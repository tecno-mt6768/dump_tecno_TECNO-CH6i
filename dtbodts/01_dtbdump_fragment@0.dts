/dts-v1/;

/ {

	__fixups__ {
		accdet = "/fragment@11:target:0";
		auxadc = "/fragment@25/__overlay__:io-channels:0", "/fragment@28:target:0", "/fragment@29/__overlay__:io-channels:0";
		camera_af_hw_node = "/fragment@64:target:0";
		charger = "/fragment@26:target:0";
		chosen = "/fragment@1:target:0";
		consys = "/fragment@17:target:0";
		dsi_te = "/fragment@48:target:0";
		extcon_usb = "/fragment@25:target:0";
		goodix_fp = "/fragment@44:target:0";
		gpio = "/fragment@41:target:0";
		gpio_usage_mapping = "/fragment@40:target:0";
		i2c0 = "/fragment@31:target:0";
		i2c1 = "/fragment@32:target:0";
		i2c2 = "/fragment@7:target:0", "/fragment@33:target:0";
		i2c3 = "/fragment@34:target:0";
		i2c4 = "/fragment@35:target:0";
		i2c5 = "/fragment@2:target:0", "/fragment@36:target:0";
		i2c6 = "/fragment@37:target:0";
		i2c7 = "/fragment@18:target:0", "/fragment@38:target:0";
		i2c8 = "/fragment@39:target:0";
		irq_nfc = "/fragment@46:target:0";
		irtx_pwm = "/fragment@19:target:0";
		kd_camera_hw1 = "/fragment@3:target:0", "/fragment@58:target:0", "/fragment@62:target:0";
		keypad = "/fragment@12:target:0", "/fragment@60:target:0";
		lk_charger = "/fragment@27:target:0";
		main_pmic = "/fragment@3/__overlay__:pmic:0", "/fragment@49:target:0";
		md1_sim1_hot_plug_eint = "/fragment@50:target:0";
		md_auxadc = "/fragment@29:target:0";
		msdc1_ins = "/fragment@43:target:0";
		mt6370_pmu = "/fragment@14:target:0";
		mt6370_typec = "/fragment@15:target:0";
		mt_charger = "/fragment@25/__overlay__:charger:0";
		mt_pmic_vcama1_ldo_reg = "/fragment@51:target:0";
		mt_pmic_vcama2_ldo_reg = "/fragment@52:target:0", "/fragment@58/__overlay__:vcama_main2-supply:0", "/fragment@58/__overlay__:vcama_sub2-supply:0", "/fragment@62/__overlay__:cam2_vcama-supply:0", "/fragment@62/__overlay__:cam3_vcama-supply:0";
		mt_pmic_vcamd_ldo_reg = "/fragment@55:target:0", "/fragment@58/__overlay__:vcamd-supply:0", "/fragment@58/__overlay__:vcamd_sub-supply:0", "/fragment@62/__overlay__:cam0_vcamd-supply:0", "/fragment@62/__overlay__:cam1_vcamd-supply:0";
		mt_pmic_vcamio_ldo_reg = "/fragment@56:target:0", "/fragment@58/__overlay__:vcamio-supply:0", "/fragment@58/__overlay__:vcamio_sub-supply:0", "/fragment@58/__overlay__:vcamio_main2-supply:0", "/fragment@62/__overlay__:cam0_vcamio-supply:0", "/fragment@62/__overlay__:cam1_vcamio-supply:0", "/fragment@62/__overlay__:cam2_vcamio-supply:0";
		mt_pmic_vio28_ldo_reg = "/fragment@5/__overlay__/fingerprint@0:vmch-supply:0";
		mt_pmic_vldo28_ldo_reg = "/fragment@57:target:0", "/fragment@58/__overlay__:vcamaf-supply:0", "/fragment@59/__overlay__:vtouch-supply:0", "/fragment@62/__overlay__:cam0_vcamaf-supply:0", "/fragment@64/__overlay__:camaf_m1_pmic-supply:0";
		mt_pmic_vsim1_ldo_reg = "/fragment@53:target:0";
		mt_pmic_vsim2_ldo_reg = "/fragment@54:target:0";
		mtkfb = "/fragment@22:target:0";
		odm = "/fragment@4:target:0", "/fragment@24:target:0";
		pio = "/fragment@2/__overlay__/sgm41516d@6B:sgm41516d,intr_gpio:0", "/fragment@2/__overlay__/sgm41516d@6B:led_ctl_gpio:0", "/fragment@3/__overlay__:camera_input_gpio:0", "/fragment@4/__overlay__/fingerprint:interrupt-parent:0", "/fragment@4/__overlay__/tran_audio:fs_extamp_gpio:0", "/fragment@5/__overlay__/fingerprint@0:interrupt-parent:0", "/fragment@5/__overlay__/fingerprint@0:irq-gpio-std:0", "/fragment@5/__overlay__/fingerprint@0:reset-gpio-std:0", "/fragment@6:target:0", "/fragment@10:target:0", "/fragment@13:target:0", "/fragment@14/__overlay__:mt6370,intr_gpio:0", "/fragment@15/__overlay__:mt6370pd,intr_gpio:0", "/fragment@16:target:0", "/fragment@18/__overlay__/nfc_nxp@28:nxp,pn544-irq:0", "/fragment@18/__overlay__/nfc_nxp@28:nxp,pn544-ven:0", "/fragment@18/__overlay__/nfc_nxp@28:nxp,pn544-fw-dwnld:0", "/fragment@20:target:0", "/fragment@21:target:0", "/fragment@23:target:0", "/fragment@24/__overlay__/otg_iddig:interrupt-parent:0", "/fragment@25/__overlay__:id-gpios:0", "/fragment@40/__overlay__:GPIO_SIM1_HOT_PLUG:0", "/fragment@40/__overlay__:GPIO_FDD_BAND_SUPPORT_DETECT_1ST_PIN:0", "/fragment@40/__overlay__:GPIO_FDD_BAND_SUPPORT_DETECT_2ND_PIN:0", "/fragment@40/__overlay__:GPIO_FDD_BAND_SUPPORT_DETECT_3RD_PIN:0", "/fragment@40/__overlay__:GPIO_SIM2_SIO:0", "/fragment@40/__overlay__:GPIO_SIM2_SRST:0", "/fragment@40/__overlay__:GPIO_SIM2_SCLK:0", "/fragment@40/__overlay__:GPIO_SIM1_SCLK:0", "/fragment@40/__overlay__:GPIO_SIM1_SRST:0", "/fragment@40/__overlay__:GPIO_SIM1_SIO:0", "/fragment@42/__overlay__:interrupt-parent:0", "/fragment@43/__overlay__:interrupt-parent:0", "/fragment@43/__overlay__:deb-gpios:0", "/fragment@44/__overlay__:interrupt-parent:0", "/fragment@45/__overlay__:interrupt-parent:0", "/fragment@46/__overlay__:interrupt-parent:0", "/fragment@47/__overlay__:interrupt-parent:0", "/fragment@48/__overlay__:interrupt-parent:0", "/fragment@49/__overlay__:interrupt-parent:0", "/fragment@61:target:0", "/fragment@63:target:0";
		pmic_clock_buffer_ctrl = "/fragment@30:target:0";
		reserved_memory = "/fragment@0:target:0";
		rt9465_slave_chr = "/fragment@47:target:0";
		spi0 = "/fragment@5:target:0";
		spi2 = "/fragment@8:target:0";
		subpmic_pmu_eint = "/fragment@45:target:0";
		touch = "/fragment@9:target:0", "/fragment@42:target:0", "/fragment@59:target:0";
	};

	__local_fixups__ {

		fragment@12 {

			__overlay__ {
				pinctrl-0 = <0x0>;
			};
		};

		fragment@17 {

			__overlay__ {
				pinctrl-0 = <0x0>;
				pinctrl-1 = <0x0>;
				pinctrl-2 = <0x0>;
				pinctrl-3 = <0x0>;
			};
		};

		fragment@19 {

			__overlay__ {
				pinctrl-0 = <0x0>;
				pinctrl-1 = <0x0>;
			};
		};

		fragment@22 {

			__overlay__ {
				pinctrl-0 = <0x0>;
				pinctrl-1 = <0x0>;
				pinctrl-2 = <0x0>;
				pinctrl-3 = <0x0>;
				pinctrl-4 = <0x0>;
				pinctrl-5 = <0x0>;
				pinctrl-6 = <0x0>;
			};
		};

		fragment@24 {

			__overlay__ {

				tran_battery {
					pinctrl-0 = <0x0>;
					pinctrl-1 = <0x0>;
					pinctrl-2 = <0x0>;
					pinctrl-3 = <0x0>;
					pinctrl-4 = <0x0>;
					pinctrl-5 = <0x0>;
				};
			};
		};

		fragment@4 {

			__overlay__ {

				fingerprint {
					pinctrl-0 = <0x0>;
					pinctrl-1 = <0x0>;
					pinctrl-2 = <0x0>;
					pinctrl-3 = <0x0>;
					pinctrl-4 = <0x0>;
				};

				flashlights_ocp81375 {
					pinctrl-0 = <0x0>;
					pinctrl-1 = <0x0>;
					pinctrl-2 = <0x0>;
				};
			};
		};

		fragment@5 {

			__overlay__ {

				fingerprint@0 {
					pinctrl-0 = <0x0>;
					pinctrl-1 = <0x0>;
					pinctrl-2 = <0x0>;
					pinctrl-3 = <0x0>;
					pinctrl-4 = <0x0>;
				};
			};
		};

		fragment@62 {

			__overlay__ {
				pinctrl-0 = <0x0>;
				pinctrl-1 = <0x0>;
				pinctrl-10 = <0x0>;
				pinctrl-11 = <0x0>;
				pinctrl-12 = <0x0>;
				pinctrl-13 = <0x0>;
				pinctrl-14 = <0x0>;
				pinctrl-15 = <0x0>;
				pinctrl-16 = <0x0>;
				pinctrl-17 = <0x0>;
				pinctrl-18 = <0x0>;
				pinctrl-19 = <0x0>;
				pinctrl-2 = <0x0>;
				pinctrl-20 = <0x0>;
				pinctrl-21 = <0x0>;
				pinctrl-22 = <0x0>;
				pinctrl-23 = <0x0>;
				pinctrl-24 = <0x0>;
				pinctrl-25 = <0x0>;
				pinctrl-26 = <0x0>;
				pinctrl-27 = <0x0>;
				pinctrl-28 = <0x0>;
				pinctrl-29 = <0x0>;
				pinctrl-3 = <0x0>;
				pinctrl-30 = <0x0>;
				pinctrl-31 = <0x0>;
				pinctrl-32 = <0x0>;
				pinctrl-33 = <0x0>;
				pinctrl-34 = <0x0>;
				pinctrl-35 = <0x0>;
				pinctrl-36 = <0x0>;
				pinctrl-37 = <0x0>;
				pinctrl-38 = <0x0>;
				pinctrl-39 = <0x0>;
				pinctrl-4 = <0x0>;
				pinctrl-40 = <0x0>;
				pinctrl-5 = <0x0>;
				pinctrl-6 = <0x0>;
				pinctrl-7 = <0x0>;
				pinctrl-8 = <0x0>;
				pinctrl-9 = <0x0>;
			};
		};

		fragment@9 {

			__overlay__ {
				pinctrl-0 = <0x0>;
				pinctrl-1 = <0x0>;
				pinctrl-2 = <0x0>;
				pinctrl-3 = <0x0>;
				pinctrl-4 = <0x0>;
				pinctrl-5 = <0x0>;
			};
		};
	};

	__symbols__ {
		camera0_mclk_2mA = "/fragment@61/__overlay__/camera0_mclk_2mA@gpio100";
		camera0_mclk_4mA = "/fragment@61/__overlay__/camera0_mclk_4mA@gpio100";
		camera0_mclk_6mA = "/fragment@61/__overlay__/camera0_mclk_6mA@gpio100";
		camera0_mclk_8mA = "/fragment@61/__overlay__/camera0_mclk_8mA@gpio100";
		camera0_mclk_off = "/fragment@61/__overlay__/camera0_mclk_gpio_mode@gpio100";
		camera0_pdn_high = "/fragment@61/__overlay__/camera0_pdn_output_high@gpio98";
		camera0_pdn_low = "/fragment@61/__overlay__/camera0_pdn_output_low@gpio98";
		camera0_rst_high = "/fragment@61/__overlay__/camera0_rst_output_high@gpio102";
		camera0_rst_low = "/fragment@61/__overlay__/camera0_rst_output_low@gpio102";
		camera0_vcama_off = "/fragment@61/__overlay__/camera0_vcama_output_low@gpio23";
		camera0_vcama_on = "/fragment@61/__overlay__/camera0_vcama_output_high@gpio23";
		camera1_mclk_2mA = "/fragment@61/__overlay__/camera1_mclk_2mA@gpio99";
		camera1_mclk_4mA = "/fragment@61/__overlay__/camera1_mclk_4mA@gpio99";
		camera1_mclk_6mA = "/fragment@61/__overlay__/camera1_mclk_6mA@gpio99";
		camera1_mclk_8mA = "/fragment@61/__overlay__/camera1_mclk_8mA@gpio99";
		camera1_mclk_off = "/fragment@61/__overlay__/camera1_mclk_gpio_mode@gpio99";
		camera1_pdn_high = "/fragment@61/__overlay__/camera1_pdn_output_high@gpio97";
		camera1_pdn_low = "/fragment@61/__overlay__/camera1_pdn_output_low@gpio97";
		camera1_rst_high = "/fragment@61/__overlay__/camera1_rst_output_high@gpio101";
		camera1_rst_low = "/fragment@61/__overlay__/camera1_rst_output_low@gpio101";
		camera1_vcama_off = "/fragment@61/__overlay__/camera1_vcama_output_low@gpio23";
		camera1_vcama_on = "/fragment@61/__overlay__/camera1_vcama_output_high@gpio23";
		camera2_mclk_2mA = "/fragment@61/__overlay__/camera2_mclk_2mA@gpio111";
		camera2_mclk_4mA = "/fragment@61/__overlay__/camera2_mclk_4mA@gpio111";
		camera2_mclk_6mA = "/fragment@61/__overlay__/camera2_mclk_6mA@gpio111";
		camera2_mclk_8mA = "/fragment@61/__overlay__/camera2_mclk_8mA@gpio111";
		camera2_mclk_off = "/fragment@61/__overlay__/camera2_mclk_gpio_mode@gpio111";
		camera2_pdn_high = "/fragment@61/__overlay__/camera2_pdn_output_high@gpio110";
		camera2_pdn_low = "/fragment@61/__overlay__/camera2_pdn_output_low@gpio110";
		camera2_rst_high = "/fragment@61/__overlay__/camera2_rst_output_high@gpio112";
		camera2_rst_low = "/fragment@61/__overlay__/camera2_rst_output_low@gpio112";
		camera3_mclk_2mA = "/fragment@61/__overlay__/camera3_mclk_2mA@gpio108";
		camera3_mclk_4mA = "/fragment@61/__overlay__/camera3_mclk_4mA@gpio108";
		camera3_mclk_6mA = "/fragment@61/__overlay__/camera3_mclk_6mA@gpio108";
		camera3_mclk_8mA = "/fragment@61/__overlay__/camera3_mclk_8mA@gpio108";
		camera3_mclk_off = "/fragment@61/__overlay__/camera3_mclk_gpio_mode@gpio108";
		camera3_pdn_high = "/fragment@61/__overlay__/camera3_pdn_output_high@gpio107";
		camera3_pdn_low = "/fragment@61/__overlay__/camera3_pdn_output_low@gpio107";
		camera3_rst_high = "/fragment@61/__overlay__/camera3_rst_output_high@gpio107";
		camera3_rst_low = "/fragment@61/__overlay__/camera3_rst_output_low@gpio107";
		camera_main_af_mtk = "/fragment@35/__overlay__/camera_main_af@0c";
		camera_main_eeprom_mtk = "/fragment@35/__overlay__/camera_main_eeprom@50";
		camera_main_mtk = "/fragment@35/__overlay__/camera_main@1a";
		camera_main_two_mtk = "/fragment@34/__overlay__/camera_main_two@10";
		camera_pins_default = "/fragment@61/__overlay__/camdefault";
		camera_sub_eeprom_mtk = "/fragment@34/__overlay__/camera_sub_eeprom@51";
		camera_sub_mtk = "/fragment@34/__overlay__/camera_sub@2d";
		camera_sub_two_mtk = "/fragment@33/__overlay__/camera_sub_two@50";
		ccu_sensor_i2c_2_hw_mtk = "/fragment@33/__overlay__/ccu_sensor_i2c_2_hw@11";
		ccu_sensor_i2c_4_hw_mtk = "/fragment@35/__overlay__/ccu_sensor_i2c_4_hw@12";
		consys_pins_default = "/fragment@16/__overlay__/consys_default";
		ctp_pins_default = "/fragment@10/__overlay__/eint0default";
		ctp_pins_eint_as_int = "/fragment@10/__overlay__/ctpeint@0";
		ctp_pins_eint_output0 = "/fragment@10/__overlay__/eintoutput0";
		ctp_pins_eint_output1 = "/fragment@10/__overlay__/eintoutput1";
		ctp_pins_rst_output0 = "/fragment@10/__overlay__/rstoutput0";
		ctp_pins_rst_output1 = "/fragment@10/__overlay__/rstoutput1";
		fingerprint = "/fragment@4/__overlay__/fingerprint";
		fingerprint_default = "/fragment@6/__overlay__/fingerprint_default";
		fingerprint_eint = "/fragment@6/__overlay__/gpio7_eint";
		fingerprint_eint_pull_down = "/fragment@6/__overlay__/gpio7_eint_pull_down";
		fingerprint_rst_one = "/fragment@6/__overlay__/rst_out_one";
		fingerprint_rst_zero = "/fragment@6/__overlay__/rst_out_zero";
		flashlights_ocp81375 = "/fragment@4/__overlay__/flashlights_ocp81375";
		flashlights_ocp81375_pins_default = "/fragment@63/__overlay__/ocp81375default";
		flashlights_ocp81375_pins_hwen_high = "/fragment@63/__overlay__/ocp81375hwen_high";
		flashlights_ocp81375_pins_hwen_low = "/fragment@63/__overlay__/ocp81375hwen_low";
		gpio178_otg = "/fragment@23/__overlay__/otg_init";
		gpio178_otg_high = "/fragment@23/__overlay__/otg_high";
		gpio178_otg_low = "/fragment@23/__overlay__/otg_low";
		gpio8_meta = "/fragment@23/__overlay__/meta_init";
		gpio8_meta_high = "/fragment@23/__overlay__/meta_high";
		gpio8_meta_low = "/fragment@23/__overlay__/meta_low";
		gpslna_pins_init = "/fragment@16/__overlay__/gpslna@0";
		gpslna_pins_oh = "/fragment@16/__overlay__/gpslna@1";
		gpslna_pins_ol = "/fragment@16/__overlay__/gpslna@2";
		i2c_lcd_bias_mtk = "/fragment@37/__overlay__/i2c_lcd_bias@3e";
		irtx_gpio_led_default = "/fragment@20/__overlay__/irtx_gpio_led_def@gpio12";
		irtx_gpio_led_set = "/fragment@20/__overlay__/irtx_gpio_led_set@gpio12";
		kpd_pins_default = "/fragment@13/__overlay__/kpdgpiodefault";
		led0 = "/fragment@4/__overlay__/led@0";
		led1 = "/fragment@4/__overlay__/led@1";
		led2 = "/fragment@4/__overlay__/led@2";
		led3 = "/fragment@4/__overlay__/led@3";
		led4 = "/fragment@4/__overlay__/led@4";
		led5 = "/fragment@4/__overlay__/led@5";
		led6 = "/fragment@4/__overlay__/led@6";
		mtkfb_pins_default = "/fragment@21/__overlay__/dispdefault";
		mtkfb_pins_lcd_bias_enn0 = "/fragment@21/__overlay__/lcd_bias_enn0_gpio";
		mtkfb_pins_lcd_bias_enn1 = "/fragment@21/__overlay__/lcd_bias_enn1_gpio";
		mtkfb_pins_lcd_bias_enp0 = "/fragment@21/__overlay__/lcd_bias_enp0_gpio";
		mtkfb_pins_lcd_bias_enp1 = "/fragment@21/__overlay__/lcd_bias_enp1_gpio";
		mtkfb_pins_lcm_reset0 = "/fragment@21/__overlay__/lcm_rst_out0_gpio";
		mtkfb_pins_lcm_reset1 = "/fragment@21/__overlay__/lcm_rst_out1_gpio";
		nfc_mtk = "/fragment@38/__overlay__/nfc@28";
		otg_iddig = "/fragment@24/__overlay__/otg_iddig";
		sgm41516d = "/fragment@2/__overlay__/sgm41516d@6B";
		strobe_main_mtk = "/fragment@37/__overlay__/strobe_main@63";
		subpmic_pmu_mtk = "/fragment@36/__overlay__/subpmic_pmu@34";
		tran_audio = "/fragment@4/__overlay__/tran_audio";
		tran_battery = "/fragment@24/__overlay__/tran_battery";
		tran_battery_aging = "/fragment@24/__overlay__/tran_battery_aging";
		tran_touch = "/fragment@8/__overlay__/touch@0";
		usb_type_c_mtk = "/fragment@36/__overlay__/usb_type_c@4e";
		vibrator0 = "/fragment@4/__overlay__/vibrator@0";
	};

	fragment@0 {
		target = <0xffffffff>;

		__overlay__ {

			reserve-memory-scp_share {
				alignment = <0x0 0x1000000>;
				alloc-ranges = <0x0 0x40000000 0x0 0x50000000>;
				compatible = "mediatek,reserve-memory-scp_share";
				no-map;
				size = <0x0 0xd00000>;
			};
		};
	};

	fragment@1 {
		target = <0xffffffff>;

		__overlay__ {
			atag,videolfb-fb_base_h = <0x0>;
			atag,videolfb-fb_base_l = "~`P";
			atag,videolfb-fps = <0x1770>;
			atag,videolfb-islcm_inited = <0x0>;
			atag,videolfb-islcmfound = <0x1>;
			atag,videolfb-lcmname = "hx83112b_fhdp_dsi_cmd_auo_rt5081_drv";
			atag,videolfb-vramSize = <0x17e8000>;
		};
	};

	fragment@10 {
		target = <0xffffffff>;

		__overlay__ {

			ctpeint@0 {
				phandle = <0xa>;

				pins_cmd_dat {
					pinmux = <0x100>;
					slew-rate = <0x0>;
				};
			};

			eint0default {
				phandle = <0x9>;
			};

			eintoutput0 {
				phandle = <0xb>;

				pins_cmd_dat {
					output-low;
					pinmux = <0x100>;
					slew-rate = <0x1>;
				};
			};

			eintoutput1 {
				phandle = <0xc>;

				pins_cmd_dat {
					output-high;
					pinmux = <0x100>;
					slew-rate = <0x1>;
				};
			};

			rstoutput0 {
				phandle = <0xd>;

				pins_cmd_dat {
					output-low;
					pinmux = <0x0>;
					slew-rate = <0x1>;
				};
			};

			rstoutput1 {
				phandle = <0xe>;

				pins_cmd_dat {
					output-high;
					pinmux = <0x0>;
					slew-rate = <0x1>;
				};
			};
		};
	};

	fragment@11 {
		target = <0xffffffff>;

		__overlay__ {
			accdet-mic-mode = <0x1>;
			accdet-mic-vol = <0x6>;
			accdet-plugout-debounce = <0x1>;
			headset-eint-level-pol = <0x8>;
			headset-four-key-threshold = <0x0 0x3a 0x79 0xc0 0x190>;
			headset-mode-setting = <0x500 0x500 0x1 0x1f0 0x800 0x800 0x20 0x44>;
			headset-three-key-threshold = <0x0 0x50 0xdc 0x190>;
			headset-three-key-threshold-CDD = <0x0 0x79 0xc0 0x258>;
			status = "okay";
		};
	};

	fragment@12 {
		target = <0xffffffff>;

		__overlay__ {
			pinctrl-0 = <0xf>;
			pinctrl-names = "default";
		};
	};

	fragment@13 {
		target = <0xffffffff>;

		__overlay__ {

			kpdgpiodefault {
				phandle = <0xf>;

				pins_cmd_dat {
					bias-pull-up = <0x66>;
					input-enable;
					input-schmitt-enable;
					pinmux = <0x5d01>;
				};
			};
		};
	};

	fragment@14 {
		target = <0xffffffff>;

		__overlay__ {
			mt6370,intr_gpio = <0xffffffff 0x14 0x0>;
			mt6370,intr_gpio_num = <0x14>;
		};
	};

	fragment@15 {
		target = <0xffffffff>;

		__overlay__ {
			mt6370pd,intr_gpio = <0xffffffff 0x29 0x0>;
			mt6370pd,intr_gpio_num = <0x29>;
		};
	};

	fragment@16 {
		target = <0xffffffff>;

		__overlay__ {

			consys_default {
				phandle = <0x10>;
			};

			gpslna@0 {
				phandle = <0x11>;

				pins_cmd_dat {
					bias-disable;
					output-low;
					pinmux = <0x5b00>;
					slew-rate = <0x0>;
				};
			};

			gpslna@1 {
				phandle = <0x12>;

				pins_cmd_dat {
					output-high;
					pinmux = <0x5b00>;
					slew-rate = <0x1>;
				};
			};

			gpslna@2 {
				phandle = <0x13>;

				pins_cmd_dat {
					output-low;
					pinmux = <0x5b00>;
					slew-rate = <0x1>;
				};
			};
		};
	};

	fragment@17 {
		target = <0xffffffff>;

		__overlay__ {
			pinctrl-0 = <0x10>;
			pinctrl-1 = <0x11>;
			pinctrl-2 = <0x12>;
			pinctrl-3 = <0x13>;
			pinctrl-names = "default", "gps_lna_state_init", "gps_lna_state_oh", "gps_lna_state_ol";
			status = "okay";
		};
	};

	fragment@18 {
		target = <0xffffffff>;

		__overlay__ {
			status = "okay";

			nfc_nxp@28 {
				compatible = "nxp,pn544";
				nxp,pn544-fw-dwnld = <0xffffffff 0xa6 0x0>;
				nxp,pn544-irq = <0xffffffff 0x1d 0x0>;
				nxp,pn544-ven = <0xffffffff 0x1e 0x0>;
				reg = <0x28>;
			};
		};
	};

	fragment@19 {
		target = <0xffffffff>;

		__overlay__ {
			pinctrl-0 = <0x14>;
			pinctrl-1 = <0x15>;
			pinctrl-names = "irtx_gpio_led_default", "irtx_gpio_led_set";
			status = "okay";
		};
	};

	fragment@2 {
		target = <0xffffffff>;

		__overlay__ {

			sgm41516d@6B {
				compatible = "mediatek,sgm41516d";
				led_ctl_gpio = <0xffffffff 0xa5 0x0>;
				phandle = <0x4c>;
				reg = <0x6b>;
				sgm41516d,intr_gpio = <0xffffffff 0x9 0x0>;
				sgm41516d,intr_gpio_num = <0x9>;
				status = "okay";
			};
		};
	};

	fragment@20 {
		target = <0xffffffff>;

		__overlay__ {

			irtx_gpio_led_def@gpio12 {
				phandle = <0x14>;

				pins_cmd_dat {
					bias-disable;
					input-schmitt-enable = <0x0>;
					output-low;
					pinmux = <0xc00>;
					slew-rate = <0x1>;
				};
			};

			irtx_gpio_led_set@gpio12 {
				phandle = <0x15>;

				pins_cmd_dat {
					output-high;
					pinmux = <0xc01>;
					slew-rate = <0x1>;
				};
			};
		};
	};

	fragment@21 {
		target = <0xffffffff>;

		__overlay__ {

			dispdefault {
				phandle = <0x16>;
			};

			lcd_bias_enn0_gpio {
				phandle = <0x1b>;

				pins_cmd_dat {
					output-low;
					pinmux = <0x9800>;
					slew-rate = <0x1>;
				};
			};

			lcd_bias_enn1_gpio {
				phandle = <0x1c>;

				pins_cmd_dat {
					output-high;
					pinmux = <0x9800>;
					slew-rate = <0x1>;
				};
			};

			lcd_bias_enp0_gpio {
				phandle = <0x19>;

				pins_cmd_dat {
					output-low;
					pinmux = <0x9900>;
					slew-rate = <0x1>;
				};
			};

			lcd_bias_enp1_gpio {
				phandle = <0x1a>;

				pins_cmd_dat {
					output-high;
					pinmux = <0x9900>;
					slew-rate = <0x1>;
				};
			};

			lcm_rst_out0_gpio {
				phandle = <0x17>;

				pins_cmd_dat {
					output-low;
					pinmux = <0x2d00>;
					slew-rate = <0x1>;
				};
			};

			lcm_rst_out1_gpio {
				phandle = <0x18>;

				pins_cmd_dat {
					output-high;
					pinmux = <0x2d00>;
					slew-rate = <0x1>;
				};
			};
		};
	};

	fragment@22 {
		target = <0xffffffff>;

		__overlay__ {
			pinctrl-0 = <0x16>;
			pinctrl-1 = <0x17>;
			pinctrl-2 = <0x18>;
			pinctrl-3 = <0x19>;
			pinctrl-4 = <0x1a>;
			pinctrl-5 = <0x1b>;
			pinctrl-6 = <0x1c>;
			pinctrl-names = "dispdefault", "lcm_rst_out0_gpio", "lcm_rst_out1_gpio", "lcd_bias_enp0_gpio", "lcd_bias_enp1_gpio", "lcd_bias_enn0_gpio", "lcd_bias_enn1_gpio";
			status = "okay";
		};
	};

	fragment@23 {
		target = <0xffffffff>;

		__overlay__ {

			meta_high {
				phandle = <0x22>;

				pins_cmd_dat {
					output-high;
					pinmux = <0x800>;
					slew-rate = <0x1>;
				};
			};

			meta_init {
				phandle = <0x20>;

				pins_cmd_dat {
					pinmux = <0x800>;
					slew-rate = <0x1>;
				};
			};

			meta_low {
				phandle = <0x21>;

				pins_cmd_dat {
					output-low;
					pinmux = <0x800>;
					slew-rate = <0x1>;
				};
			};

			otg_high {
				phandle = <0x1f>;

				pins_cmd_dat {
					output-high;
					pinmux = <0xb200>;
					slew-rate = <0x1>;
				};
			};

			otg_init {
				phandle = <0x1d>;

				pins_cmd_dat {
					pinmux = <0xb200>;
					slew-rate = <0x1>;
				};
			};

			otg_low {
				phandle = <0x1e>;

				pins_cmd_dat {
					output-low;
					pinmux = <0xb200>;
					slew-rate = <0x1>;
				};
			};
		};
	};

	fragment@24 {
		target = <0xffffffff>;

		__overlay__ {

			otg_iddig {
				compatible = "mediatek,usb_iddig_bi_eint";
				debounce = <0xfa00>;
				interrupt-parent = <0xffffffff>;
				interrupts = <0x29 0x8 0x29 0x0>;
				phandle = <0x59>;
				status = "okay";
			};

			tran_battery {
				compatible = "tran,chg_fun";
				enable_pcb_tml;
				jeita_above_t4_chg_cur = <0x0>;
				jeita_above_t4_input_cur = <0xf4240>;
				jeita_below_t0_chg_cur = <0x0>;
				jeita_below_t0_input_cur = <0x16e360>;
				jeita_t0_to_t1_chg_cur = <0xf4240>;
				jeita_t0_to_t1_input_cur = <0x16e360>;
				jeita_t2_to_t3_chg_cur = <0x1e8480>;
				jeita_t2_to_t3_input_cur = <0x200b20>;
				jeita_t3_to_t4_chg_cur = <0x1e8480>;
				jeita_t3_to_t4_input_cur = <0x200b20>;
				pcb_cur_step_one = <0x1f4>;
				pcb_cur_step_two = <0x1f4>;
				pcb_min_chg_cur = <0xf4240>;
				pcb_temp_step_one = <0x9c40>;
				pcb_temp_step_two = <0xabe0>;
				phandle = <0x5a>;
				pinctrl-0 = <0x1d>;
				pinctrl-1 = <0x1e>;
				pinctrl-2 = <0x1f>;
				pinctrl-3 = <0x20>;
				pinctrl-4 = <0x21>;
				pinctrl-5 = <0x22>;
				pinctrl-names = "otg_gpio_init", "otg_gpio_low", "otg_gpio_high", "meta_gpio_init", "meta_gpio_low", "meta_gpio_high";
			};

			tran_battery_aging {
				battery_aging_module0 = <0x0>;
				battery_aging_module1 = <0x0>;
				battery_aging_module2 = <0x0>;
				battery_aging_module3 = <0x0>;
				compatible = "tran,chg_aging";
				phandle = <0x5b>;
			};
		};
	};

	fragment@25 {
		target = <0xffffffff>;

		__overlay__ {
			charger = <0xffffffff>;
			fake_typec_otg_detect;
			id-gpios = <0xffffffff 0x29 0x0>;
			io-channel-names = "AUX_CHG";
			io-channels = <0xffffffff 0x4>;
		};
	};

	fragment@26 {
		target = <0xffffffff>;

		__overlay__ {
			ac_charger_current = <0x2191c0>;
			ac_charger_input_current = <0x1e8480>;
			algorithm_name = "SwitchCharging";
			apple_1_0a_charger_current = <0x9eb10>;
			apple_2_1a_charger_current = <0xc3500>;
			battery_cv = <0x432380 0x432380 0x432380 0x432380>;
			bif_cv_under_threshold2 = <0x43e6d0>;
			bif_threshold1 = <0x40d990>;
			bif_threshold2 = <0x419ce0>;
			cable_imp_threshold = <0x2bb>;
			charging_host_charger_current = <0x16e360>;
			chg1_ta_ac_charger_current = <0x16e360>;
			chg2_ta_ac_charger_current = <0x16e360>;
			compatible = "mediatek,charger";
			disable_pd_dual;
			dual_polling_ieoc = <0x6ddd0>;
			enable_hvdcp20;
			enable_ir_comp;
			enable_min_charge_temp;
			enable_pe_2;
			enable_pe_plus;
			enable_sw_jeita;
			enable_tc30;
			high_temp_to_enter_pe40 = <0x27>;
			high_temp_to_leave_pe40 = <0x2e>;
			ibus_err = <0xe>;
			jeita_temp_above_t4_cv = <0x3e8fa0 0x3e8fa0 0x3e8fa0 0x3e8fa0>;
			jeita_temp_below_t0_cv = <0x432380 0x432380 0x432380 0x432380>;
			jeita_temp_t0_to_t1_cv = <0x432380 0x432380 0x432380 0x432380>;
			jeita_temp_t1_to_t2_cv = <0x432380 0x432380 0x432380 0x432380>;
			jeita_temp_t2_to_t3_cv = <0x432380 0x432380 0x432380 0x432380>;
			jeita_temp_t3_to_t4_cv = <0x3e8fa0 0x3e8fa0 0x3e8fa0 0x3e8fa0>;
			low_temp_to_enter_pe40 = <0x10>;
			low_temp_to_leave_pe40 = <0xa>;
			max_charge_temp = <0x35>;
			max_charge_temp_minus_x_degree = <0x34>;
			max_charger_voltage = <0x632ea0>;
			max_charging_time = <0x11940>;
			max_dmivr_charger_current = <0x155cc0>;
			min_charge_temp = <0x0>;
			min_charge_temp_plus_x_degree = <0x1>;
			min_charger_voltage = <0x4630c0>;
			min_charger_voltage_1 = <0x432380>;
			min_charger_voltage_2 = <0x401640>;
			multi_battery_cv;
			non_std_ac_charger_current = <0x124f80>;
			pd_ichg_level_threshold = <0xf4240>;
			pd_stop_battery_soc = <0x50>;
			pd_vbus_low_bound = <0x4c4b40>;
			pd_vbus_upper_bound = <0x4c4b40>;
			pe20_ichg_level_threshold = <0xf4240>;
			pe40_dual_charger_chg1_current = <0x1e8480>;
			pe40_dual_charger_chg2_current = <0x1e8480>;
			pe40_dual_charger_input_current = <0x2dc6c0>;
			pe40_r_cable_1a_lower = <0x206>;
			pe40_r_cable_2a_lower = <0x17f>;
			pe40_r_cable_3a_lower = <0xf5>;
			pe40_single_charger_current = <0x2dc6c0>;
			pe40_single_charger_input_current = <0x2dc6c0>;
			pe40_stop_battery_soc = <0x50>;
			pe_ichg_level_threshold = <0xf4240>;
			power_path_support;
			r_bat_comp = <0x1e>;
			slave_mivr_diff = <0x186a0>;
			ta_9v_support;
			ta_ac_12v_input_current = <0x30d400>;
			ta_ac_7v_input_current = <0x1e8480>;
			ta_ac_9v_input_current = <0x200b20>;
			ta_ac_charger_current = <0x2dc6c0>;
			ta_start_battery_soc = <0x0>;
			ta_stop_battery_soc = <0x5a>;
			temp_neg_10_thres = <0x2>;
			temp_t0_thres = <0x1>;
			temp_t0_thres_plus_x_degree = <0x1>;
			temp_t1_thres = <0x1>;
			temp_t1_thres_plus_x_degree = <0x1>;
			temp_t2_thres = <0xf>;
			temp_t2_thres_plus_x_degree = <0x10>;
			temp_t3_thres = <0x2d>;
			temp_t3_thres_minus_x_degree = <0x2c>;
			temp_t4_thres = <0x37>;
			temp_t4_thres_minus_x_degree = <0x33>;
			usb_charger_current = <0x7a120>;
			usb_charger_current_configured = <0x7a120>;
			usb_charger_current_suspend = <0x0>;
			usb_charger_current_unconfigured = <0x11170>;
			v_comp_max = <0x9c40>;
			vbat_cable_imp_threshold = <0x3b8260>;
			vsys_watt = <0x4c4b40>;
		};
	};

	fragment@27 {
		target = <0xffffffff>;

		__overlay__ {
			ac_charger_current = <0x16e360>;
			ac_charger_input_current = <0x16e360>;
			charging_host_charger_current = <0x16e360>;
			compatible = "mediatek,lk_charger";
			cur_threshold = <0x7a120>;
			enable_anime;
			enable_pd20_reset;
			enable_pe_plus;
			fast_charge_voltage = <0x2625a0>;
			max_charger_voltage = <0x632ea0>;
			non_std_ac_charger_current = <0x7a120>;
			pd_charger_current = <0x7a120>;
			power_path_support;
			ta_ac_charger_current = <0x2dc6c0>;
			temp_t1_threshold = <0x0>;
			temp_t2_threshold = <0xf>;
			temp_t3_threshold = <0x2d>;
			temp_t4_threshold = <0x32>;
			usb_charger_current = <0x7a120>;
		};
	};

	fragment@28 {
		target = <0xffffffff>;

		__overlay__ {

			adc_channel@ {
				compatible = "mediatek,adc_channel";
				mediatek,adc_fdd_rf_params_dynamic_custom_ch = <0x2>;
				mediatek,temperature0 = <0x0>;
				mediatek,temperature1 = <0x1>;
				status = "okay";
			};
		};
	};

	fragment@29 {
		target = <0xffffffff>;

		__overlay__ {
			io-channels = <0xffffffff 0x2>;
		};
	};

	fragment@3 {
		target = <0xffffffff>;

		__overlay__ {
			camera_input_gpio = <0xffffffff 0x15 0x0>;
			pmic = <0xffffffff>;
		};
	};

	fragment@30 {
		target = <0xffffffff>;

		__overlay__ {
			mediatek,clkbuf-config = <0x2 0x1 0x1 0x2 0x0 0x0 0x0>;
			mediatek,clkbuf-driving-current = <0x1 0x1 0x1 0x1 0x1 0x1 0x1>;
			mediatek,clkbuf-quantity = <0x7>;
			status = "okay";
		};
	};

	fragment@31 {
		target = <0xffffffff>;

		__overlay__ {
			#address-cells = <0x1>;
			#size-cells = <0x0>;
			clock-frequency = <0x61a80>;
			mediatek,use-open-drain;
		};
	};

	fragment@32 {
		target = <0xffffffff>;

		__overlay__ {
			#address-cells = <0x1>;
			#size-cells = <0x0>;
			clock-frequency = <0x61a80>;
			mediatek,use-open-drain;
		};
	};

	fragment@33 {
		target = <0xffffffff>;

		__overlay__ {
			#address-cells = <0x1>;
			#size-cells = <0x0>;
			clock-frequency = <0x61a80>;
			mediatek,use-open-drain;

			camera_sub_two@50 {
				compatible = "mediatek,camera_sub_two";
				phandle = <0x5c>;
				reg = <0x50>;
				status = "okay";
			};

			ccu_sensor_i2c_2_hw@11 {
				compatible = "mediatek,ccu_sensor_i2c_2_hw";
				phandle = <0x5d>;
				reg = <0x11>;
				status = "okay";
			};
		};
	};

	fragment@34 {
		target = <0xffffffff>;

		__overlay__ {
			#address-cells = <0x1>;
			#size-cells = <0x0>;
			clock-frequency = <0x61a80>;
			mediatek,use-open-drain;

			camera_main_two@10 {
				compatible = "mediatek,camera_main_two";
				phandle = <0x5e>;
				reg = <0x10>;
				status = "okay";
			};

			camera_sub@2d {
				compatible = "mediatek,camera_sub";
				phandle = <0x5f>;
				reg = <0x2d>;
				status = "okay";
			};

			camera_sub_eeprom@51 {
				compatible = "mediatek,camera_sub_eeprom";
				phandle = <0x60>;
				reg = <0x51>;
				status = "okay";
			};
		};
	};

	fragment@35 {
		target = <0xffffffff>;

		__overlay__ {
			#address-cells = <0x1>;
			#size-cells = <0x0>;
			clock-frequency = <0x61a80>;
			mediatek,use-open-drain;

			camera_main@1a {
				compatible = "mediatek,camera_main";
				phandle = <0x61>;
				reg = <0x1a>;
				status = "okay";
			};

			camera_main_af@0c {
				compatible = "mediatek,camera_main_af";
				phandle = <0x63>;
				reg = <0xc>;
				status = "okay";
			};

			camera_main_eeprom@50 {
				compatible = "mediatek,camera_main_eeprom";
				phandle = <0x62>;
				reg = <0x50>;
				status = "okay";
			};

			ccu_sensor_i2c_4_hw@12 {
				compatible = "mediatek,ccu_sensor_i2c_4_hw";
				phandle = <0x64>;
				reg = <0x12>;
				status = "okay";
			};
		};
	};

	fragment@36 {
		target = <0xffffffff>;

		__overlay__ {
			#address-cells = <0x1>;
			#size-cells = <0x0>;
			clock-frequency = <0x61a80>;
			mediatek,use-open-drain;

			subpmic_pmu@34 {
				compatible = "mediatek,subpmic_pmu";
				phandle = <0x65>;
				reg = <0x34>;
				status = "okay";
			};

			usb_type_c@4e {
				compatible = "mediatek,usb_type_c";
				phandle = <0x66>;
				reg = <0x4e>;
				status = "okay";
			};
		};
	};

	fragment@37 {
		target = <0xffffffff>;

		__overlay__ {
			#address-cells = <0x1>;
			#size-cells = <0x0>;
			clock-frequency = <0x61a80>;
			mediatek,use-open-drain;

			i2c_lcd_bias@3e {
				compatible = "mediatek,i2c_lcd_bias";
				phandle = <0x67>;
				reg = <0x3e>;
				status = "okay";
			};

			strobe_main@63 {
				compatible = "mediatek,strobe_main";
				phandle = <0x68>;
				reg = <0x63>;
				status = "okay";
			};
		};
	};

	fragment@38 {
		target = <0xffffffff>;

		__overlay__ {
			#address-cells = <0x1>;
			#size-cells = <0x0>;
			clock-frequency = <0x61a80>;
			mediatek,use-open-drain;

			nfc@28 {
				compatible = "mediatek,nfc";
				phandle = <0x69>;
				reg = <0x28>;
				status = "okay";
			};
		};
	};

	fragment@39 {
		target = <0xffffffff>;

		__overlay__ {
			#address-cells = <0x1>;
			#size-cells = <0x0>;
			clock-frequency = <0x61a80>;
			mediatek,use-open-drain;
		};
	};

	fragment@4 {
		target = <0xffffffff>;

		__overlay__ {

			fingerprint {
				compatible = "tran_fp";
				debounce = <0x7 0x0>;
				interrupt-parent = <0xffffffff>;
				interrupts = <0x7 0x1 0x7 0x0>;
				phandle = <0x56>;
				pinctrl-0 = <0x4>;
				pinctrl-1 = <0x5>;
				pinctrl-2 = <0x6>;
				pinctrl-3 = <0x7>;
				pinctrl-4 = <0x8>;
				pinctrl-names = "tran_fp_default", "tran_fp_pin_irq", "tran_fp_irq_pull_down", "tran_fp_reset_high", "tran_fp_reset_low";
				status = "okay";
			};

			flashlights_ocp81375 {
				compatible = "mediatek,flashlights_ocp81375";
				phandle = <0x4d>;
				pinctrl-0 = <0x1>;
				pinctrl-1 = <0x2>;
				pinctrl-2 = <0x3>;
				pinctrl-names = "ocp81375default", "ocp81375hwen_high", "ocp81375hwen_low";
				status = "okay";
			};

			led@0 {
				compatible = "mediatek,red";
				data = <0x1>;
				led_mode = <0x0>;
				phandle = <0x4e>;
				pwm_config = <0x0 0x0 0x0 0x0 0x0>;
			};

			led@1 {
				compatible = "mediatek,green";
				data = <0x1>;
				led_mode = <0x0>;
				phandle = <0x4f>;
				pwm_config = <0x0 0x0 0x0 0x0 0x0>;
			};

			led@2 {
				compatible = "mediatek,blue";
				data = <0x1>;
				led_mode = <0x0>;
				phandle = <0x50>;
				pwm_config = <0x0 0x0 0x0 0x0 0x0>;
			};

			led@3 {
				compatible = "mediatek,jogball-backlight";
				data = <0x1>;
				led_mode = <0x0>;
				phandle = <0x51>;
				pwm_config = <0x0 0x0 0x0 0x0 0x0>;
			};

			led@4 {
				compatible = "mediatek,keyboard-backlight";
				data = <0x1>;
				led_mode = <0x0>;
				phandle = <0x52>;
				pwm_config = <0x0 0x0 0x0 0x0 0x0>;
			};

			led@5 {
				compatible = "mediatek,button-backlight";
				data = <0x1>;
				led_mode = <0x0>;
				phandle = <0x53>;
				pwm_config = <0x0 0x0 0x0 0x0 0x0>;
			};

			led@6 {
				compatible = "mediatek,lcd-backlight";
				data = <0x1>;
				led_mode = <0x5>;
				phandle = <0x54>;
				pwm_config = <0x1 0x0 0x0 0x0 0x0>;
			};

			tran_audio {
				compatible = "tran_audio,audio";
				fs_extamp_gpio = <0xffffffff 0x97 0x0>;
				fs_extamp_mode = <0x6>;
				fs_extamp_speech_mode = <0x6>;
				fs_receiver_mode = <0x3>;
				phandle = <0x57>;
			};

			vibrator@0 {
				compatible = "mediatek,vibrator";
				phandle = <0x55>;
				vib_limit = <0x9>;
				vib_timer = <0x19>;
				vib_vol = <0xb>;
			};
		};
	};

	fragment@40 {
		target = <0xffffffff>;

		__overlay__ {
			GPIO_FDD_BAND_SUPPORT_DETECT_1ST_PIN = <0xffffffff 0x42 0x0>;
			GPIO_FDD_BAND_SUPPORT_DETECT_2ND_PIN = <0xffffffff 0x43 0x0>;
			GPIO_FDD_BAND_SUPPORT_DETECT_3RD_PIN = <0xffffffff 0x44 0x0>;
			GPIO_SIM1_HOT_PLUG = <0xffffffff 0x2f 0x0>;
			GPIO_SIM1_SCLK = <0xffffffff 0xac 0x0>;
			GPIO_SIM1_SIO = <0xffffffff 0xae 0x0>;
			GPIO_SIM1_SRST = <0xffffffff 0xad 0x0>;
			GPIO_SIM2_SCLK = <0xffffffff 0x9d 0x0>;
			GPIO_SIM2_SIO = <0xffffffff 0x9b 0x0>;
			GPIO_SIM2_SRST = <0xffffffff 0x9c 0x0>;
		};
	};

	fragment@41 {
		target = <0xffffffff>;

		__overlay__ {
			gpio_init_default = <0x0 0x0 0x1 0x0 0x1 0x0 0x1 0x1 0x0 0x0 0x0 0x1 0x1 0x1 0x2 0x0 0x0 0x0 0x1 0x0 0x1 0x3 0x0 0x0 0x0 0x1 0x0 0x1 0x4 0x0 0x0 0x0 0x1 0x1 0x1 0x5 0x0 0x0 0x0 0x1 0x1 0x0 0x6 0x0 0x1 0x0 0x1 0x0 0x0 0x7 0x0 0x0 0x0 0x1 0x0 0x0 0x8 0x0 0x0 0x0 0x1 0x1 0x0 0x9 0x0 0x0 0x0 0x1 0x0 0x0 0xa 0x0 0x0 0x0 0x1 0x1 0x0 0xb 0x1 0x0 0x0 0x1 0x0 0x0 0xc 0x2 0x0 0x0 0x1 0x0 0x0 0xd 0x2 0x0 0x0 0x1 0x0 0x0 0xe 0x2 0x1 0x0 0x0 0x0 0x0 0xf 0x2 0x1 0x0 0x0 0x0 0x0 0x10 0x2 0x1 0x0 0x0 0x0 0x0 0x11 0x0 0x0 0x0 0x1 0x0 0x1 0x12 0x0 0x0 0x0 0x1 0x1 0x1 0x13 0x0 0x0 0x0 0x1 0x1 0x1 0x14 0x0 0x0 0x0 0x1 0x1 0x1 0x15 0x5 0x0 0x0 0x1 0x0 0x0 0x16 0x5 0x0 0x0 0x1 0x0 0x0 0x17 0x0 0x1 0x0 0x0 0x0 0x0 0x18 0x5 0x0 0x0 0x1 0x0 0x0 0x19 0x2 0x1 0x0 0x1 0x0 0x0 0x1a 0x2 0x1 0x0 0x1 0x0 0x0 0x1b 0x2 0x1 0x0 0x0 0x0 0x0 0x1c 0x2 0x0 0x0 0x0 0x0 0x0 0x1d 0x0 0x0 0x0 0x1 0x0 0x0 0x1e 0x0 0x1 0x0 0x1 0x1 0x0 0x1f 0x0 0x0 0x0 0x1 0x0 0x0 0x20 0x1 0x0 0x0 0x1 0x0 0x0 0x21 0x1 0x1 0x0 0x1 0x0 0x0 0x22 0x1 0x1 0x0 0x1 0x0 0x0 0x23 0x1 0x1 0x0 0x1 0x0 0x0 0x24 0x2 0x1 0x0 0x0 0x0 0x0 0x25 0x2 0x1 0x0 0x0 0x0 0x0 0x26 0x2 0x1 0x0 0x0 0x0 0x0 0x27 0x0 0x0 0x0 0x1 0x1 0x1 0x28 0x2 0x0 0x0 0x1 0x0 0x0 0x29 0x0 0x0 0x0 0x1 0x1 0x1 0x2a 0x0 0x0 0x0 0x1 0x1 0x1 0x2b 0x1 0x1 0x0 0x1 0x0 0x0 0x2c 0x1 0x0 0x0 0x1 0x0 0x0 0x2d 0x0 0x1 0x0 0x1 0x0 0x0 0x2e 0x0 0x0 0x0 0x1 0x0 0x0 0x2f 0x1 0x0 0x0 0x1 0x1 0x0 0x30 0x1 0x0 0x0 0x1 0x1 0x1 0x31 0x1 0x0 0x0 0x1 0x1 0x1 0x32 0x1 0x0 0x0 0x1 0x1 0x1 0x33 0x1 0x0 0x0 0x1 0x1 0x1 0x34 0x1 0x0 0x0 0x1 0x0 0x0 0x35 0x1 0x0 0x0 0x1 0x0 0x0 0x36 0x1 0x0 0x0 0x1 0x0 0x0 0x37 0x1 0x0 0x0 0x1 0x0 0x0 0x38 0x1 0x0 0x0 0x1 0x0 0x0 0x39 0x1 0x0 0x0 0x1 0x0 0x0 0x3a 0x0 0x0 0x0 0x1 0x0 0x0 0x3b 0x1 0x0 0x0 0x1 0x0 0x0 0x3c 0x1 0x0 0x0 0x1 0x0 0x0 0x3d 0x1 0x0 0x0 0x1 0x0 0x0 0x3e 0x1 0x0 0x0 0x1 0x0 0x0 0x3f 0x1 0x0 0x0 0x1 0x0 0x0 0x40 0x1 0x0 0x0 0x1 0x0 0x0 0x41 0x0 0x0 0x0 0x1 0x0 0x0 0x42 0x0 0x0 0x0 0x1 0x0 0x0 0x43 0x0 0x0 0x0 0x1 0x0 0x0 0x44 0x0 0x0 0x0 0x1 0x0 0x0 0x45 0x1 0x0 0x0 0x1 0x0 0x0 0x46 0x1 0x0 0x0 0x1 0x0 0x0 0x47 0x1 0x0 0x0 0x1 0x0 0x0 0x48 0x1 0x0 0x0 0x1 0x0 0x0 0x49 0x1 0x0 0x0 0x1 0x0 0x0 0x4a 0x1 0x0 0x0 0x1 0x0 0x0 0x4b 0x1 0x0 0x0 0x1 0x0 0x0 0x4c 0x1 0x0 0x0 0x1 0x0 0x0 0x4d 0x1 0x0 0x0 0x1 0x0 0x0 0x4e 0x1 0x0 0x0 0x1 0x0 0x0 0x4f 0x1 0x0 0x0 0x1 0x0 0x0 0x50 0x1 0x0 0x0 0x1 0x0 0x0 0x51 0x2 0x0 0x0 0x1 0x1 0x1 0x52 0x1 0x0 0x0 0x1 0x1 0x1 0x53 0x1 0x0 0x0 0x1 0x1 0x1 0x54 0x2 0x0 0x0 0x1 0x1 0x1 0x55 0x2 0x0 0x0 0x1 0x0 0x0 0x56 0x2 0x1 0x0 0x0 0x0 0x0 0x57 0x2 0x1 0x0 0x0 0x0 0x0 0x58 0x2 0x1 0x0 0x0 0x0 0x0 0x59 0x1 0x0 0x0 0x1 0x1 0x1 0x5a 0x1 0x0 0x0 0x1 0x1 0x1 0x5b 0x0 0x1 0x0 0x0 0x0 0x0 0x5c 0x1 0x1 0x0 0x0 0x0 0x0 0x5d 0x1 0x0 0x0 0x1 0x1 0x0 0x5e 0x1 0x0 0x0 0x1 0x1 0x0 0x5f 0x1 0x0 0x0 0x1 0x1 0x0 0x60 0x1 0x1 0x0 0x0 0x0 0x0 0x61 0x0 0x1 0x0 0x0 0x0 0x0 0x62 0x0 0x1 0x0 0x0 0x0 0x0 0x63 0x1 0x1 0x0 0x0 0x0 0x0 0x64 0x1 0x1 0x0 0x0 0x0 0x0 0x65 0x0 0x1 0x0 0x0 0x0 0x0 0x66 0x0 0x1 0x0 0x0 0x0 0x0 0x67 0x1 0x0 0x0 0x1 0x1 0x1 0x68 0x1 0x0 0x0 0x1 0x1 0x1 0x69 0x1 0x0 0x0 0x1 0x1 0x1 0x6a 0x1 0x0 0x0 0x1 0x1 0x1 0x6b 0x0 0x1 0x0 0x0 0x0 0x0 0x6c 0x0 0x1 0x0 0x0 0x0 0x0 0x6d 0x0 0x1 0x0 0x0 0x0 0x0 0x6e 0x0 0x1 0x0 0x0 0x0 0x0 0x6f 0x1 0x1 0x0 0x0 0x0 0x0 0x70 0x0 0x1 0x0 0x0 0x0 0x0 0x71 0x0 0x0 0x0 0x1 0x0 0x0 0x72 0x0 0x0 0x0 0x1 0x0 0x0 0x73 0x0 0x0 0x0 0x1 0x0 0x0 0x74 0x0 0x0 0x0 0x1 0x0 0x0 0x75 0x0 0x0 0x0 0x1 0x0 0x0 0x76 0x0 0x0 0x0 0x1 0x0 0x0 0x77 0x0 0x0 0x0 0x1 0x0 0x0 0x78 0x0 0x0 0x0 0x1 0x0 0x0 0x79 0x0 0x0 0x0 0x1 0x0 0x0 0x86 0x1 0x0 0x0 0x1 0x0 0x1 0x87 0x1 0x1 0x0 0x0 0x0 0x0 0x88 0x1 0x1 0x0 0x0 0x0 0x0 0x89 0x1 0x1 0x0 0x0 0x0 0x0 0x8a 0x1 0x1 0x0 0x0 0x0 0x0 0x8b 0x1 0x1 0x0 0x0 0x0 0x0 0x8c 0x1 0x0 0x0 0x1 0x0 0x0 0x8d 0x1 0x0 0x0 0x1 0x0 0x0 0x8e 0x1 0x0 0x0 0x1 0x0 0x0 0x8f 0x1 0x0 0x0 0x1 0x0 0x0 0x90 0x1 0x0 0x0 0x1 0x0 0x0 0x91 0x1 0x1 0x0 0x0 0x0 0x0 0x92 0x1 0x1 0x0 0x0 0x0 0x0 0x93 0x1 0x1 0x0 0x0 0x0 0x0 0x94 0x1 0x1 0x0 0x0 0x0 0x0 0x95 0x1 0x1 0x0 0x0 0x0 0x0 0x96 0x0 0x1 0x0 0x0 0x0 0x0 0x97 0x0 0x1 0x0 0x1 0x0 0x0 0x98 0x0 0x1 0x0 0x1 0x0 0x0 0x99 0x1 0x1 0x0 0x1 0x0 0x0 0x9a 0x1 0x1 0x0 0x0 0x0 0x0 0x9b 0x1 0x0 0x0 0x1 0x1 0x0 0x9c 0x1 0x1 0x0 0x0 0x0 0x0 0x9d 0x1 0x1 0x0 0x0 0x0 0x0 0x9e 0x0 0x1 0x0 0x0 0x0 0x0 0x9f 0x0 0x1 0x0 0x0 0x0 0x0 0xa0 0x0 0x1 0x0 0x0 0x0 0x0 0xa1 0x1 0x0 0x0 0x1 0x1 0x1 0xa2 0x1 0x0 0x0 0x1 0x1 0x1 0xa3 0x1 0x0 0x0 0x1 0x1 0x1 0xa4 0x1 0x0 0x0 0x1 0x1 0x1 0xa5 0x0 0x1 0x0 0x0 0x0 0x0 0xa6 0x0 0x1 0x0 0x0 0x0 0x0 0xa7 0x1 0x0 0x0 0x1 0x0 0x0 0xa8 0x1 0x0 0x0 0x1 0x0 0x0 0xa9 0x4 0x1 0x0 0x0 0x0 0x0 0xaa 0x1 0x0 0x0 0x1 0x1 0x1 0xab 0x1 0x1 0x0 0x0 0x0 0x1 0xac 0x1 0x1 0x0 0x0 0x0 0x0 0xad 0x1 0x1 0x0 0x0 0x0 0x0 0xae 0x1 0x0 0x0 0x1 0x1 0x0 0xaf 0x1 0x0 0x0 0x1 0x1 0x1 0xb0 0x1 0x0 0x0 0x1 0x1 0x1 0xb2 0x0 0x1 0x0 0x0 0x0 0x0 0xb3 0x0 0x1 0x0 0x0 0x0 0x0 0xb4 0x0 0x0 0x0 0x1 0x0 0x0 0xb5 0x0 0x0 0x0 0x1 0x0 0x0 0xb6 0x0 0x0 0x0 0x1 0x0 0x0 0xb7 0x0 0x0 0x0 0x1 0x0 0x0 0xb8 0x0 0x0 0x0 0x1 0x0 0x0 0xb9 0x0 0x0 0x0 0x1 0x0 0x0 0xba 0x0 0x0 0x0 0x1 0x0 0x0>;
		};
	};

	fragment@42 {
		target = <0xffffffff>;

		__overlay__ {
			interrupt-parent = <0xffffffff>;
			interrupts = <0x1 0x2 0x1 0x0>;
			status = "okay";
		};
	};

	fragment@43 {
		target = <0xffffffff>;

		__overlay__ {
			deb-gpios = <0xffffffff 0x4 0x0>;
			debounce = <0x186a0>;
			interrupt-parent = <0xffffffff>;
			interrupts = <0x4 0x4 0x4 0x0>;
			status = "okay";
		};
	};

	fragment@44 {
		target = <0xffffffff>;

		__overlay__ {
			interrupt-parent = <0xffffffff>;
			interrupts = <0x9 0x1 0x9 0x0>;
			status = "okay";
		};
	};

	fragment@45 {
		target = <0xffffffff>;

		__overlay__ {
			interrupt-parent = <0xffffffff>;
			interrupts = <0x14 0x2 0x14 0x0>;
			status = "okay";
		};
	};

	fragment@46 {
		target = <0xffffffff>;

		__overlay__ {
			interrupt-parent = <0xffffffff>;
			interrupts = <0x1d 0x4 0x1d 0x0>;
			status = "okay";
		};
	};

	fragment@47 {
		target = <0xffffffff>;

		__overlay__ {
			interrupt-parent = <0xffffffff>;
			interrupts = <0x2a 0x2 0x2a 0x0>;
			status = "okay";
		};
	};

	fragment@48 {
		target = <0xffffffff>;

		__overlay__ {
			interrupt-parent = <0xffffffff>;
			interrupts = <0x2c 0x1 0x2c 0x1>;
			status = "okay";
		};
	};

	fragment@49 {
		target = <0xffffffff>;

		__overlay__ {
			interrupt-parent = <0xffffffff>;
			interrupts = <0x90 0x4 0xb4 0x0>;
			status = "okay";
		};
	};

	fragment@5 {
		target = <0xffffffff>;

		__overlay__ {

			fingerprint@0 {
				compatible = "tran_fp";
				debounce = <0x7 0x0>;
				interrupt-parent = <0xffffffff>;
				interrupts = <0x7 0x1 0x7 0x0>;
				irq-gpio = <0x7>;
				irq-gpio-std = <0xffffffff 0x7 0x0>;
				pinctrl-0 = <0x4>;
				pinctrl-1 = <0x5>;
				pinctrl-2 = <0x6>;
				pinctrl-3 = <0x7>;
				pinctrl-4 = <0x8>;
				pinctrl-names = "tran_fp_default", "tran_fp_pin_irq", "tran_fp_irq_pull_down", "tran_fp_reset_high", "tran_fp_reset_low";
				reg = <0x0>;
				reset-gpio = <0x6>;
				reset-gpio-std = <0xffffffff 0x6 0x0>;
				spi-max-frequency = <0x19bfcc0>;
				status = "okay";
				vmch-supply = <0xffffffff>;
			};
		};
	};

	fragment@50 {
		target = <0xffffffff>;

		__overlay__ {
			compatible = "mediatek,md1_sim1_hot_plug_eint-eint";
			debounce = <0x0 0x2710>;
			dedicated = <0x0 0x0>;
			interrupts = <0x0 0x8>;
			sockettype = <0x0 0x0>;
			src_pin = <0x0 0x1>;
			status = "okay";
		};
	};

	fragment@51 {
		target = <0xffffffff>;

		__overlay__ {
			regulator-default-on = <0x1>;
			regulator-name = "vcama1";
			status = "okay";
		};
	};

	fragment@52 {
		target = <0xffffffff>;

		__overlay__ {
			regulator-default-on = <0x1>;
			regulator-name = "vcama2";
			status = "okay";
		};
	};

	fragment@53 {
		target = <0xffffffff>;

		__overlay__ {
			regulator-default-on = <0x1>;
			regulator-name = "vsim1";
			status = "okay";
		};
	};

	fragment@54 {
		target = <0xffffffff>;

		__overlay__ {
			regulator-default-on = <0x1>;
			regulator-name = "vsim2";
			status = "okay";
		};
	};

	fragment@55 {
		target = <0xffffffff>;

		__overlay__ {
			regulator-default-on = <0x1>;
			regulator-name = "vcamd";
			status = "okay";
		};
	};

	fragment@56 {
		target = <0xffffffff>;

		__overlay__ {
			regulator-default-on = <0x1>;
			regulator-name = "vcamio";
			status = "okay";
		};
	};

	fragment@57 {
		target = <0xffffffff>;

		__overlay__ {
			regulator-default-on = <0x1>;
			regulator-name = "vldo28";
			status = "okay";
		};
	};

	fragment@58 {
		target = <0xffffffff>;

		__overlay__ {
			status = "okay";
			vcama_main2-supply = <0xffffffff>;
			vcama_sub2-supply = <0xffffffff>;
			vcamaf-supply = <0xffffffff>;
			vcamd-supply = <0xffffffff>;
			vcamd_sub-supply = <0xffffffff>;
			vcamio-supply = <0xffffffff>;
			vcamio_main2-supply = <0xffffffff>;
			vcamio_sub-supply = <0xffffffff>;
		};
	};

	fragment@59 {
		target = <0xffffffff>;

		__overlay__ {
			status = "okay";
			vtouch-supply = <0xffffffff>;
		};
	};

	fragment@6 {
		target = <0xffffffff>;

		__overlay__ {

			fingerprint_default {
				phandle = <0x4>;
			};

			gpio7_eint {
				phandle = <0x5>;

				pins_cmd_dat {
					bias-disable;
					pinmux = <0x700>;
					slew-rate = <0x0>;
				};
			};

			gpio7_eint_pull_down {
				phandle = <0x6>;

				pins_cmd_dat {
					bias-pull-down = <0x0>;
					output-low;
					pinmux = <0x700>;
					slew-rate = <0x0>;
				};
			};

			rst_out_one {
				phandle = <0x7>;

				pins_cmd_dat {
					bias-disable;
					output-high;
					pinmux = <0x600>;
					slew-rate = <0x1>;
				};
			};

			rst_out_zero {
				phandle = <0x8>;

				pins_cmd_dat {
					bias-disable;
					output-low;
					pinmux = <0x600>;
					slew-rate = <0x1>;
				};
			};
		};
	};

	fragment@60 {
		target = <0xffffffff>;

		__overlay__ {
			mediatek,kpd-hw-dl-key0 = <0x0>;
			mediatek,kpd-hw-dl-key1 = <0x1>;
			mediatek,kpd-hw-dl-key2 = <0x8>;
			mediatek,kpd-hw-factory-key = <0x1>;
			mediatek,kpd-hw-init-map = <0x73 0x72 0x0 0x0 0x0 0x0 0x0 0x0 0x0 0x0 0x0 0x0 0x0 0x0 0x0 0x0 0x0 0x0 0x0 0x0 0x0 0x0 0x0 0x0 0x0 0x0 0x0 0x0 0x0 0x0 0x0 0x0 0x0 0x0 0x0 0x0 0x0 0x0 0x0 0x0 0x0 0x0 0x0 0x0 0x0 0x0 0x0 0x0 0x0 0x0 0x0 0x0 0x0 0x0 0x0 0x0 0x0 0x0 0x0 0x0 0x0 0x0 0x0 0x0 0x0 0x0 0x0 0x0 0x0 0x0 0x0 0x0>;
			mediatek,kpd-hw-map-num = <0x48>;
			mediatek,kpd-hw-pwrkey = <0x8>;
			mediatek,kpd-hw-recovery-key = <0x0>;
			mediatek,kpd-key-debounce = <0x400>;
			mediatek,kpd-pwkey-gpio-din = <0x0>;
			mediatek,kpd-pwrkey-eint-gpio = <0x0>;
			mediatek,kpd-sw-pwrkey = <0x74>;
			mediatek,kpd-use-extend-type = <0x0>;
			status = "okay";
		};
	};

	fragment@61 {
		target = <0xffffffff>;

		__overlay__ {

			camdefault {
				phandle = <0x23>;
			};

			camera0_mclk_2mA@gpio100 {
				phandle = <0x39>;

				pins_cmd_dat {
					drive-strength = <0x2>;
					pinmux = <0x6401>;
				};
			};

			camera0_mclk_4mA@gpio100 {
				phandle = <0x3a>;

				pins_cmd_dat {
					drive-strength = <0x4>;
					pinmux = <0x6401>;
				};
			};

			camera0_mclk_6mA@gpio100 {
				phandle = <0x3b>;

				pins_cmd_dat {
					drive-strength = <0x6>;
					pinmux = <0x6401>;
				};
			};

			camera0_mclk_8mA@gpio100 {
				phandle = <0x3c>;

				pins_cmd_dat {
					drive-strength = <0x7>;
					pinmux = <0x6401>;
				};
			};

			camera0_mclk_gpio_mode@gpio100 {
				phandle = <0x38>;

				pins_cmd_dat {
					drive-strength = <0x4>;
					pinmux = <0x6400>;
				};
			};

			camera0_pdn_output_high@gpio98 {
				phandle = <0x27>;

				pins_cmd_dat {
					output-high;
					pinmux = <0x6200>;
				};
			};

			camera0_pdn_output_low@gpio98 {
				phandle = <0x26>;

				pins_cmd_dat {
					output-low;
					pinmux = <0x6200>;
				};
			};

			camera0_rst_output_high@gpio102 {
				phandle = <0x25>;

				pins_cmd_dat {
					output-high;
					pinmux = <0x6600>;
				};
			};

			camera0_rst_output_low@gpio102 {
				phandle = <0x24>;

				pins_cmd_dat {
					output-low;
					pinmux = <0x6600>;
				};
			};

			camera0_vcama_output_high@gpio23 {
				phandle = <0x34>;

				pins_cmd_dat {
					output-high;
					pinmux = <0x1700>;
				};
			};

			camera0_vcama_output_low@gpio23 {
				phandle = <0x35>;

				pins_cmd_dat {
					output-low;
					pinmux = <0x1700>;
				};
			};

			camera1_mclk_2mA@gpio99 {
				phandle = <0x3e>;

				pins_cmd_dat {
					drive-strength = <0x2>;
					pinmux = <0x6301>;
				};
			};

			camera1_mclk_4mA@gpio99 {
				phandle = <0x3f>;

				pins_cmd_dat {
					drive-strength = <0x4>;
					pinmux = <0x6301>;
				};
			};

			camera1_mclk_6mA@gpio99 {
				phandle = <0x40>;

				pins_cmd_dat {
					drive-strength = <0x6>;
					pinmux = <0x6301>;
				};
			};

			camera1_mclk_8mA@gpio99 {
				phandle = <0x41>;

				pins_cmd_dat {
					drive-strength = <0x7>;
					pinmux = <0x6301>;
				};
			};

			camera1_mclk_gpio_mode@gpio99 {
				phandle = <0x3d>;

				pins_cmd_dat {
					drive-strength = <0x4>;
					pinmux = <0x6300>;
				};
			};

			camera1_pdn_output_high@gpio97 {
				phandle = <0x2b>;

				pins_cmd_dat {
					output-high;
					pinmux = <0x6100>;
				};
			};

			camera1_pdn_output_low@gpio97 {
				phandle = <0x2a>;

				pins_cmd_dat {
					output-low;
					pinmux = <0x6100>;
					slew-rate = <0x1>;
				};
			};

			camera1_rst_output_high@gpio101 {
				phandle = <0x29>;

				pins_cmd_dat {
					output-high;
					pinmux = <0x6500>;
				};
			};

			camera1_rst_output_low@gpio101 {
				phandle = <0x28>;

				pins_cmd_dat {
					output-low;
					pinmux = <0x6500>;
				};
			};

			camera1_vcama_output_high@gpio23 {
				phandle = <0x36>;

				pins_cmd_dat {
					output-high;
					pinmux = <0x1700>;
				};
			};

			camera1_vcama_output_low@gpio23 {
				phandle = <0x37>;

				pins_cmd_dat {
					output-low;
					pinmux = <0x1700>;
				};
			};

			camera2_mclk_2mA@gpio111 {
				phandle = <0x43>;

				pins_cmd_dat {
					drive-strength = <0x2>;
					pinmux = <0x6f01>;
				};
			};

			camera2_mclk_4mA@gpio111 {
				phandle = <0x44>;

				pins_cmd_dat {
					drive-strength = <0x4>;
					pinmux = <0x6f01>;
				};
			};

			camera2_mclk_6mA@gpio111 {
				phandle = <0x45>;

				pins_cmd_dat {
					drive-strength = <0x6>;
					pinmux = <0x6f01>;
				};
			};

			camera2_mclk_8mA@gpio111 {
				phandle = <0x46>;

				pins_cmd_dat {
					drive-strength = <0x7>;
					pinmux = <0x6f01>;
				};
			};

			camera2_mclk_gpio_mode@gpio111 {
				phandle = <0x42>;

				pins_cmd_dat {
					drive-strength = <0x4>;
					pinmux = <0x6f00>;
				};
			};

			camera2_pdn_output_high@gpio110 {
				phandle = <0x2f>;

				pins_cmd_dat {
					output-high;
					pinmux = <0x6e00>;
				};
			};

			camera2_pdn_output_low@gpio110 {
				phandle = <0x2e>;

				pins_cmd_dat {
					output-low;
					pinmux = <0x6e00>;
				};
			};

			camera2_rst_output_high@gpio112 {
				phandle = <0x2d>;

				pins_cmd_dat {
					output-high;
					pinmux = <0x7000>;
				};
			};

			camera2_rst_output_low@gpio112 {
				phandle = <0x2c>;

				pins_cmd_dat {
					output-low;
					pinmux = <0x7000>;
				};
			};

			camera3_mclk_2mA@gpio108 {
				phandle = <0x48>;

				pins_cmd_dat {
					drive-strength = <0x2>;
					pinmux = <0x6c01>;
				};
			};

			camera3_mclk_4mA@gpio108 {
				phandle = <0x49>;

				pins_cmd_dat {
					drive-strength = <0x4>;
					pinmux = <0x6c01>;
				};
			};

			camera3_mclk_6mA@gpio108 {
				phandle = <0x4a>;

				pins_cmd_dat {
					drive-strength = <0x6>;
					pinmux = <0x6c01>;
				};
			};

			camera3_mclk_8mA@gpio108 {
				phandle = <0x4b>;

				pins_cmd_dat {
					drive-strength = <0x7>;
					pinmux = <0x6c01>;
				};
			};

			camera3_mclk_gpio_mode@gpio108 {
				phandle = <0x47>;

				pins_cmd_dat {
					drive-strength = <0x4>;
					pinmux = <0x6c00>;
				};
			};

			camera3_pdn_output_high@gpio107 {
				phandle = <0x31>;

				pins_cmd_dat {
					output-high;
					pinmux = <0x6b00>;
				};
			};

			camera3_pdn_output_low@gpio107 {
				phandle = <0x30>;

				pins_cmd_dat {
					output-low;
					pinmux = <0x6b00>;
				};
			};

			camera3_rst_output_high@gpio107 {
				phandle = <0x33>;

				pins_cmd_dat {
					output-high;
					pinmux = <0x6b00>;
				};
			};

			camera3_rst_output_low@gpio107 {
				phandle = <0x32>;

				pins_cmd_dat {
					output-low;
					pinmux = <0x6b00>;
				};
			};
		};
	};

	fragment@62 {
		target = <0xffffffff>;

		__overlay__ {
			cam0_vcamaf-supply = <0xffffffff>;
			cam0_vcamd-supply = <0xffffffff>;
			cam0_vcamio-supply = <0xffffffff>;
			cam1_vcamd-supply = <0xffffffff>;
			cam1_vcamio-supply = <0xffffffff>;
			cam2_vcama-supply = <0xffffffff>;
			cam2_vcamio-supply = <0xffffffff>;
			cam3_vcama-supply = <0xffffffff>;
			pinctrl-0 = <0x23>;
			pinctrl-1 = <0x24>;
			pinctrl-10 = <0x2d>;
			pinctrl-11 = <0x2e>;
			pinctrl-12 = <0x2f>;
			pinctrl-13 = <0x30>;
			pinctrl-14 = <0x31>;
			pinctrl-15 = <0x32>;
			pinctrl-16 = <0x33>;
			pinctrl-17 = <0x34>;
			pinctrl-18 = <0x35>;
			pinctrl-19 = <0x36>;
			pinctrl-2 = <0x25>;
			pinctrl-20 = <0x37>;
			pinctrl-21 = <0x38>;
			pinctrl-22 = <0x39>;
			pinctrl-23 = <0x3a>;
			pinctrl-24 = <0x3b>;
			pinctrl-25 = <0x3c>;
			pinctrl-26 = <0x3d>;
			pinctrl-27 = <0x3e>;
			pinctrl-28 = <0x3f>;
			pinctrl-29 = <0x40>;
			pinctrl-3 = <0x26>;
			pinctrl-30 = <0x41>;
			pinctrl-31 = <0x42>;
			pinctrl-32 = <0x43>;
			pinctrl-33 = <0x44>;
			pinctrl-34 = <0x45>;
			pinctrl-35 = <0x46>;
			pinctrl-36 = <0x47>;
			pinctrl-37 = <0x48>;
			pinctrl-38 = <0x49>;
			pinctrl-39 = <0x4a>;
			pinctrl-4 = <0x27>;
			pinctrl-40 = <0x4b>;
			pinctrl-5 = <0x28>;
			pinctrl-6 = <0x29>;
			pinctrl-7 = <0x2a>;
			pinctrl-8 = <0x2b>;
			pinctrl-9 = <0x2c>;
			pinctrl-names = "default", "cam0_rst0", "cam0_rst1", "cam0_pnd0", "cam0_pnd1", "cam1_rst0", "cam1_rst1", "cam1_pnd0", "cam1_pnd1", "cam2_rst0", "cam2_rst1", "cam2_pnd0", "cam2_pnd1", "cam3_pnd0", "cam3_pnd1", "cam3_rst0", "cam3_rst1", "cam0_vcama_on", "cam0_vcama_off", "cam1_vcama_on", "cam1_vcama_off", "cam0_mclk_off", "cam0_mclk_2mA", "cam0_mclk_4mA", "cam0_mclk_6mA", "cam0_mclk_8mA", "cam1_mclk_off", "cam1_mclk_2mA", "cam1_mclk_4mA", "cam1_mclk_6mA", "cam1_mclk_8mA", "cam2_mclk_off", "cam2_mclk_2mA", "cam2_mclk_4mA", "cam2_mclk_6mA", "cam2_mclk_8mA", "cam3_mclk_off", "cam3_mclk_2mA", "cam3_mclk_4mA", "cam3_mclk_6mA", "cam3_mclk_8mA";
			status = "okay";
		};
	};

	fragment@63 {
		target = <0xffffffff>;

		__overlay__ {

			ocp81375default {
				phandle = <0x1>;
			};

			ocp81375hwen_high {
				phandle = <0x2>;

				pins_cmd_dat {
					output-high;
					pinmux = <0xa900>;
					slew-rate = <0x1>;
				};
			};

			ocp81375hwen_low {
				phandle = <0x3>;

				pins_cmd_dat {
					output-low;
					pinmux = <0xa900>;
					slew-rate = <0x1>;
				};
			};
		};
	};

	fragment@64 {
		target = <0xffffffff>;

		__overlay__ {
			camaf_m1_pmic-supply = <0xffffffff>;
		};
	};

	fragment@7 {
		target = <0xffffffff>;

		__overlay__ {
			clock-frequency = <0x61a80>;

			mtk-usb@60 {
				compatible = "mediatek,mtk-usb";
				reg = <0x60>;
				status = "okay";
			};
		};
	};

	fragment@8 {
		target = <0xffffffff>;

		__overlay__ {

			touch@0 {
				compatible = "novatek,NVT-ts-spi";
				novatek,mp-support-dt;
				novatek,spi-rd-fast-addr = <0x3f310>;
				novatek,swrst-n8-addr = <0x3f0fe>;
				phandle = <0x58>;
				reg = <0x0>;
				spi-max-frequency = <0x7a1200>;
				status = "okay";

				novatek-mp-criteria-6279@0 {
					#address-cells = <0x1>;
					#size-cells = <0x0>;
					AIN_KEY = <0x0 0x1 0x2 0xff>;
					AIN_X = <0x0 0x1 0x2 0x3 0x4 0x5 0x6 0x7 0x8 0x9 0xa 0xb 0xc 0xd 0xe 0xf>;
					AIN_Y = <0x0 0x1 0x2 0x3 0x4 0x5 0x6 0x7 0x8 0x9 0xa 0xb 0xc 0xd 0xe 0xf 0x10 0x11 0x12 0x13 0x14 0x15 0x16 0x17 0x18 0x19 0x1a 0x1b 0x1c 0x1d 0x1e 0x1f 0x20 0x21 0x22 0x23>;
					IC_KEY_CFG_SIZE = <0x4>;
					IC_X_CFG_SIZE = <0x10>;
					IC_Y_CFG_SIZE = <0x24>;
					PS_Config_Diff_Test_Frame = <0x32>;
					PS_Config_Lmt_FW_CC_N = <0x12 0x12 0x12 0x13 0x12 0x13 0x13 0x13 0x13 0x13 0x13 0x13 0x13 0x13 0x13 0x13 0x13 0x12 0x12 0x12 0x12 0x12 0x12 0x13 0x13 0x12 0x12 0x12 0x12 0x12 0x12 0x13 0x12 0x12 0x12 0x12 0x12 0x12 0x12 0x12 0x12 0x12 0x12 0x12 0x12 0x12 0x12 0x13 0x13 0x12 0x12 0x12 0x12 0x12 0x12 0x13 0x12 0x12 0x12 0x12 0x12 0x12 0x12 0x13 0x13 0x12 0x12 0x12 0x12 0x12 0x12 0x12 0x12 0x12 0x12 0x12 0x12 0x12 0x12 0x13 0x13 0x12 0x12 0x12 0x12 0x13 0x12 0x13 0x12 0x12 0x12 0x12 0x12 0x12 0x12 0x13 0x13 0x12 0x12 0x12 0x12 0x12 0x12 0x12 0x12 0x12 0x12 0x12 0x12 0x12 0x12 0x13 0x13 0x12 0x12 0x12 0x12 0x13 0x12 0x13 0x12 0x12 0x12 0x12 0x12 0x12 0x12 0x13 0x12 0x12 0x12 0x12 0x12 0x12 0x12 0x12 0x13 0x12 0x12 0x12 0x12 0x12 0x12 0x13 0x13 0x13 0x13 0x13 0x13 0x13 0x13 0x13 0x12 0x12 0x12 0x12 0x12 0x12 0x12 0x13 0x13 0x13 0x12 0x13 0x12 0x13 0x12 0x13 0x13 0x13 0x12 0x12 0x13 0x12 0x12 0x13 0x13 0x13 0x13 0x13 0x13 0x13 0x13 0x13 0x12 0x12 0x12 0x12 0x12 0x12 0x12 0x13 0x13 0x12 0x12 0x12 0x12 0x13 0x12 0x13 0x12 0x12 0x12 0x12 0x12 0x12 0x12 0x13 0x13 0x12 0x12 0x13 0x13 0x13 0x13 0x13 0x12 0x12 0x12 0x12 0x12 0x12 0x12 0x13 0x13 0x12 0x12 0x12 0x12 0x13 0x13 0x13 0x13 0x13 0x13 0x13 0x13 0x12 0x12 0x13 0x13 0x13 0x13 0x13 0x13 0x13 0x13 0x13 0x13 0x13 0x13 0x13 0x13 0x13 0x12 0x13 0x13 0x12 0x12 0x13 0x12 0x13 0x13 0x13 0x13 0x13 0x13 0x12 0x12 0x12 0x12 0x13 0x13 0x12 0x12 0x13 0x13 0x13 0x13 0x13 0x12 0x12 0x13 0x12 0x12 0x12 0x12 0x13 0x13 0x12 0x12 0x12 0x12 0x12 0x12 0x12 0x12 0x12 0x12 0x12 0x12 0x12 0x12 0x12 0x13 0x12 0x12 0x12 0x12 0x12 0x12 0x12 0x12 0x12 0x12 0x12 0x12 0x12 0x12 0x12 0x12 0x12 0x12 0x12 0x12 0x12 0x12 0x12 0x12 0x12 0x12 0x12 0x12 0x12 0x12 0x13 0x13 0x12 0x12 0x12 0x12 0x12 0x12 0x12 0x12 0x12 0x12 0x12 0x12 0x12 0x12 0x13 0x13 0x12 0x12 0x12 0x12 0x12 0x12 0x12 0x12 0x12 0x12 0x12 0x12 0x12 0x12 0x12 0x13 0x12 0x12 0x12 0x12 0x12 0x12 0x12 0x12 0x12 0x12 0x12 0x12 0x12 0x12 0x12 0x12 0x12 0x12 0x12 0x12 0x12 0x12 0x12 0x12 0x12 0x12 0x12 0x12 0x12 0x12 0x13 0x13 0x12 0x12 0x12 0x12 0x12 0x12 0x12 0x12 0x12 0x12 0x12 0x12 0x12 0x12 0x13 0x13 0x12 0x12 0x12 0x12 0x12 0x12 0x12 0x12 0x12 0x12 0x12 0x12 0x12 0x12 0x13 0x13 0x12 0x12 0x12 0x12 0x12 0x12 0x12 0x12 0x12 0x12 0x12 0x12 0x12 0x12 0x12 0x12 0x12 0x12 0x12 0x12 0x12 0x12 0x12 0x12 0x12 0x12 0x12 0x12 0x12 0x12 0x13 0x13 0x12 0x12 0x12 0x12 0x12 0x12 0x12 0x12 0x12 0x12 0x12 0x12 0x12 0x12 0x12 0x12 0x12 0x12 0x12 0x12 0x12 0x12 0x12 0x12 0x12 0x12 0x12 0x12 0x12 0x12 0x13 0x13 0x12 0x12 0x12 0x12 0x12 0x12 0x12 0x12 0x12 0x12 0x12 0x12 0x12 0x12 0x12 0x12 0x12 0x12 0x12 0x12 0x12 0x12 0x12 0x12 0x12 0x12 0x12 0x12 0x12 0x12 0x13 0x13 0x12 0x12 0x12 0x12 0x12 0x12 0x12 0x12 0x12 0x12 0x12 0x12 0x12 0x12 0x13 0x12 0x12 0x12 0x12 0x12 0x12 0x12 0x12 0x12 0x12 0x12 0x12 0x12 0x12 0x12 0x13 0x13 0x13 0x13 0x13 0x13 0x13 0x13 0x13 0x13 0x12 0x12 0x12 0x12 0x12 0x12 0x13 0x0 0x0 0x0>;
					PS_Config_Lmt_FW_CC_P = <0x29 0x29 0x29 0x2a 0x29 0x2a 0x2a 0x2a 0x2a 0x2a 0x2a 0x2a 0x2a 0x2a 0x2a 0x2a 0x2a 0x29 0x29 0x29 0x29 0x29 0x29 0x2a 0x2a 0x29 0x29 0x29 0x29 0x29 0x29 0x2a 0x29 0x29 0x29 0x29 0x29 0x29 0x29 0x29 0x29 0x29 0x29 0x29 0x29 0x29 0x29 0x2a 0x2a 0x29 0x29 0x29 0x29 0x29 0x29 0x2a 0x29 0x29 0x29 0x29 0x29 0x29 0x29 0x2a 0x2a 0x29 0x29 0x29 0x29 0x29 0x29 0x29 0x29 0x29 0x29 0x29 0x29 0x29 0x29 0x2a 0x2a 0x29 0x29 0x29 0x29 0x2a 0x29 0x2a 0x29 0x29 0x29 0x29 0x29 0x29 0x29 0x2a 0x2a 0x29 0x29 0x29 0x29 0x29 0x29 0x29 0x29 0x29 0x29 0x29 0x29 0x29 0x29 0x2a 0x2a 0x29 0x29 0x29 0x29 0x2a 0x29 0x2a 0x29 0x29 0x29 0x29 0x29 0x29 0x29 0x2a 0x29 0x29 0x29 0x29 0x29 0x29 0x29 0x29 0x2a 0x29 0x29 0x29 0x29 0x29 0x29 0x2a 0x2a 0x2a 0x2a 0x2a 0x2a 0x2a 0x2a 0x2a 0x29 0x29 0x29 0x29 0x29 0x29 0x29 0x2a 0x2a 0x2a 0x29 0x2a 0x29 0x2a 0x29 0x2a 0x2a 0x2a 0x29 0x29 0x2a 0x29 0x29 0x2a 0x2a 0x2a 0x2a 0x2a 0x2a 0x2a 0x2a 0x2a 0x29 0x29 0x29 0x29 0x29 0x29 0x29 0x2a 0x2a 0x29 0x29 0x29 0x29 0x2a 0x29 0x2a 0x29 0x29 0x29 0x29 0x29 0x29 0x29 0x2a 0x2a 0x29 0x29 0x2a 0x2a 0x2a 0x2a 0x2a 0x29 0x29 0x29 0x29 0x29 0x29 0x29 0x2a 0x2a 0x29 0x29 0x29 0x29 0x2a 0x2a 0x2a 0x2a 0x2a 0x2a 0x2a 0x2a 0x29 0x29 0x2a 0x2a 0x2a 0x2a 0x2a 0x2a 0x2a 0x2a 0x2c 0x2a 0x2a 0x2a 0x2a 0x2a 0x2a 0x29 0x2a 0x2a 0x29 0x29 0x2a 0x29 0x2a 0x2a 0x2a 0x2a 0x2a 0x2a 0x29 0x29 0x29 0x29 0x2a 0x2a 0x29 0x29 0x2a 0x2a 0x2a 0x2a 0x2c 0x29 0x29 0x2a 0x29 0x29 0x29 0x29 0x2a 0x2a 0x29 0x29 0x29 0x29 0x29 0x29 0x29 0x29 0x29 0x29 0x29 0x29 0x29 0x29 0x29 0x2a 0x29 0x29 0x29 0x29 0x29 0x29 0x29 0x29 0x29 0x29 0x29 0x29 0x29 0x29 0x29 0x29 0x29 0x29 0x29 0x29 0x29 0x29 0x29 0x29 0x29 0x29 0x29 0x29 0x29 0x29 0x2a 0x2a 0x29 0x29 0x29 0x29 0x29 0x29 0x29 0x29 0x29 0x29 0x29 0x29 0x29 0x29 0x2a 0x2a 0x29 0x29 0x29 0x29 0x29 0x29 0x29 0x29 0x29 0x29 0x29 0x29 0x29 0x29 0x29 0x2a 0x29 0x29 0x29 0x29 0x29 0x29 0x29 0x29 0x29 0x29 0x29 0x29 0x29 0x29 0x29 0x29 0x29 0x29 0x29 0x29 0x29 0x29 0x29 0x29 0x29 0x29 0x29 0x29 0x29 0x29 0x2a 0x2a 0x29 0x29 0x29 0x29 0x29 0x29 0x29 0x29 0x29 0x29 0x29 0x29 0x29 0x29 0x2a 0x2a 0x29 0x29 0x29 0x29 0x29 0x29 0x29 0x29 0x29 0x29 0x29 0x29 0x29 0x29 0x2a 0x2a 0x29 0x29 0x29 0x29 0x29 0x29 0x29 0x29 0x29 0x29 0x29 0x29 0x29 0x29 0x29 0x29 0x29 0x29 0x29 0x29 0x29 0x29 0x29 0x29 0x29 0x29 0x29 0x29 0x29 0x29 0x2a 0x2a 0x29 0x29 0x29 0x29 0x29 0x29 0x29 0x29 0x29 0x29 0x29 0x29 0x29 0x29 0x29 0x29 0x29 0x29 0x29 0x29 0x29 0x29 0x29 0x29 0x29 0x29 0x29 0x29 0x29 0x29 0x2a 0x2a 0x29 0x29 0x29 0x29 0x29 0x29 0x29 0x29 0x29 0x29 0x29 0x29 0x29 0x29 0x29 0x29 0x29 0x29 0x29 0x29 0x29 0x29 0x29 0x29 0x29 0x29 0x29 0x29 0x29 0x29 0x2a 0x2a 0x29 0x29 0x29 0x29 0x29 0x29 0x29 0x29 0x29 0x29 0x29 0x29 0x29 0x29 0x2a 0x29 0x29 0x29 0x29 0x29 0x29 0x29 0x29 0x29 0x29 0x29 0x29 0x29 0x29 0x29 0x2a 0x2a 0x2a 0x2a 0x2a 0x2a 0x2a 0x2a 0x2a 0x2a 0x29 0x29 0x29 0x29 0x29 0x29 0x2a 0x13a 0x13a 0x13a>;
					PS_Config_Lmt_FW_Diff_N = <0xffffffce 0xffffffce 0xffffffce 0xffffffce 0xffffffce 0xffffffce 0xffffffce 0xffffffce 0xffffffce 0xffffffce 0xffffffce 0xffffffce 0xffffffce 0xffffffce 0xffffffce 0xffffffce 0xffffffce 0xffffffce 0xffffffce 0xffffffce 0xffffffce 0xffffffce 0xffffffce 0xffffffce 0xffffffce 0xffffffce 0xffffffce 0xffffffce 0xffffffce 0xffffffce 0xffffffce 0xffffffce 0xffffffce 0xffffffce 0xffffffce 0xffffffce 0xffffffce 0xffffffce 0xffffffce 0xffffffce 0xffffffce 0xffffffce 0xffffffce 0xffffffce 0xffffffce 0xffffffce 0xffffffce 0xffffffce 0xffffffce 0xffffffce 0xffffffce 0xffffffce 0xffffffce 0xffffffce 0xffffffce 0xffffffce 0xffffffce 0xffffffce 0xffffffce 0xffffffce 0xffffffce 0xffffffce 0xffffffce 0xffffffce 0xffffffce 0xffffffce 0xffffffce 0xffffffce 0xffffffce 0xffffffce 0xffffffce 0xffffffce 0xffffffce 0xffffffce 0xffffffce 0xffffffce 0xffffffce 0xffffffce 0xffffffce 0xffffffce 0xffffffce 0xffffffce 0xffffffce 0xffffffce 0xffffffce 0xffffffce 0xffffffce 0xffffffce 0xffffffce 0xffffffce 0xffffffce 0xffffffce 0xffffffce 0xffffffce 0xffffffce 0xffffffce 0xffffffce 0xffffffce 0xffffffce 0xffffffce 0xffffffce 0xffffffce 0xffffffce 0xffffffce 0xffffffce 0xffffffce 0xffffffce 0xffffffce 0xffffffce 0xffffffce 0xffffffce 0xffffffce 0xffffffce 0xffffffce 0xffffffce 0xffffffce 0xffffffce 0xffffffce 0xffffffce 0xffffffce 0xffffffce 0xffffffce 0xffffffce 0xffffffce 0xffffffce 0xffffffce 0xffffffce 0xffffffce 0xffffffce 0xffffffce 0xffffffce 0xffffffce 0xffffffce 0xffffffce 0xffffffce 0xffffffce 0xffffffce 0xffffffce 0xffffffce 0xffffffce 0xffffffce 0xffffffce 0xffffffce 0xffffffce 0xffffffce 0xffffffce 0xffffffce 0xffffffce 0xffffffce 0xffffffce 0xffffffce 0xffffffce 0xffffffce 0xffffffce 0xffffffce 0xffffffce 0xffffffce 0xffffffce 0xffffffce 0xffffffce 0xffffffce 0xffffffce 0xffffffce 0xffffffce 0xffffffce 0xffffffce 0xffffffce 0xffffffce 0xffffffce 0xffffffce 0xffffffce 0xffffffce 0xffffffce 0xffffffce 0xffffffce 0xffffffce 0xffffffce 0xffffffce 0xffffffce 0xffffffce 0xffffffce 0xffffffce 0xffffffce 0xffffffce 0xffffffce 0xffffffce 0xffffffce 0xffffffce 0xffffffce 0xffffffce 0xffffffce 0xffffffce 0xffffffce 0xffffffce 0xffffffce 0xffffffce 0xffffffce 0xffffffce 0xffffffce 0xffffffce 0xffffffce 0xffffffce 0xffffffce 0xffffffce 0xffffffce 0xffffffce 0xffffffce 0xffffffce 0xffffffce 0xffffffce 0xffffffce 0xffffffce 0xffffffce 0xffffffce 0xffffffce 0xffffffce 0xffffffce 0xffffffce 0xffffffce 0xffffffce 0xffffffce 0xffffffce 0xffffffce 0xffffffce 0xffffffce 0xffffffce 0xffffffce 0xffffffce 0xffffffce 0xffffffce 0xffffffce 0xffffffce 0xffffffce 0xffffffce 0xffffffce 0xffffffce 0xffffffce 0xffffffce 0xffffffce 0xffffffce 0xffffffce 0xffffffce 0xffffffce 0xffffffce 0xffffffce 0xffffffce 0xffffffce 0xffffffce 0xffffffce 0xffffffce 0xffffffce 0xffffffce 0xffffffce 0xffffffce 0xffffffce 0xffffffce 0xffffffce 0xffffffce 0xffffffce 0xffffffce 0xffffffce 0xffffffce 0xffffffce 0xffffffce 0xffffffce 0xffffffce 0xffffffce 0xffffffce 0xffffffce 0xffffffce 0xffffffce 0xffffffce 0xffffffce 0xffffffce 0xffffffce 0xffffffce 0xffffffce 0xffffffce 0xffffffce 0xffffffce 0xffffffce 0xffffffce 0xffffffce 0xffffffce 0xffffffce 0xffffffce 0xffffffce 0xffffffce 0xffffffce 0xffffffce 0xffffffce 0xffffffce 0xffffffce 0xffffffce 0xffffffce 0xffffffce 0xffffffce 0xffffffce 0xffffffce 0xffffffce 0xffffffce 0xffffffce 0xffffffce 0xffffffce 0xffffffce 0xffffffce 0xffffffce 0xffffffce 0xffffffce 0xffffffce 0xffffffce 0xffffffce 0xffffffce 0xffffffce 0xffffffce 0xffffffce 0xffffffce 0xffffffce 0xffffffce 0xffffffce 0xffffffce 0xffffffce 0xffffffce 0xffffffce 0xffffffce 0xffffffce 0xffffffce 0xffffffce 0xffffffce 0xffffffce 0xffffffce 0xffffffce 0xffffffce 0xffffffce 0xffffffce 0xffffffce 0xffffffce 0xffffffce 0xffffffce 0xffffffce 0xffffffce 0xffffffce 0xffffffce 0xffffffce 0xffffffce 0xffffffce 0xffffffce 0xffffffce 0xffffffce 0xffffffce 0xffffffce 0xffffffce 0xffffffce 0xffffffce 0xffffffce 0xffffffce 0xffffffce 0xffffffce 0xffffffce 0xffffffce 0xffffffce 0xffffffce 0xffffffce 0xffffffce 0xffffffce 0xffffffce 0xffffffce 0xffffffce 0xffffffce 0xffffffce 0xffffffce 0xffffffce 0xffffffce 0xffffffce 0xffffffce 0xffffffce 0xffffffce 0xffffffce 0xffffffce 0xffffffce 0xffffffce 0xffffffce 0xffffffce 0xffffffce 0xffffffce 0xffffffce 0xffffffce 0xffffffce 0xffffffce 0xffffffce 0xffffffce 0xffffffce 0xffffffce 0xffffffce 0xffffffce 0xffffffce 0xffffffce 0xffffffce 0xffffffce 0xffffffce 0xffffffce 0xffffffce 0xffffffce 0xffffffce 0xffffffce 0xffffffce 0xffffffce 0xffffffce 0xffffffce 0xffffffce 0xffffffce 0xffffffce 0xffffffce 0xffffffce 0xffffffce 0xffffffce 0xffffffce 0xffffffce 0xffffffce 0xffffffce 0xffffffce 0xffffffce 0xffffffce 0xffffffce 0xffffffce 0xffffffce 0xffffffce 0xffffffce 0xffffffce 0xffffffce 0xffffffce 0xffffffce 0xffffffce 0xffffffce 0xffffffce 0xffffffce 0xffffffce 0xffffffce 0xffffffce 0xffffffce 0xffffffce 0xffffffce 0xffffffce 0xffffffce 0xffffffce 0xffffffce 0xffffffce 0xffffffce 0xffffffce 0xffffffce 0xffffffce 0xffffffce 0xffffffce 0xffffffce 0xffffffce 0xffffffce 0xffffffce 0xffffffce 0xffffffce 0xffffffce 0xffffffce 0xffffffce 0xffffffce 0xffffffce 0xffffffce 0xffffffce 0xffffffce 0xffffffce 0xffffffce 0xffffffce 0xffffffce 0xffffffce 0xffffffce 0xffffffce 0xffffffce 0xffffffce 0xffffffce 0xffffffce 0xffffffce 0xffffffce 0xffffffce 0xffffffce 0xffffffce 0xffffffce 0xffffffce 0xffffffce 0xffffffce 0xffffffce 0xffffffce 0xffffffce 0xffffffce 0xffffffce 0xffffffce 0xffffffce 0xffffffce 0xffffffce 0xffffffce 0xffffffce 0xffffffce 0xffffffce 0xffffffce 0xffffffce 0xffffffce 0xffffffce 0xffffffce 0xffffffce 0xffffffce 0xffffffce 0xffffffce 0xffffffce 0xffffffce 0xffffffce 0xffffffce 0xffffffce 0xffffffce 0xffffffce 0xffffffce 0xffffffce 0xffffffce 0xffffffce 0xffffffce 0xffffffce 0xffffffce 0xffffffce 0xffffffce 0xffffffce 0xffffffce 0xffffffce 0xffffffce 0xffffffce 0xffffffce 0xffffffce 0xffffffce 0xffffffce 0xffffffce 0xffffffce 0xffffffce 0xffffffce 0xffffffce 0xffffffce 0xffffffce 0xffffffce 0xffffffce 0xffffffce 0xffffffce 0xffffffce 0xffffffce 0xffffffce 0xffffffce 0xffffffce 0xffffffce 0xffffffce 0xffffffce 0xffffffce 0xffffffce 0xffffffce 0xffffffce 0xffffffce 0xffffffce 0xffffffce 0xffffffce 0xffffffce 0xffffffce 0xffffffce 0xffffffce 0xffffffce 0xffffffce 0xffffffce 0xffffffce 0xffffffce 0xffffffce 0xffffffce 0xffffffce 0xffffffce 0xffffffce 0xffffffce 0xffffffb5 0xffffffb5 0xffffffb5>;
					PS_Config_Lmt_FW_Diff_P = <0x32 0x32 0x32 0x32 0x32 0x32 0x32 0x32 0x32 0x32 0x32 0x32 0x32 0x32 0x32 0x32 0x32 0x32 0x32 0x32 0x32 0x32 0x32 0x32 0x32 0x32 0x32 0x32 0x32 0x32 0x32 0x32 0x32 0x32 0x32 0x32 0x32 0x32 0x32 0x32 0x32 0x32 0x32 0x32 0x32 0x32 0x32 0x32 0x32 0x32 0x32 0x32 0x32 0x32 0x32 0x32 0x32 0x32 0x32 0x32 0x32 0x32 0x32 0x32 0x32 0x32 0x32 0x32 0x32 0x32 0x32 0x32 0x32 0x32 0x32 0x32 0x32 0x32 0x32 0x32 0x32 0x32 0x32 0x32 0x32 0x32 0x32 0x32 0x32 0x32 0x32 0x32 0x32 0x32 0x32 0x32 0x32 0x32 0x32 0x32 0x32 0x32 0x32 0x32 0x32 0x32 0x32 0x32 0x32 0x32 0x32 0x32 0x32 0x32 0x32 0x32 0x32 0x32 0x32 0x32 0x32 0x32 0x32 0x32 0x32 0x32 0x32 0x32 0x32 0x32 0x32 0x32 0x32 0x32 0x32 0x32 0x32 0x32 0x32 0x32 0x32 0x32 0x32 0x32 0x32 0x32 0x32 0x32 0x32 0x32 0x32 0x32 0x32 0x32 0x32 0x32 0x32 0x32 0x32 0x32 0x32 0x32 0x32 0x32 0x32 0x32 0x32 0x32 0x32 0x32 0x32 0x32 0x32 0x32 0x32 0x32 0x32 0x32 0x32 0x32 0x32 0x32 0x32 0x32 0x32 0x32 0x32 0x32 0x32 0x32 0x32 0x32 0x32 0x32 0x32 0x32 0x32 0x32 0x32 0x32 0x32 0x32 0x32 0x32 0x32 0x32 0x32 0x32 0x32 0x32 0x32 0x32 0x32 0x32 0x32 0x32 0x32 0x32 0x32 0x32 0x32 0x32 0x32 0x32 0x32 0x32 0x32 0x32 0x32 0x32 0x32 0x32 0x32 0x32 0x32 0x32 0x32 0x32 0x32 0x32 0x32 0x32 0x32 0x32 0x32 0x32 0x32 0x32 0x32 0x32 0x32 0x32 0x32 0x32 0x32 0x32 0x32 0x32 0x32 0x32 0x32 0x32 0x32 0x32 0x32 0x32 0x32 0x32 0x32 0x32 0x32 0x32 0x32 0x32 0x32 0x32 0x32 0x32 0x32 0x32 0x32 0x32 0x32 0x32 0x32 0x32 0x32 0x32 0x32 0x32 0x32 0x32 0x32 0x32 0x32 0x32 0x32 0x32 0x32 0x32 0x32 0x32 0x32 0x32 0x32 0x32 0x32 0x32 0x32 0x32 0x32 0x32 0x32 0x32 0x32 0x32 0x32 0x32 0x32 0x32 0x32 0x32 0x32 0x32 0x32 0x32 0x32 0x32 0x32 0x32 0x32 0x32 0x32 0x32 0x32 0x32 0x32 0x32 0x32 0x32 0x32 0x32 0x32 0x32 0x32 0x32 0x32 0x32 0x32 0x32 0x32 0x32 0x32 0x32 0x32 0x32 0x32 0x32 0x32 0x32 0x32 0x32 0x32 0x32 0x32 0x32 0x32 0x32 0x32 0x32 0x32 0x32 0x32 0x32 0x32 0x32 0x32 0x32 0x32 0x32 0x32 0x32 0x32 0x32 0x32 0x32 0x32 0x32 0x32 0x32 0x32 0x32 0x32 0x32 0x32 0x32 0x32 0x32 0x32 0x32 0x32 0x32 0x32 0x32 0x32 0x32 0x32 0x32 0x32 0x32 0x32 0x32 0x32 0x32 0x32 0x32 0x32 0x32 0x32 0x32 0x32 0x32 0x32 0x32 0x32 0x32 0x32 0x32 0x32 0x32 0x32 0x32 0x32 0x32 0x32 0x32 0x32 0x32 0x32 0x32 0x32 0x32 0x32 0x32 0x32 0x32 0x32 0x32 0x32 0x32 0x32 0x32 0x32 0x32 0x32 0x32 0x32 0x32 0x32 0x32 0x32 0x32 0x32 0x32 0x32 0x32 0x32 0x32 0x32 0x32 0x32 0x32 0x32 0x32 0x32 0x32 0x32 0x32 0x32 0x32 0x32 0x32 0x32 0x32 0x32 0x32 0x32 0x32 0x32 0x32 0x32 0x32 0x32 0x32 0x32 0x32 0x32 0x32 0x32 0x32 0x32 0x32 0x32 0x32 0x32 0x32 0x32 0x32 0x32 0x32 0x32 0x32 0x32 0x32 0x32 0x32 0x32 0x32 0x32 0x32 0x32 0x32 0x32 0x32 0x32 0x32 0x32 0x32 0x32 0x32 0x32 0x32 0x32 0x32 0x32 0x32 0x32 0x32 0x32 0x32 0x32 0x32 0x32 0x32 0x32 0x32 0x32 0x32 0x32 0x32 0x32 0x32 0x32 0x32 0x32 0x32 0x32 0x32 0x32 0x32 0x32 0x32 0x32 0x32 0x32 0x32 0x32 0x32 0x32 0x32 0x32 0x32 0x32 0x32 0x32 0x32 0x4b 0x4b 0x4b>;
					PS_Config_Lmt_FW_Rawdata_N = <0x1e0 0x1d8 0x1db 0x1da 0x1d9 0x1db 0x1da 0x1de 0x1e2 0x1e3 0x1e2 0x1dc 0x1e2 0x1e0 0x1e0 0x1dc 0x1de 0x1e7 0x1e6 0x1e0 0x1e1 0x1e3 0x1e6 0x1db 0x1d8 0x1db 0x1de 0x1dc 0x1db 0x1e0 0x1e0 0x1da 0x1e1 0x1d6 0x1d5 0x1d9 0x1d9 0x1d8 0x1d6 0x1db 0x1dd 0x1d8 0x1db 0x1e1 0x1db 0x1dd 0x1de 0x1d7 0x1dd 0x1e3 0x1e1 0x1da 0x1e6 0x1dd 0x1e0 0x1dd 0x1e2 0x1e1 0x1e0 0x1e0 0x1e0 0x1de 0x1dd 0x1e2 0x1e1 0x1db 0x1d8 0x1d9 0x1dc 0x1da 0x1d9 0x1da 0x1dd 0x1db 0x1e0 0x1dc 0x1dd 0x1df 0x1dd 0x1da 0x1dc 0x1e4 0x1dd 0x1dd 0x1df 0x1da 0x1db 0x1de 0x1dd 0x1db 0x1dd 0x1da 0x1dd 0x1dc 0x1db 0x1dd 0x1e2 0x1d0 0x1d5 0x1ce 0x1dc 0x1ce 0x1d7 0x1d1 0x1e3 0x1dd 0x1dc 0x1dd 0x1dd 0x1df 0x1df 0x1da 0x1e0 0x1dc 0x1da 0x1d9 0x1dd 0x1d8 0x1db 0x1e2 0x1e7 0x1e0 0x1df 0x1dc 0x1e0 0x1da 0x1e0 0x1dd 0x1dd 0x1dd 0x1dd 0x1de 0x1e0 0x1d9 0x1de 0x1da 0x1da 0x1dc 0x1e4 0x1e8 0x1e4 0x1e6 0x1e4 0x1d5 0x1dd 0x1d8 0x1d4 0x1d4 0x1d5 0x1d4 0x1d8 0x1e1 0x1e0 0x1df 0x1da 0x1d8 0x1da 0x1d8 0x1d9 0x1dc 0x1e4 0x1e0 0x1d9 0x1e0 0x1da 0x1e3 0x1dd 0x1e7 0x1e0 0x1de 0x1dc 0x1de 0x1da 0x1db 0x1da 0x1de 0x1e2 0x1db 0x1db 0x1de 0x1d7 0x1e3 0x1da 0x1e2 0x1e4 0x1e4 0x1e1 0x1e2 0x1e3 0x1de 0x1e0 0x1db 0x1e9 0x1da 0x1d9 0x1e1 0x1db 0x1e4 0x1df 0x1e7 0x1e1 0x1db 0x1da 0x1d8 0x1da 0x1dc 0x1db 0x1de 0x1d8 0x1e4 0x1e0 0x1d8 0x1db 0x1d5 0x1d8 0x1e0 0x1e3 0x1e5 0x1e7 0x1e1 0x1e3 0x1de 0x1e0 0x1dc 0x1da 0x1d6 0x1dc 0x1dc 0x1dd 0x1db 0x1db 0x1e0 0x1de 0x1dd 0x1db 0x1de 0x1dd 0x1dd 0x1dd 0x1dd 0x1e1 0x1da 0x1df 0x1e3 0x1e0 0x1dd 0x1e1 0x1e6 0x1de 0x1dd 0x1d9 0x1db 0x1df 0x1e0 0x1e1 0x1de 0x1dd 0x1de 0x1e1 0x1dd 0x1dd 0x1da 0x1d7 0x1dd 0x1d7 0x1d9 0x1d9 0x1d4 0x1d7 0x1d7 0x1d7 0x1dd 0x1e3 0x1db 0x1db 0x1e2 0x1e4 0x1e0 0x1e0 0x1e4 0x1e3 0x1d9 0x1d8 0x1e1 0x1e7 0x1e8 0x1e7 0x1e5 0x1db 0x1e0 0x1db 0x1da 0x1d9 0x1e3 0x1dd 0x1db 0x1df 0x1db 0x1dd 0x1e0 0x1db 0x1e3 0x1e2 0x1df 0x1e0 0x1db 0x1e5 0x1e1 0x1f0 0x1d9 0x1e0 0x1e0 0x1e1 0x1da 0x1d6 0x1dd 0x1da 0x1de 0x1dd 0x1df 0x1df 0x1df 0x1e3 0x1de 0x1e0 0x1e3 0x1e1 0x1e0 0x1dd 0x1e4 0x1e9 0x1e0 0x1e6 0x1e4 0x1e4 0x1e0 0x1e4 0x1e3 0x1e2 0x1e5 0x1e5 0x1e3 0x1e0 0x1e3 0x1d3 0x1e3 0x1e3 0x1e4 0x1e6 0x1e6 0x1e7 0x1d5 0x1d7 0x1e1 0x1eb 0x1e6 0x1e9 0x1ea 0x1e8 0x1e3 0x1dd 0x1e1 0x1dd 0x1db 0x1dd 0x1df 0x1e0 0x1e1 0x1de 0x1e1 0x1e3 0x1db 0x1e1 0x1e2 0x1e1 0x1e1 0x1da 0x1e7 0x1ea 0x1e4 0x1ea 0x1ea 0x1eb 0x1d8 0x1d5 0x1ea 0x1ec 0x1ee 0x1e6 0x1e6 0x1eb 0x1ee 0x1db 0x1e2 0x1e6 0x1e5 0x1e3 0x1e0 0x1e0 0x1db 0x1de 0x1da 0x1d7 0x1d9 0x1d5 0x1d7 0x1d6 0x1dd 0x1e1 0x1da 0x1db 0x1e2 0x1dd 0x1dd 0x1dc 0x1e2 0x1dc 0x1db 0x1dc 0x1dc 0x1e3 0x1e6 0x1dd 0x1dd 0x1e6 0x1e4 0x1e7 0x1e3 0x1e6 0x1e7 0x1e4 0x1d7 0x1da 0x1dd 0x1de 0x1df 0x1dc 0x1dd 0x1dd 0x1e3 0x1e2 0x1e0 0x1de 0x1e6 0x1dc 0x1d8 0x1da 0x1db 0x1db 0x1e0 0x1e6 0x1e2 0x1e4 0x1e3 0x1e2 0x1e3 0x1e3 0x1e2 0x1e4 0x1e3 0x1e7 0x1e6 0x1dd 0x1dd 0x1db 0x1de 0x1df 0x1de 0x1db 0x1df 0x1de 0x1df 0x1dd 0x1de 0x1e1 0x1e0 0x1dd 0x1de 0x1d8 0x1e0 0x1e0 0x1d7 0x1d6 0x1e6 0x1e5 0x1e7 0x1e4 0x1e0 0x1e2 0x1e3 0x1de 0x1df 0x1e3 0x1e0 0x1e1 0x1dc 0x1e4 0x1db 0x1dd 0x1e0 0x1e1 0x1e5 0x1e6 0x1e4 0x1e2 0x1e3 0x1e3 0x1e0 0x1e6 0x1e6 0x1e4 0x1dc 0x1e1 0x1da 0x1da 0x1d8 0x1d8 0x1d8 0x1da 0x1da 0x1e4 0x1e2 0x1e0 0x1e3 0x1e3 0x1e3 0x1e1 0x1da 0x1e0 0x1dd 0x1d7 0x1dc 0x1db 0x1da 0x1db 0x1dc 0x1db 0x1e1 0x1e0 0x1dd 0x1df 0x1df 0x1e1 0x1d7 0x1e2 0x1e0 0x1df 0x1e3 0x1e0 0x1e2 0x1e4 0x1e3 0x1df 0x1df 0x1dd 0x1de 0x1e0 0x1e0 0x1e0 0x1da 0x1d4 0x1d8 0x1d7 0x1d7 0x1db 0x1dd 0x1db 0x1e4 0x1e4 0x1dc 0x1da 0x1da 0x1da 0x1db 0x1dc 0x1db 0xf0 0xf0 0xf0>;
					PS_Config_Lmt_FW_Rawdata_P = <0x460 0x44d 0x454 0x453 0x450 0x456 0x452 0x45b 0x465 0x467 0x465 0x457 0x465 0x460 0x460 0x457 0x45b 0x472 0x46e 0x460 0x464 0x468 0x46f 0x456 0x44f 0x454 0x45b 0x457 0x454 0x460 0x461 0x453 0x464 0x449 0x448 0x450 0x450 0x44d 0x449 0x454 0x45a 0x44f 0x454 0x464 0x454 0x459 0x45d 0x44b 0x45a 0x468 0x464 0x452 0x46e 0x459 0x461 0x45a 0x465 0x464 0x461 0x461 0x460 0x45d 0x459 0x465 0x464 0x456 0x44d 0x450 0x457 0x452 0x450 0x453 0x45a 0x454 0x460 0x457 0x459 0x45e 0x459 0x453 0x457 0x469 0x45a 0x459 0x45e 0x453 0x454 0x45d 0x45a 0x456 0x459 0x453 0x45a 0x457 0x456 0x459 0x465 0x43b 0x448 0x437 0x457 0x437 0x44c 0x43e 0x467 0x459 0x457 0x45a 0x459 0x45e 0x45e 0x453 0x460 0x457 0x453 0x450 0x459 0x44f 0x454 0x465 0x470 0x460 0x45e 0x457 0x460 0x452 0x461 0x459 0x45a 0x45a 0x459 0x45d 0x460 0x450 0x45b 0x453 0x453 0x457 0x469 0x473 0x46b 0x46e 0x46b 0x446 0x459 0x44f 0x445 0x444 0x446 0x445 0x44d 0x462 0x461 0x45e 0x453 0x44d 0x452 0x44d 0x450 0x457 0x469 0x461 0x450 0x460 0x452 0x467 0x459 0x472 0x460 0x45d 0x457 0x45d 0x453 0x456 0x453 0x45b 0x465 0x456 0x456 0x45b 0x44c 0x468 0x453 0x465 0x469 0x469 0x464 0x465 0x468 0x45d 0x460 0x456 0x475 0x453 0x450 0x462 0x456 0x469 0x45e 0x470 0x462 0x454 0x453 0x44d 0x453 0x457 0x456 0x45d 0x44f 0x46b 0x460 0x44d 0x456 0x448 0x44f 0x460 0x467 0x46c 0x470 0x464 0x467 0x45d 0x461 0x457 0x453 0x449 0x457 0x457 0x45a 0x456 0x454 0x460 0x45d 0x45a 0x456 0x45d 0x45a 0x459 0x45a 0x459 0x462 0x453 0x45e 0x468 0x461 0x45a 0x462 0x46f 0x45b 0x45a 0x450 0x456 0x45e 0x460 0x464 0x45b 0x459 0x45d 0x464 0x459 0x459 0x453 0x44b 0x459 0x44b 0x450 0x450 0x445 0x44b 0x44b 0x44b 0x459 0x467 0x454 0x456 0x465 0x46b 0x461 0x460 0x46b 0x468 0x450 0x44d 0x464 0x470 0x473 0x470 0x46c 0x456 0x460 0x454 0x452 0x450 0x468 0x459 0x456 0x45e 0x454 0x459 0x460 0x454 0x468 0x465 0x45e 0x460 0x454 0x46c 0x464 0x485 0x450 0x460 0x461 0x462 0x453 0x449 0x459 0x453 0x45d 0x459 0x45e 0x45e 0x45e 0x468 0x45b 0x461 0x468 0x464 0x460 0x459 0x46b 0x475 0x460 0x46f 0x46b 0x46b 0x460 0x46b 0x467 0x465 0x46c 0x46c 0x467 0x461 0x468 0x442 0x468 0x468 0x46b 0x46f 0x46f 0x470 0x446 0x44b 0x464 0x47a 0x46f 0x475 0x477 0x473 0x468 0x459 0x462 0x459 0x456 0x459 0x45e 0x460 0x464 0x45d 0x462 0x467 0x456 0x462 0x465 0x464 0x462 0x452 0x470 0x479 0x46b 0x477 0x477 0x47a 0x44d 0x446 0x479 0x47d 0x481 0x46e 0x46e 0x47a 0x481 0x454 0x465 0x46f 0x46c 0x468 0x461 0x461 0x456 0x45d 0x453 0x44c 0x450 0x446 0x44c 0x449 0x45a 0x462 0x452 0x454 0x465 0x45a 0x459 0x457 0x465 0x457 0x454 0x457 0x457 0x468 0x46f 0x459 0x459 0x46e 0x469 0x472 0x468 0x46e 0x470 0x469 0x44c 0x453 0x45a 0x45d 0x45e 0x457 0x45a 0x45a 0x468 0x465 0x460 0x45b 0x46e 0x457 0x44d 0x453 0x456 0x454 0x460 0x46e 0x465 0x46b 0x467 0x465 0x467 0x468 0x465 0x469 0x467 0x472 0x46e 0x459 0x45a 0x454 0x45b 0x45e 0x45d 0x456 0x45e 0x45d 0x45e 0x459 0x45b 0x462 0x461 0x45a 0x45d 0x44f 0x460 0x461 0x44b 0x449 0x46f 0x46c 0x470 0x469 0x460 0x465 0x468 0x45b 0x45e 0x467 0x460 0x462 0x457 0x46b 0x456 0x45a 0x460 0x464 0x46c 0x46e 0x469 0x465 0x468 0x467 0x460 0x46e 0x46e 0x46b 0x457 0x462 0x453 0x453 0x44d 0x44d 0x44d 0x452 0x453 0x469 0x465 0x460 0x467 0x468 0x467 0x462 0x452 0x461 0x45a 0x44c 0x457 0x454 0x452 0x456 0x457 0x456 0x462 0x460 0x45a 0x45e 0x45e 0x462 0x44c 0x465 0x460 0x45e 0x467 0x461 0x465 0x469 0x468 0x45e 0x45e 0x45a 0x45d 0x460 0x461 0x461 0x453 0x445 0x44d 0x44b 0x44b 0x456 0x45a 0x454 0x46b 0x46b 0x457 0x452 0x453 0x452 0x454 0x457 0x456 0xf00 0xf00 0xf00>;
					PS_Config_Lmt_Open_Rawdata_N = <0x5e5 0x63f 0x64a 0x667 0x644 0x64d 0x640 0x5dd 0x5e8 0x664 0x64b 0x654 0x652 0x64a 0x619 0x5c7 0x5fa 0x648 0x651 0x66f 0x651 0x65a 0x648 0x5fd 0x604 0x66a 0x651 0x65b 0x657 0x64d 0x61f 0x5e0 0x62a 0x64a 0x654 0x67a 0x65d 0x660 0x64f 0x64b 0x660 0x677 0x661 0x66b 0x66d 0x655 0x62e 0x610 0x622 0x63f 0x64b 0x673 0x653 0x656 0x646 0x633 0x653 0x66d 0x655 0x65f 0x65b 0x645 0x61c 0x5f5 0x641 0x661 0x666 0x691 0x676 0x67a 0x663 0x666 0x672 0x68e 0x670 0x67f 0x675 0x65d 0x631 0x61f 0x63a 0x658 0x65e 0x68b 0x673 0x679 0x65e 0x663 0x674 0x68e 0x66f 0x67f 0x672 0x65a 0x631 0x620 0x646 0x665 0x66f 0x697 0x684 0x68d 0x671 0x676 0x67b 0x693 0x678 0x682 0x66e 0x65c 0x62d 0x621 0x63f 0x660 0x66c 0x690 0x685 0x68f 0x664 0x676 0x67c 0x690 0x678 0x682 0x66a 0x655 0x61d 0x61c 0x64c 0x66c 0x675 0x699 0x693 0x699 0x684 0x682 0x693 0x6a4 0x68d 0x698 0x678 0x663 0x641 0x62c 0x651 0x66d 0x675 0x69b 0x698 0x69d 0x68a 0x685 0x697 0x6a6 0x68d 0x69b 0x677 0x660 0x63f 0x62c 0x654 0x677 0x67d 0x6a9 0x6a8 0x6a2 0x69b 0x69f 0x6a1 0x6b9 0x69c 0x6ae 0x67e 0x65e 0x647 0x639 0x648 0x66b 0x66c 0x699 0x699 0x6a6 0x68e 0x68f 0x69d 0x6b5 0x698 0x6ac 0x67c 0x66d 0x646 0x635 0x65a 0x679 0x681 0x6a7 0x6b3 0x6c4 0x6a9 0x6a5 0x6a5 0x6b8 0x6a3 0x6ad 0x67b 0x671 0x649 0x634 0x648 0x668 0x670 0x692 0x6a3 0x6b7 0x69d 0x692 0x6ab 0x6bd 0x6a8 0x6b5 0x678 0x671 0x64b 0x634 0x664 0x682 0x68a 0x6ac 0x6b2 0x6d6 0x6be 0x6b0 0x6bb 0x6c7 0x6ad 0x6bc 0x675 0x673 0x653 0x637 0x660 0x680 0x683 0x6a4 0x6bf 0x6d2 0x6c1 0x6b7 0x6be 0x6c8 0x6b0 0x6be 0x681 0x673 0x64f 0x634 0x661 0x685 0x67f 0x6a2 0x6c1 0x6da 0x6c9 0x6bd 0x6c0 0x6d0 0x6b1 0x6c1 0x67d 0x670 0x646 0x631 0x650 0x674 0x66a 0x68a 0x6b3 0x6cc 0x6c0 0x6b1 0x6b2 0x6c0 0x6a3 0x6a9 0x66f 0x663 0x633 0x621 0x637 0x631 0x61c 0x613 0x5fb 0x60d 0x607 0x619 0x5e7 0x616 0x5ff 0x5fd 0x60b 0x634 0x63e 0x666 0x638 0x637 0x61b 0x61b 0x600 0x610 0x609 0x61c 0x5e2 0x60c 0x5fa 0x603 0x608 0x62f 0x638 0x65d 0x635 0x63b 0x61e 0x61e 0x604 0x612 0x60c 0x61c 0x5ed 0x60f 0x607 0x60f 0x612 0x63b 0x640 0x658 0x62b 0x631 0x60a 0x616 0x5f9 0x607 0x604 0x610 0x5e2 0x607 0x5f6 0x60d 0x610 0x636 0x638 0x64f 0x637 0x642 0x622 0x623 0x60d 0x615 0x610 0x61b 0x5eb 0x60f 0x606 0x61b 0x61b 0x63a 0x63c 0x650 0x622 0x630 0x612 0x617 0x5fa 0x603 0x600 0x60a 0x5eb 0x609 0x603 0x618 0x619 0x635 0x637 0x648 0x61e 0x634 0x616 0x619 0x600 0x60a 0x604 0x60e 0x5e6 0x606 0x5fe 0x612 0x613 0x636 0x636 0x642 0x61c 0x62b 0x618 0x61b 0x5fe 0x60d 0x604 0x610 0x5ef 0x5fd 0x602 0x616 0x618 0x639 0x63a 0x640 0x617 0x633 0x61a 0x619 0x600 0x609 0x607 0x611 0x5e3 0x5fd 0x5fc 0x60c 0x60f 0x62c 0x630 0x62c 0x60f 0x62c 0x615 0x613 0x5fc 0x606 0x603 0x60a 0x5d3 0x5ec 0x5ea 0x5fb 0x5fb 0x61c 0x61e 0x618 0x5ff 0x62e 0x610 0x617 0x5fa 0x604 0x601 0x609 0x5d9 0x5fc 0x5f4 0x60a 0x609 0x627 0x628 0x61d 0x604 0x627 0x60d 0x614 0x5f6 0x600 0x5ff 0x602 0x5ce 0x5e9 0x5e0 0x5f4 0x5f7 0x613 0x612 0x609 0x5f1 0x61b 0x608 0x609 0x5ec 0x5f8 0x5f5 0x5f7 0x5da 0x5f8 0x5f5 0x603 0x604 0x629 0x61b 0x613 0x579 0x614 0x589 0x607 0x576 0x5fc 0x57a 0x5f5 0x556 0x5e8 0x56a 0x5f2 0x57a 0x615 0x58b 0x5fe 0x57e 0x59a 0x592 0x595 0x57f 0x58b 0x584 0x587 0x565 0x57c 0x575 0x584 0x583 0x59d 0x58f 0x589 0x583 0x59e 0x59b 0x59f 0x587 0x594 0x58c 0x590 0x573 0x58b 0x57f 0x590 0x58d 0x5a6 0x596 0x58e 0x524 0x594 0x590 0x597 0x57f 0x58b 0x582 0x588 0x56d 0x58b 0x57a 0x58f 0x58c 0x5a6 0x58f 0x53a 0x517 0x59e 0x59d 0x5a9 0x58c 0x598 0x591 0x597 0x571 0x590 0x57d 0x58e 0x58f 0x5a6 0x589 0x51e 0xfffffe01 0xfffffe01 0xfffffe01>;
					PS_Config_Lmt_Open_Rawdata_P = <0xdc1 0xe93 0xead 0xef2 0xe9f 0xeb4 0xe95 0xdb0 0xdc9 0xeeb 0xeaf 0xec4 0xec1 0xead 0xe3c 0xd7c 0xdf2 0xea9 0xebe 0xf04 0xebd 0xed2 0xea8 0xdfa 0xe0b 0xef7 0xebe 0xed6 0xecc 0xeb4 0xe4a 0xdb7 0xe62 0xead 0xec5 0xf1d 0xed9 0xee1 0xeba 0xeb0 0xee0 0xf16 0xee4 0xefa 0xf00 0xec6 0xe6b 0xe25 0xe51 0xe93 0xeaf 0xf0c 0xec2 0xec9 0xea3 0xe77 0xec2 0xefe 0xec6 0xede 0xed6 0xea1 0xe41 0xde8 0xe98 0xee4 0xeee 0xf52 0xf15 0xf1d 0xee8 0xeee 0xf0a 0xf4b 0xf07 0xf2a 0xf11 0xed9 0xe74 0xe4a 0xe87 0xecf 0xedd 0xf44 0xf0c 0xf1c 0xedb 0xee8 0xf0f 0xf4d 0xf04 0xf2a 0xf0b 0xed2 0xe74 0xe4b 0xea5 0xeec 0xf04 0xf60 0xf35 0xf49 0xf08 0xf13 0xf1f 0xf58 0xf19 0xf2f 0xf01 0xed7 0xe69 0xe4d 0xe94 0xee1 0xefd 0xf50 0xf38 0xf4e 0xeeb 0xf15 0xf21 0xf50 0xf18 0xf31 0xef9 0xec6 0xe44 0xe41 0xeb3 0xefc 0xf12 0xf66 0xf58 0xf65 0xf34 0xf2f 0xf58 0xf7f 0xf49 0xf63 0xf19 0xee7 0xe98 0xe67 0xebd 0xefe 0xf12 0xf6a 0xf63 0xf6e 0xf42 0xf36 0xf62 0xf85 0xf49 0xf6a 0xf16 0xee1 0xe94 0xe67 0xec4 0xf16 0xf24 0xf8a 0xf88 0xf7b 0xf6a 0xf74 0xf78 0xfb0 0xf6c 0xf97 0xf26 0xedb 0xea6 0xe85 0xea9 0xefa 0xefd 0xf66 0xf65 0xf83 0xf4d 0xf4e 0xf6e 0xfa8 0xf63 0xf93 0xf21 0xefe 0xea5 0xe7c 0xed3 0xf1a 0xf2d 0xf86 0xfa2 0xfcb 0xf8a 0xf81 0xf82 0xfaf 0xf7e 0xf94 0xf1f 0xf08 0xeaa 0xe7b 0xea8 0xef3 0xf05 0xf55 0xf7c 0xfab 0xf6e 0xf55 0xf90 0xfba 0xf88 0xfa6 0xf18 0xf08 0xeb0 0xe7b 0xee9 0xf2f 0xf42 0xf93 0xf9f 0xff3 0xfbd 0xf9b 0xfb6 0xfd0 0xf94 0xfb7 0xf12 0xf0e 0xec2 0xe82 0xee0 0xf2b 0xf32 0xf7f 0xfbe 0xfeb 0xfc2 0xfab 0xfbd 0xfd3 0xf9b 0xfbd 0xf2d 0xf0c 0xeba 0xe7b 0xee4 0xf36 0xf28 0xf7b 0xfc2 0xffd 0xfd5 0xfb9 0xfc1 0xfe5 0xf9d 0xfc2 0xf24 0xf07 0xea3 0xe72 0xebb 0xf0f 0xef9 0xf42 0xfa2 0xfdc 0xfc0 0xf9e 0xf9f 0xfc0 0xf7e 0xf8a 0xf04 0xee8 0xe78 0xe4e 0xe80 0xe74 0xe43 0xe2c 0xdf6 0xe20 0xe12 0xe3c 0xdc6 0xe35 0xdfe 0xdf9 0xe1a 0xe79 0xe91 0xeef 0xe83 0xe82 0xe3f 0xe3f 0xe01 0xe27 0xe16 0xe43 0xdbb 0xe1c 0xdf3 0xe07 0xe13 0xe6e 0xe83 0xeda 0xe7c 0xe8a 0xe46 0xe46 0xe0b 0xe2a 0xe1d 0xe43 0xdd4 0xe24 0xe12 0xe24 0xe2b 0xe8a 0xe95 0xecf 0xe64 0xe74 0xe17 0xe33 0xdf0 0xe10 0xe0b 0xe25 0xdba 0xe12 0xde9 0xe1e 0xe25 0xe7e 0xe83 0xeba 0xe80 0xe9b 0xe51 0xe52 0xe1e 0xe32 0xe25 0xe3f 0xdd0 0xe24 0xe0e 0xe40 0xe40 0xe89 0xe8c 0xebb 0xe51 0xe71 0xe2a 0xe36 0xdf2 0xe08 0xe00 0xe17 0xdcf 0xe16 0xe08 0xe39 0xe3c 0xe7c 0xe82 0xea9 0xe46 0xe7b 0xe35 0xe3c 0xe00 0xe19 0xe09 0xe21 0xdc3 0xe0f 0xdfd 0xe2a 0xe2c 0xe7e 0xe7e 0xe9b 0xe41 0xe64 0xe39 0xe3f 0xdfd 0xe20 0xe0b 0xe25 0xdd8 0xdfa 0xe05 0xe33 0xe39 0xe86 0xe87 0xe97 0xe36 0xe77 0xe3d 0xe3c 0xe00 0xe16 0xe10 0xe28 0xdbc 0xdf9 0xdf7 0xe1c 0xe23 0xe67 0xe71 0xe67 0xe24 0xe67 0xe31 0xe2c 0xdf7 0xe0e 0xe07 0xe19 0xd98 0xdd1 0xdcd 0xdf4 0xdf4 0xe43 0xe46 0xe38 0xdfe 0xe6d 0xe27 0xe36 0xdf2 0xe0b 0xe02 0xe15 0xda5 0xdf7 0xde4 0xe17 0xe16 0xe5b 0xe5d 0xe44 0xe0b 0xe5b 0xe1e 0xe2f 0xde9 0xe00 0xdfe 0xe05 0xd8d 0xdca 0xdb7 0xde5 0xdeb 0xe2e 0xe2b 0xe16 0xdde 0xe3f 0xe13 0xe15 0xdd1 0xded 0xde6 0xdec 0xda9 0xded 0xde6 0xe08 0xe0b 0xe60 0xe3f 0xe2e 0xcc6 0xe2f 0xcea 0xe10 0xcbe 0xdf7 0xcc9 0xde8 0xc75 0xdc8 0xca2 0xde1 0xcc7 0xe31 0xcef 0xdfb 0xcd1 0xd12 0xcff 0xd06 0xcd3 0xcf0 0xcdf 0xce6 0xc96 0xccc 0xcbc 0xcdf 0xcdc 0xd1a 0xcf8 0xcea 0xcdc 0xd1d 0xd14 0xd1e 0xce6 0xd04 0xcf3 0xcfb 0xcb8 0xcf0 0xcd4 0xcfb 0xcf4 0xd2f 0xd09 0xcf7 0xbff 0xd05 0xcfb 0xd0b 0xcd3 0xcf0 0xcdb 0xce8 0xcaa 0xcf0 0xcc7 0xcf8 0xcf1 0xd2f 0xcf8 0xc32 0xbe0 0xd1d 0xd1a 0xd35 0xcf1 0xd0d 0xcfd 0xd0c 0xcb2 0xcfb 0xcd0 0xcf6 0xcfa 0xd2e 0xcec 0xbf1 0x1400 0x1400 0x1400>;
					PS_Config_Lmt_Short_Rawdata_N = <0x2774 0x2774 0x2774 0x2774 0x2774 0x2774 0x2774 0x2774 0x2774 0x2774 0x2774 0x2774 0x2774 0x2774 0x2774 0x2774 0x2774 0x2774 0x2774 0x2774 0x2774 0x2774 0x2774 0x2774 0x2774 0x2774 0x2774 0x2774 0x2774 0x2774 0x2774 0x2774 0x2774 0x2774 0x2774 0x2774 0x2774 0x2774 0x2774 0x2774 0x2774 0x2774 0x2774 0x2774 0x2774 0x2774 0x2774 0x2774 0x2774 0x2774 0x2774 0x2774 0x2774 0x2774 0x2774 0x2774 0x2774 0x2774 0x2774 0x2774 0x2774 0x2774 0x2774 0x2774 0x2774 0x2774 0x2774 0x2774 0x2774 0x2774 0x2774 0x2774 0x2774 0x2774 0x2774 0x2774 0x2774 0x2774 0x2774 0x2774 0x2774 0x2774 0x2774 0x2774 0x2774 0x2774 0x2774 0x2774 0x2774 0x2774 0x2774 0x2774 0x2774 0x2774 0x2774 0x2774 0x2774 0x2774 0x2774 0x2774 0x2774 0x2774 0x2774 0x2774 0x2774 0x2774 0x2774 0x2774 0x2774 0x2774 0x2774 0x2774 0x2774 0x2774 0x2774 0x2774 0x2774 0x2774 0x2774 0x2774 0x2774 0x2774 0x2774 0x2774 0x2774 0x2774 0x2774 0x2774 0x2774 0x2774 0x2774 0x2774 0x2774 0x2774 0x2774 0x2774 0x2774 0x2774 0x2774 0x2774 0x2774 0x2774 0x2774 0x2774 0x2774 0x2774 0x2774 0x2774 0x2774 0x2774 0x2774 0x2774 0x2774 0x2774 0x2774 0x2774 0x2774 0x2774 0x2774 0x2774 0x2774 0x2774 0x2774 0x2774 0x2774 0x2774 0x2774 0x2774 0x2774 0x2774 0x2774 0x2774 0x2774 0x2774 0x2774 0x2774 0x2774 0x2774 0x2774 0x2774 0x2774 0x2774 0x2774 0x2774 0x2774 0x2774 0x2774 0x2774 0x2774 0x2774 0x2774 0x2774 0x2774 0x2774 0x2774 0x2774 0x2774 0x2774 0x2774 0x2774 0x2774 0x2774 0x2774 0x2774 0x2774 0x2774 0x2774 0x2774 0x2774 0x2774 0x2774 0x2774 0x2774 0x2774 0x2774 0x2774 0x2774 0x2774 0x2774 0x2774 0x2774 0x2774 0x2774 0x2774 0x2774 0x2774 0x2774 0x2774 0x2774 0x2774 0x2774 0x2774 0x2774 0x2774 0x2774 0x2774 0x2774 0x2774 0x2774 0x2774 0x2774 0x2774 0x2774 0x2774 0x2774 0x2774 0x2774 0x2774 0x2774 0x2774 0x2774 0x2774 0x2774 0x2774 0x2774 0x2774 0x2774 0x2774 0x2774 0x2774 0x2774 0x2774 0x2774 0x2774 0x2774 0x2774 0x2774 0x2774 0x2774 0x2774 0x2774 0x2774 0x2774 0x2774 0x2774 0x2774 0x2774 0x2774 0x2774 0x2774 0x2774 0x2774 0x2774 0x2774 0x2774 0x2774 0x2774 0x2774 0x2774 0x2774 0x2774 0x2774 0x2774 0x2774 0x2774 0x2774 0x2774 0x2774 0x2774 0x2774 0x2774 0x2774 0x2774 0x2774 0x2774 0x2774 0x2774 0x2774 0x2774 0x2774 0x2774 0x2774 0x2774 0x2774 0x2774 0x2774 0x2774 0x2774 0x2774 0x2774 0x2774 0x2774 0x2774 0x2774 0x2774 0x2774 0x2774 0x2774 0x2774 0x2774 0x2774 0x2774 0x2774 0x2774 0x2774 0x2774 0x2774 0x2774 0x2774 0x2774 0x2774 0x2774 0x2774 0x2774 0x2774 0x2774 0x2774 0x2774 0x2774 0x2774 0x2774 0x2774 0x2774 0x2774 0x2774 0x2774 0x2774 0x2774 0x2774 0x2774 0x2774 0x2774 0x2774 0x2774 0x2774 0x2774 0x2774 0x2774 0x2774 0x2774 0x2774 0x2774 0x2774 0x2774 0x2774 0x2774 0x2774 0x2774 0x2774 0x2774 0x2774 0x2774 0x2774 0x2774 0x2774 0x2774 0x2774 0x2774 0x2774 0x2774 0x2774 0x2774 0x2774 0x2774 0x2774 0x2774 0x2774 0x2774 0x2774 0x2774 0x2774 0x2774 0x2774 0x2774 0x2774 0x2774 0x2774 0x2774 0x2774 0x2774 0x2774 0x2774 0x2774 0x2774 0x2774 0x2774 0x2774 0x2774 0x2774 0x2774 0x2774 0x2774 0x2774 0x2774 0x2774 0x2774 0x2774 0x2774 0x2774 0x2774 0x2774 0x2774 0x2774 0x2774 0x2774 0x2774 0x2774 0x2774 0x2774 0x2774 0x2774 0x2774 0x2774 0x2774 0x2774 0x2774 0x2774 0x2774 0x2774 0x2774 0x2774 0x2774 0x2774 0x2774 0x2774 0x2774 0x2774 0x2774 0x2774 0x2774 0x2774 0x2774 0x2774 0x2774 0x2774 0x2774 0x2774 0x2774 0x2774 0x2774 0x2774 0x2774 0x2774 0x2774 0x2774 0x2774 0x2774 0x2774 0x2774 0x2774 0x2774 0x2774 0x2774 0x2774 0x2774 0x2774 0x2774 0x2774 0x2774 0x2774 0x2774 0x2774 0x2774 0x2774 0x2774 0x2774 0x2774 0x2774 0x2774 0x2774 0x2774 0x2774 0x2774 0x2774 0x2774 0x2774 0x2774 0x2774 0x2774 0x2774 0x2774 0x2774 0x2774 0x2774 0x2774 0x2774 0x2774 0x2774 0x2774 0x2774 0x2774 0x2774 0x2774 0x2774 0x2774 0x2774 0x2774 0x2774 0x2774 0x2774 0x2774 0x2774 0x2774 0x2774 0x2774 0x2774 0x2774 0x2774 0x2774 0x2774 0x2774 0x2774 0x2774 0x2774 0x2774 0x2774 0x2774 0x2774 0x2774 0x2774 0x2774 0x2774 0x2774 0x2774 0x2774 0x2774 0x2774 0x2774 0x2774 0x2774 0x2774 0x2774 0x2774 0x2774 0x2774 0x2774 0x2774 0x2774 0x2774 0x2774 0x2774 0x2774 0x2774 0x2774 0x2774 0x2774 0x2710 0x2710 0x2710>;
					PS_Config_Lmt_Short_Rawdata_P = <0x36b8 0x36b8 0x36b8 0x36b8 0x36b8 0x36b8 0x36b8 0x36b8 0x36b8 0x36b8 0x36b8 0x36b8 0x36b8 0x36b8 0x36b8 0x36b8 0x36b8 0x36b8 0x36b8 0x36b8 0x36b8 0x36b8 0x36b8 0x36b8 0x36b8 0x36b8 0x36b8 0x36b8 0x36b8 0x36b8 0x36b8 0x36b8 0x36b8 0x36b8 0x36b8 0x36b8 0x36b8 0x36b8 0x36b8 0x36b8 0x36b8 0x36b8 0x36b8 0x36b8 0x36b8 0x36b8 0x36b8 0x36b8 0x36b8 0x36b8 0x36b8 0x36b8 0x36b8 0x36b8 0x36b8 0x36b8 0x36b8 0x36b8 0x36b8 0x36b8 0x36b8 0x36b8 0x36b8 0x36b8 0x36b8 0x36b8 0x36b8 0x36b8 0x36b8 0x36b8 0x36b8 0x36b8 0x36b8 0x36b8 0x36b8 0x36b8 0x36b8 0x36b8 0x36b8 0x36b8 0x36b8 0x36b8 0x36b8 0x36b8 0x36b8 0x36b8 0x36b8 0x36b8 0x36b8 0x36b8 0x36b8 0x36b8 0x36b8 0x36b8 0x36b8 0x36b8 0x36b8 0x36b8 0x36b8 0x36b8 0x36b8 0x36b8 0x36b8 0x36b8 0x36b8 0x36b8 0x36b8 0x36b8 0x36b8 0x36b8 0x36b8 0x36b8 0x36b8 0x36b8 0x36b8 0x36b8 0x36b8 0x36b8 0x36b8 0x36b8 0x36b8 0x36b8 0x36b8 0x36b8 0x36b8 0x36b8 0x36b8 0x36b8 0x36b8 0x36b8 0x36b8 0x36b8 0x36b8 0x36b8 0x36b8 0x36b8 0x36b8 0x36b8 0x36b8 0x36b8 0x36b8 0x36b8 0x36b8 0x36b8 0x36b8 0x36b8 0x36b8 0x36b8 0x36b8 0x36b8 0x36b8 0x36b8 0x36b8 0x36b8 0x36b8 0x36b8 0x36b8 0x36b8 0x36b8 0x36b8 0x36b8 0x36b8 0x36b8 0x36b8 0x36b8 0x36b8 0x36b8 0x36b8 0x36b8 0x36b8 0x36b8 0x36b8 0x36b8 0x36b8 0x36b8 0x36b8 0x36b8 0x36b8 0x36b8 0x36b8 0x36b8 0x36b8 0x36b8 0x36b8 0x36b8 0x36b8 0x36b8 0x36b8 0x36b8 0x36b8 0x36b8 0x36b8 0x36b8 0x36b8 0x36b8 0x36b8 0x36b8 0x36b8 0x36b8 0x36b8 0x36b8 0x36b8 0x36b8 0x36b8 0x36b8 0x36b8 0x36b8 0x36b8 0x36b8 0x36b8 0x36b8 0x36b8 0x36b8 0x36b8 0x36b8 0x36b8 0x36b8 0x36b8 0x36b8 0x36b8 0x36b8 0x36b8 0x36b8 0x36b8 0x36b8 0x36b8 0x36b8 0x36b8 0x36b8 0x36b8 0x36b8 0x36b8 0x36b8 0x36b8 0x36b8 0x36b8 0x36b8 0x36b8 0x36b8 0x36b8 0x36b8 0x36b8 0x36b8 0x36b8 0x36b8 0x36b8 0x36b8 0x36b8 0x36b8 0x36b8 0x36b8 0x36b8 0x36b8 0x36b8 0x36b8 0x36b8 0x36b8 0x36b8 0x36b8 0x36b8 0x36b8 0x36b8 0x36b8 0x36b8 0x36b8 0x36b8 0x36b8 0x36b8 0x36b8 0x36b8 0x36b8 0x36b8 0x36b8 0x36b8 0x36b8 0x36b8 0x36b8 0x36b8 0x36b8 0x36b8 0x36b8 0x36b8 0x36b8 0x36b8 0x36b8 0x36b8 0x36b8 0x36b8 0x36b8 0x36b8 0x36b8 0x36b8 0x36b8 0x36b8 0x36b8 0x36b8 0x36b8 0x36b8 0x36b8 0x36b8 0x36b8 0x36b8 0x36b8 0x36b8 0x36b8 0x36b8 0x36b8 0x36b8 0x36b8 0x36b8 0x36b8 0x36b8 0x36b8 0x36b8 0x36b8 0x36b8 0x36b8 0x36b8 0x36b8 0x36b8 0x36b8 0x36b8 0x36b8 0x36b8 0x36b8 0x36b8 0x36b8 0x36b8 0x36b8 0x36b8 0x36b8 0x36b8 0x36b8 0x36b8 0x36b8 0x36b8 0x36b8 0x36b8 0x36b8 0x36b8 0x36b8 0x36b8 0x36b8 0x36b8 0x36b8 0x36b8 0x36b8 0x36b8 0x36b8 0x36b8 0x36b8 0x36b8 0x36b8 0x36b8 0x36b8 0x36b8 0x36b8 0x36b8 0x36b8 0x36b8 0x36b8 0x36b8 0x36b8 0x36b8 0x36b8 0x36b8 0x36b8 0x36b8 0x36b8 0x36b8 0x36b8 0x36b8 0x36b8 0x36b8 0x36b8 0x36b8 0x36b8 0x36b8 0x36b8 0x36b8 0x36b8 0x36b8 0x36b8 0x36b8 0x36b8 0x36b8 0x36b8 0x36b8 0x36b8 0x36b8 0x36b8 0x36b8 0x36b8 0x36b8 0x36b8 0x36b8 0x36b8 0x36b8 0x36b8 0x36b8 0x36b8 0x36b8 0x36b8 0x36b8 0x36b8 0x36b8 0x36b8 0x36b8 0x36b8 0x36b8 0x36b8 0x36b8 0x36b8 0x36b8 0x36b8 0x36b8 0x36b8 0x36b8 0x36b8 0x36b8 0x36b8 0x36b8 0x36b8 0x36b8 0x36b8 0x36b8 0x36b8 0x36b8 0x36b8 0x36b8 0x36b8 0x36b8 0x36b8 0x36b8 0x36b8 0x36b8 0x36b8 0x36b8 0x36b8 0x36b8 0x36b8 0x36b8 0x36b8 0x36b8 0x36b8 0x36b8 0x36b8 0x36b8 0x36b8 0x36b8 0x36b8 0x36b8 0x36b8 0x36b8 0x36b8 0x36b8 0x36b8 0x36b8 0x36b8 0x36b8 0x36b8 0x36b8 0x36b8 0x36b8 0x36b8 0x36b8 0x36b8 0x36b8 0x36b8 0x36b8 0x36b8 0x36b8 0x36b8 0x36b8 0x36b8 0x36b8 0x36b8 0x36b8 0x36b8 0x36b8 0x36b8 0x36b8 0x36b8 0x36b8 0x36b8 0x36b8 0x36b8 0x36b8 0x36b8 0x36b8 0x36b8 0x36b8 0x36b8 0x36b8 0x36b8 0x36b8 0x36b8 0x36b8 0x36b8 0x36b8 0x36b8 0x36b8 0x36b8 0x36b8 0x36b8 0x36b8 0x36b8 0x36b8 0x36b8 0x36b8 0x36b8 0x36b8 0x36b8 0x36b8 0x36b8 0x36b8 0x36b8 0x36b8 0x36b8 0x36b8 0x36b8 0x36b8 0x36b8 0x36b8 0x36b8 0x36b8 0x36b8 0x36b8 0x36b8 0x36b8 0x36b8 0x36b8 0x36b8 0x36b8 0x36b8 0x36b8 0x36b8 0x36b8 0x36b8 0x36b8 0x36b8 0x36b8 0x36b8 0x36b8 0x36b8 0x36b8 0x36b8 0x36b8 0x36b8 0x36b8 0x36b8 0x36b8 0x36b8 0x36b8 0x36b8 0x36b8 0x36b8 0x36b8 0x36b8 0x36b8 0x36b8 0x36b8 0x36b8 0x36b8 0x36b8 0x36b8 0x36b8 0x36b8 0x36b8 0x36b8 0x36b8 0x36b8 0x36b8 0x36b8 0x36b8 0x36b8 0x36b8 0x36b8 0x36b8>;
					X_Channel = <0x10>;
					Y_Channel = <0x24>;
					compatible = "novatek-mp-criteria-6279";
				};

				novatek-mp-criteria-627D@0 {
					#address-cells = <0x1>;
					#size-cells = <0x0>;
					AIN_KEY = <0x0 0x1 0x2 0xff>;
					AIN_X = <0x0 0x1 0x2 0x3 0x4 0x5 0x6 0x7 0x8 0x9 0xa 0xb 0xc 0xd 0xe 0xf 0x10 0x11>;
					AIN_Y = <0x0 0x1 0x2 0x3 0x4 0x5 0x6 0x7 0x8 0x9 0xa 0xb 0xc 0xd 0xe 0xf 0x10 0x11 0x12 0x13 0x14 0x15 0x16 0x17 0x18 0x19 0x1a 0x1b 0x1c 0x1d 0x1e 0x1f 0x20 0x21 0x22 0x23>;
					IC_KEY_CFG_SIZE = <0x4>;
					IC_X_CFG_SIZE = <0x12>;
					IC_Y_CFG_SIZE = <0x24>;
					PS_Config_Diff_Test_Frame = <0x32>;
					PS_Config_Lmt_FW_CC_N = <0x0 0x0 0x0 0x0 0x0 0x0 0x0 0x0 0x0 0x0 0x0 0x0 0x0 0x0 0x0 0x0 0x0 0x0 0x0 0x0 0x0 0x0 0x0 0x0 0x0 0x0 0x0 0x0 0x0 0x0 0x0 0x0 0x0 0x0 0x0 0x0 0x0 0x0 0x0 0x0 0x0 0x0 0x0 0x0 0x0 0x0 0x0 0x0 0x0 0x0 0x0 0x0 0x0 0x0 0x0 0x0 0x0 0x0 0x0 0x0 0x0 0x0 0x0 0x0 0x0 0x0 0x0 0x0 0x0 0x0 0x0 0x0 0x0 0x0 0x0 0x0 0x0 0x0 0x0 0x0 0x0 0x0 0x0 0x0 0x0 0x0 0x0 0x0 0x0 0x0 0x0 0x0 0x0 0x0 0x0 0x0 0x0 0x0 0x0 0x0 0x0 0x0 0x0 0x0 0x0 0x0 0x0 0x0 0x0 0x0 0x0 0x0 0x0 0x0 0x0 0x0 0x0 0x0 0x0 0x0 0x0 0x0 0x0 0x0 0x0 0x0 0x0 0x0 0x0 0x0 0x0 0x0 0x0 0x0 0x0 0x0 0x0 0x0 0x0 0x0 0x0 0x0 0x0 0x0 0x0 0x0 0x0 0x0 0x0 0x0 0x0 0x0 0x0 0x0 0x0 0x0 0x0 0x0 0x0 0x0 0x0 0x0 0x0 0x0 0x0 0x0 0x0 0x0 0x0 0x0 0x0 0x0 0x0 0x0 0x0 0x0 0x0 0x0 0x0 0x0 0x0 0x0 0x0 0x0 0x0 0x0 0x0 0x0 0x0 0x0 0x0 0x0 0x0 0x0 0x0 0x0 0x0 0x0 0x0 0x0 0x0 0x0 0x0 0x0 0x0 0x0 0x0 0x0 0x0 0x0 0x0 0x0 0x0 0x0 0x0 0x0 0x0 0x0 0x0 0x0 0x0 0x0 0x0 0x0 0x0 0x0 0x0 0x0 0x0 0x0 0x0 0x0 0x0 0x0 0x0 0x0 0x0 0x0 0x0 0x0 0x0 0x0 0x0 0x0 0x0 0x0 0x0 0x0 0x0 0x0 0x0 0x0 0x0 0x0 0x0 0x0 0x0 0x0 0x0 0x0 0x0 0x0 0x0 0x0 0x0 0x0 0x0 0x0 0x0 0x0 0x0 0x0 0x0 0x0 0x0 0x0 0x0 0x0 0x0 0x0 0x0 0x0 0x0 0x0 0x0 0x0 0x0 0x0 0x0 0x0 0x0 0x0 0x0 0x0 0x0 0x0 0x0 0x0 0x0 0x0 0x0 0x0 0x0 0x0 0x0 0x0 0x0 0x0 0x0 0x0 0x0 0x0 0x0 0x0 0x0 0x0 0x0 0x0 0x0 0x0 0x0 0x0 0x0 0x0 0x0 0x0 0x0 0x0 0x0 0x0 0x0 0x0 0x0 0x0 0x0 0x0 0x0 0x0 0x0 0x0 0x0 0x0 0x0 0x0 0x0 0x0 0x0 0x0 0x0 0x0 0x0 0x0 0x0 0x0 0x0 0x0 0x0 0x0 0x0 0x0 0x0 0x0 0x0 0x0 0x0 0x0 0x0 0x0 0x0 0x0 0x0 0x0 0x0 0x0 0x0 0x0 0x0 0x0 0x0 0x0 0x0 0x0 0x0 0x0 0x0 0x0 0x0 0x0 0x0 0x0 0x0 0x0 0x0 0x0 0x0 0x0 0x0 0x0 0x0 0x0 0x0 0x0 0x0 0x0 0x0 0x0 0x0 0x0 0x0 0x0 0x0 0x0 0x0 0x0 0x0 0x0 0x0 0x0 0x0 0x0 0x0 0x0 0x0 0x0 0x0 0x0 0x0 0x0 0x0 0x0 0x0 0x0 0x0 0x0 0x0 0x0 0x0 0x0 0x0 0x0 0x0 0x0 0x0 0x0 0x0 0x0 0x0 0x0 0x0 0x0 0x0 0x0 0x0 0x0 0x0 0x0 0x0 0x0 0x0 0x0 0x0 0x0 0x0 0x0 0x0 0x0 0x0 0x0 0x0 0x0 0x0 0x0 0x0 0x0 0x0 0x0 0x0 0x0 0x0 0x0 0x0 0x0 0x0 0x0 0x0 0x0 0x0 0x0 0x0 0x0 0x0 0x0 0x0 0x0 0x0 0x0 0x0 0x0 0x0 0x0 0x0 0x0 0x0 0x0 0x0 0x0 0x0 0x0 0x0 0x0 0x0 0x0 0x0 0x0 0x0 0x0 0x0 0x0 0x0 0x0 0x0 0x0 0x0 0x0 0x0 0x0 0x0 0x0 0x0 0x0 0x0 0x0 0x0 0x0 0x0 0x0 0x0 0x0 0x0 0x0 0x0 0x0 0x0 0x0 0x0 0x0 0x0 0x0 0x0 0x0 0x0 0x0 0x0 0x0 0x0 0x0 0x0 0x0 0x0 0x0 0x0 0x0 0x0 0x0 0x0 0x0 0x0 0x0 0x0 0x0 0x0 0x0 0x0 0x0 0x0 0x0 0x0 0x0 0x0 0x0 0x0 0x0 0x0 0x0 0x0 0x0 0x0 0x0 0x0 0x0 0x0 0x0 0x0 0x0 0x0 0x0 0x0 0x0 0x0 0x0 0x0 0x0 0x0 0x0 0x0 0x0 0x0 0x0 0x0 0x0 0x0 0x0 0x0 0x0 0x0 0x0 0x0 0x0 0x0 0x0 0x0 0x0 0x0 0x0 0x0 0x0 0x0 0x0 0x0 0x0 0x0 0x0 0x0 0x0 0x0 0x0 0x0 0x0 0x0 0x0 0x0 0x0 0x0 0x0 0x0 0x0 0x0 0x0 0x0 0x0 0x0>;
					PS_Config_Lmt_FW_CC_P = <0x13a 0x13a 0x13a 0x13a 0x13a 0x13a 0x13a 0x13a 0x13a 0x13a 0x13a 0x13a 0x13a 0x13a 0x13a 0x13a 0x13a 0x13a 0x13a 0x13a 0x13a 0x13a 0x13a 0x13a 0x13a 0x13a 0x13a 0x13a 0x13a 0x13a 0x13a 0x13a 0x13a 0x13a 0x13a 0x13a 0x13a 0x13a 0x13a 0x13a 0x13a 0x13a 0x13a 0x13a 0x13a 0x13a 0x13a 0x13a 0x13a 0x13a 0x13a 0x13a 0x13a 0x13a 0x13a 0x13a 0x13a 0x13a 0x13a 0x13a 0x13a 0x13a 0x13a 0x13a 0x13a 0x13a 0x13a 0x13a 0x13a 0x13a 0x13a 0x13a 0x13a 0x13a 0x13a 0x13a 0x13a 0x13a 0x13a 0x13a 0x13a 0x13a 0x13a 0x13a 0x13a 0x13a 0x13a 0x13a 0x13a 0x13a 0x13a 0x13a 0x13a 0x13a 0x13a 0x13a 0x13a 0x13a 0x13a 0x13a 0x13a 0x13a 0x13a 0x13a 0x13a 0x13a 0x13a 0x13a 0x13a 0x13a 0x13a 0x13a 0x13a 0x13a 0x13a 0x13a 0x13a 0x13a 0x13a 0x13a 0x13a 0x13a 0x13a 0x13a 0x13a 0x13a 0x13a 0x13a 0x13a 0x13a 0x13a 0x13a 0x13a 0x13a 0x13a 0x13a 0x13a 0x13a 0x13a 0x13a 0x13a 0x13a 0x13a 0x13a 0x13a 0x13a 0x13a 0x13a 0x13a 0x13a 0x13a 0x13a 0x13a 0x13a 0x13a 0x13a 0x13a 0x13a 0x13a 0x13a 0x13a 0x13a 0x13a 0x13a 0x13a 0x13a 0x13a 0x13a 0x13a 0x13a 0x13a 0x13a 0x13a 0x13a 0x13a 0x13a 0x13a 0x13a 0x13a 0x13a 0x13a 0x13a 0x13a 0x13a 0x13a 0x13a 0x13a 0x13a 0x13a 0x13a 0x13a 0x13a 0x13a 0x13a 0x13a 0x13a 0x13a 0x13a 0x13a 0x13a 0x13a 0x13a 0x13a 0x13a 0x13a 0x13a 0x13a 0x13a 0x13a 0x13a 0x13a 0x13a 0x13a 0x13a 0x13a 0x13a 0x13a 0x13a 0x13a 0x13a 0x13a 0x13a 0x13a 0x13a 0x13a 0x13a 0x13a 0x13a 0x13a 0x13a 0x13a 0x13a 0x13a 0x13a 0x13a 0x13a 0x13a 0x13a 0x13a 0x13a 0x13a 0x13a 0x13a 0x13a 0x13a 0x13a 0x13a 0x13a 0x13a 0x13a 0x13a 0x13a 0x13a 0x13a 0x13a 0x13a 0x13a 0x13a 0x13a 0x13a 0x13a 0x13a 0x13a 0x13a 0x13a 0x13a 0x13a 0x13a 0x13a 0x13a 0x13a 0x13a 0x13a 0x13a 0x13a 0x13a 0x13a 0x13a 0x13a 0x13a 0x13a 0x13a 0x13a 0x13a 0x13a 0x13a 0x13a 0x13a 0x13a 0x13a 0x13a 0x13a 0x13a 0x13a 0x13a 0x13a 0x13a 0x13a 0x13a 0x13a 0x13a 0x13a 0x13a 0x13a 0x13a 0x13a 0x13a 0x13a 0x13a 0x13a 0x13a 0x13a 0x13a 0x13a 0x13a 0x13a 0x13a 0x13a 0x13a 0x13a 0x13a 0x13a 0x13a 0x13a 0x13a 0x13a 0x13a 0x13a 0x13a 0x13a 0x13a 0x13a 0x13a 0x13a 0x13a 0x13a 0x13a 0x13a 0x13a 0x13a 0x13a 0x13a 0x13a 0x13a 0x13a 0x13a 0x13a 0x13a 0x13a 0x13a 0x13a 0x13a 0x13a 0x13a 0x13a 0x13a 0x13a 0x13a 0x13a 0x13a 0x13a 0x13a 0x13a 0x13a 0x13a 0x13a 0x13a 0x13a 0x13a 0x13a 0x13a 0x13a 0x13a 0x13a 0x13a 0x13a 0x13a 0x13a 0x13a 0x13a 0x13a 0x13a 0x13a 0x13a 0x13a 0x13a 0x13a 0x13a 0x13a 0x13a 0x13a 0x13a 0x13a 0x13a 0x13a 0x13a 0x13a 0x13a 0x13a 0x13a 0x13a 0x13a 0x13a 0x13a 0x13a 0x13a 0x13a 0x13a 0x13a 0x13a 0x13a 0x13a 0x13a 0x13a 0x13a 0x13a 0x13a 0x13a 0x13a 0x13a 0x13a 0x13a 0x13a 0x13a 0x13a 0x13a 0x13a 0x13a 0x13a 0x13a 0x13a 0x13a 0x13a 0x13a 0x13a 0x13a 0x13a 0x13a 0x13a 0x13a 0x13a 0x13a 0x13a 0x13a 0x13a 0x13a 0x13a 0x13a 0x13a 0x13a 0x13a 0x13a 0x13a 0x13a 0x13a 0x13a 0x13a 0x13a 0x13a 0x13a 0x13a 0x13a 0x13a 0x13a 0x13a 0x13a 0x13a 0x13a 0x13a 0x13a 0x13a 0x13a 0x13a 0x13a 0x13a 0x13a 0x13a 0x13a 0x13a 0x13a 0x13a 0x13a 0x13a 0x13a 0x13a 0x13a 0x13a 0x13a 0x13a 0x13a 0x13a 0x13a 0x13a 0x13a 0x13a 0x13a 0x13a 0x13a 0x13a 0x13a 0x13a 0x13a 0x13a 0x13a 0x13a 0x13a 0x13a 0x13a 0x13a 0x13a 0x13a 0x13a 0x13a 0x13a 0x13a 0x13a 0x13a 0x13a 0x13a 0x13a 0x13a 0x13a 0x13a 0x13a 0x13a 0x13a 0x13a 0x13a 0x13a 0x13a 0x13a 0x13a 0x13a 0x13a 0x13a 0x13a 0x13a 0x13a 0x13a 0x13a 0x13a 0x13a 0x13a 0x13a 0x13a 0x13a 0x13a 0x13a 0x13a 0x13a 0x13a 0x13a 0x13a 0x13a 0x13a 0x13a 0x13a 0x13a 0x13a 0x13a 0x13a 0x13a 0x13a 0x13a 0x13a 0x13a 0x13a 0x13a 0x13a 0x13a 0x13a 0x13a 0x13a 0x13a 0x13a 0x13a 0x13a 0x13a 0x13a 0x13a 0x13a 0x13a 0x13a 0x13a 0x13a 0x13a 0x13a 0x13a 0x13a 0x13a 0x13a 0x13a 0x13a 0x13a 0x13a 0x13a 0x13a 0x13a 0x13a 0x13a 0x13a 0x13a 0x13a 0x13a 0x13a 0x13a 0x13a 0x13a 0x13a 0x13a 0x13a 0x13a 0x13a 0x13a 0x13a 0x13a 0x13a 0x13a 0x13a 0x13a 0x13a 0x13a 0x13a 0x13a 0x13a 0x13a 0x13a 0x13a 0x13a 0x13a 0x13a 0x13a 0x13a 0x13a 0x13a 0x13a 0x13a 0x13a 0x13a 0x13a 0x13a 0x13a 0x13a 0x13a 0x13a 0x13a 0x13a 0x13a 0x13a 0x13a 0x13a>;
					PS_Config_Lmt_FW_Diff_N = <0xffffffb5 0xffffffb5 0xffffffb5 0xffffffb5 0xffffffb5 0xffffffb5 0xffffffb5 0xffffffb5 0xffffffb5 0xffffffb5 0xffffffb5 0xffffffb5 0xffffffb5 0xffffffb5 0xffffffb5 0xffffffb5 0xffffffb5 0xffffffb5 0xffffffb5 0xffffffb5 0xffffffb5 0xffffffb5 0xffffffb5 0xffffffb5 0xffffffb5 0xffffffb5 0xffffffb5 0xffffffb5 0xffffffb5 0xffffffb5 0xffffffb5 0xffffffb5 0xffffffb5 0xffffffb5 0xffffffb5 0xffffffb5 0xffffffb5 0xffffffb5 0xffffffb5 0xffffffb5 0xffffffb5 0xffffffb5 0xffffffb5 0xffffffb5 0xffffffb5 0xffffffb5 0xffffffb5 0xffffffb5 0xffffffb5 0xffffffb5 0xffffffb5 0xffffffb5 0xffffffb5 0xffffffb5 0xffffffb5 0xffffffb5 0xffffffb5 0xffffffb5 0xffffffb5 0xffffffb5 0xffffffb5 0xffffffb5 0xffffffb5 0xffffffb5 0xffffffb5 0xffffffb5 0xffffffb5 0xffffffb5 0xffffffb5 0xffffffb5 0xffffffb5 0xffffffb5 0xffffffb5 0xffffffb5 0xffffffb5 0xffffffb5 0xffffffb5 0xffffffb5 0xffffffb5 0xffffffb5 0xffffffb5 0xffffffb5 0xffffffb5 0xffffffb5 0xffffffb5 0xffffffb5 0xffffffb5 0xffffffb5 0xffffffb5 0xffffffb5 0xffffffb5 0xffffffb5 0xffffffb5 0xffffffb5 0xffffffb5 0xffffffb5 0xffffffb5 0xffffffb5 0xffffffb5 0xffffffb5 0xffffffb5 0xffffffb5 0xffffffb5 0xffffffb5 0xffffffb5 0xffffffb5 0xffffffb5 0xffffffb5 0xffffffb5 0xffffffb5 0xffffffb5 0xffffffb5 0xffffffb5 0xffffffb5 0xffffffb5 0xffffffb5 0xffffffb5 0xffffffb5 0xffffffb5 0xffffffb5 0xffffffb5 0xffffffb5 0xffffffb5 0xffffffb5 0xffffffb5 0xffffffb5 0xffffffb5 0xffffffb5 0xffffffb5 0xffffffb5 0xffffffb5 0xffffffb5 0xffffffb5 0xffffffb5 0xffffffb5 0xffffffb5 0xffffffb5 0xffffffb5 0xffffffb5 0xffffffb5 0xffffffb5 0xffffffb5 0xffffffb5 0xffffffb5 0xffffffb5 0xffffffb5 0xffffffb5 0xffffffb5 0xffffffb5 0xffffffb5 0xffffffb5 0xffffffb5 0xffffffb5 0xffffffb5 0xffffffb5 0xffffffb5 0xffffffb5 0xffffffb5 0xffffffb5 0xffffffb5 0xffffffb5 0xffffffb5 0xffffffb5 0xffffffb5 0xffffffb5 0xffffffb5 0xffffffb5 0xffffffb5 0xffffffb5 0xffffffb5 0xffffffb5 0xffffffb5 0xffffffb5 0xffffffb5 0xffffffb5 0xffffffb5 0xffffffb5 0xffffffb5 0xffffffb5 0xffffffb5 0xffffffb5 0xffffffb5 0xffffffb5 0xffffffb5 0xffffffb5 0xffffffb5 0xffffffb5 0xffffffb5 0xffffffb5 0xffffffb5 0xffffffb5 0xffffffb5 0xffffffb5 0xffffffb5 0xffffffb5 0xffffffb5 0xffffffb5 0xffffffb5 0xffffffb5 0xffffffb5 0xffffffb5 0xffffffb5 0xffffffb5 0xffffffb5 0xffffffb5 0xffffffb5 0xffffffb5 0xffffffb5 0xffffffb5 0xffffffb5 0xffffffb5 0xffffffb5 0xffffffb5 0xffffffb5 0xffffffb5 0xffffffb5 0xffffffb5 0xffffffb5 0xffffffb5 0xffffffb5 0xffffffb5 0xffffffb5 0xffffffb5 0xffffffb5 0xffffffb5 0xffffffb5 0xffffffb5 0xffffffb5 0xffffffb5 0xffffffb5 0xffffffb5 0xffffffb5 0xffffffb5 0xffffffb5 0xffffffb5 0xffffffb5 0xffffffb5 0xffffffb5 0xffffffb5 0xffffffb5 0xffffffb5 0xffffffb5 0xffffffb5 0xffffffb5 0xffffffb5 0xffffffb5 0xffffffb5 0xffffffb5 0xffffffb5 0xffffffb5 0xffffffb5 0xffffffb5 0xffffffb5 0xffffffb5 0xffffffb5 0xffffffb5 0xffffffb5 0xffffffb5 0xffffffb5 0xffffffb5 0xffffffb5 0xffffffb5 0xffffffb5 0xffffffb5 0xffffffb5 0xffffffb5 0xffffffb5 0xffffffb5 0xffffffb5 0xffffffb5 0xffffffb5 0xffffffb5 0xffffffb5 0xffffffb5 0xffffffb5 0xffffffb5 0xffffffb5 0xffffffb5 0xffffffb5 0xffffffb5 0xffffffb5 0xffffffb5 0xffffffb5 0xffffffb5 0xffffffb5 0xffffffb5 0xffffffb5 0xffffffb5 0xffffffb5 0xffffffb5 0xffffffb5 0xffffffb5 0xffffffb5 0xffffffb5 0xffffffb5 0xffffffb5 0xffffffb5 0xffffffb5 0xffffffb5 0xffffffb5 0xffffffb5 0xffffffb5 0xffffffb5 0xffffffb5 0xffffffb5 0xffffffb5 0xffffffb5 0xffffffb5 0xffffffb5 0xffffffb5 0xffffffb5 0xffffffb5 0xffffffb5 0xffffffb5 0xffffffb5 0xffffffb5 0xffffffb5 0xffffffb5 0xffffffb5 0xffffffb5 0xffffffb5 0xffffffb5 0xffffffb5 0xffffffb5 0xffffffb5 0xffffffb5 0xffffffb5 0xffffffb5 0xffffffb5 0xffffffb5 0xffffffb5 0xffffffb5 0xffffffb5 0xffffffb5 0xffffffb5 0xffffffb5 0xffffffb5 0xffffffb5 0xffffffb5 0xffffffb5 0xffffffb5 0xffffffb5 0xffffffb5 0xffffffb5 0xffffffb5 0xffffffb5 0xffffffb5 0xffffffb5 0xffffffb5 0xffffffb5 0xffffffb5 0xffffffb5 0xffffffb5 0xffffffb5 0xffffffb5 0xffffffb5 0xffffffb5 0xffffffb5 0xffffffb5 0xffffffb5 0xffffffb5 0xffffffb5 0xffffffb5 0xffffffb5 0xffffffb5 0xffffffb5 0xffffffb5 0xffffffb5 0xffffffb5 0xffffffb5 0xffffffb5 0xffffffb5 0xffffffb5 0xffffffb5 0xffffffb5 0xffffffb5 0xffffffb5 0xffffffb5 0xffffffb5 0xffffffb5 0xffffffb5 0xffffffb5 0xffffffb5 0xffffffb5 0xffffffb5 0xffffffb5 0xffffffb5 0xffffffb5 0xffffffb5 0xffffffb5 0xffffffb5 0xffffffb5 0xffffffb5 0xffffffb5 0xffffffb5 0xffffffb5 0xffffffb5 0xffffffb5 0xffffffb5 0xffffffb5 0xffffffb5 0xffffffb5 0xffffffb5 0xffffffb5 0xffffffb5 0xffffffb5 0xffffffb5 0xffffffb5 0xffffffb5 0xffffffb5 0xffffffb5 0xffffffb5 0xffffffb5 0xffffffb5 0xffffffb5 0xffffffb5 0xffffffb5 0xffffffb5 0xffffffb5 0xffffffb5 0xffffffb5 0xffffffb5 0xffffffb5 0xffffffb5 0xffffffb5 0xffffffb5 0xffffffb5 0xffffffb5 0xffffffb5 0xffffffb5 0xffffffb5 0xffffffb5 0xffffffb5 0xffffffb5 0xffffffb5 0xffffffb5 0xffffffb5 0xffffffb5 0xffffffb5 0xffffffb5 0xffffffb5 0xffffffb5 0xffffffb5 0xffffffb5 0xffffffb5 0xffffffb5 0xffffffb5 0xffffffb5 0xffffffb5 0xffffffb5 0xffffffb5 0xffffffb5 0xffffffb5 0xffffffb5 0xffffffb5 0xffffffb5 0xffffffb5 0xffffffb5 0xffffffb5 0xffffffb5 0xffffffb5 0xffffffb5 0xffffffb5 0xffffffb5 0xffffffb5 0xffffffb5 0xffffffb5 0xffffffb5 0xffffffb5 0xffffffb5 0xffffffb5 0xffffffb5 0xffffffb5 0xffffffb5 0xffffffb5 0xffffffb5 0xffffffb5 0xffffffb5 0xffffffb5 0xffffffb5 0xffffffb5 0xffffffb5 0xffffffb5 0xffffffb5 0xffffffb5 0xffffffb5 0xffffffb5 0xffffffb5 0xffffffb5 0xffffffb5 0xffffffb5 0xffffffb5 0xffffffb5 0xffffffb5 0xffffffb5 0xffffffb5 0xffffffb5 0xffffffb5 0xffffffb5 0xffffffb5 0xffffffb5 0xffffffb5 0xffffffb5 0xffffffb5 0xffffffb5 0xffffffb5 0xffffffb5 0xffffffb5 0xffffffb5 0xffffffb5 0xffffffb5 0xffffffb5 0xffffffb5 0xffffffb5 0xffffffb5 0xffffffb5 0xffffffb5 0xffffffb5 0xffffffb5 0xffffffb5 0xffffffb5 0xffffffb5 0xffffffb5 0xffffffb5 0xffffffb5 0xffffffb5 0xffffffb5 0xffffffb5 0xffffffb5 0xffffffb5 0xffffffb5 0xffffffb5 0xffffffb5 0xffffffb5 0xffffffb5 0xffffffb5 0xffffffb5 0xffffffb5 0xffffffb5 0xffffffb5 0xffffffb5 0xffffffb5 0xffffffb5 0xffffffb5 0xffffffb5 0xffffffb5 0xffffffb5 0xffffffb5 0xffffffb5 0xffffffb5 0xffffffb5 0xffffffb5 0xffffffb5 0xffffffb5 0xffffffb5 0xffffffb5 0xffffffb5 0xffffffb5 0xffffffb5 0xffffffb5 0xffffffb5 0xffffffb5 0xffffffb5 0xffffffb5 0xffffffb5 0xffffffb5 0xffffffb5 0xffffffb5 0xffffffb5 0xffffffb5 0xffffffb5 0xffffffb5 0xffffffb5 0xffffffb5 0xffffffb5 0xffffffb5 0xffffffb5 0xffffffb5 0xffffffb5 0xffffffb5 0xffffffb5 0xffffffb5 0xffffffb5 0xffffffb5 0xffffffb5 0xffffffb5 0xffffffb5 0xffffffb5 0xffffffb5 0xffffffb5 0xffffffb5 0xffffffb5 0xffffffb5 0xffffffb5 0xffffffb5 0xffffffb5 0xffffffb5 0xffffffb5 0xffffffb5 0xffffffb5 0xffffffb5 0xffffffb5 0xffffffb5 0xffffffb5 0xffffffb5 0xffffffb5 0xffffffb5 0xffffffb5 0xffffffb5 0xffffffb5 0xffffffb5 0xffffffb5 0xffffffb5 0xffffffb5 0xffffffb5 0xffffffb5 0xffffffb5 0xffffffb5 0xffffffb5 0xffffffb5 0xffffffb5 0xffffffb5 0xffffffb5 0xffffffb5 0xffffffb5 0xffffffb5 0xffffffb5 0xffffffb5 0xffffffb5 0xffffffb5 0xffffffb5 0xffffffb5 0xffffffb5 0xffffffb5 0xffffffb5 0xffffffb5 0xffffffb5 0xffffffb5 0xffffffb5 0xffffffb5 0xffffffb5 0xffffffb5 0xffffffb5 0xffffffb5 0xffffffb5 0xffffffb5 0xffffffb5 0xffffffb5 0xffffffb5 0xffffffb5 0xffffffb5>;
					PS_Config_Lmt_FW_Diff_P = <0x4b 0x4b 0x4b 0x4b 0x4b 0x4b 0x4b 0x4b 0x4b 0x4b 0x4b 0x4b 0x4b 0x4b 0x4b 0x4b 0x4b 0x4b 0x4b 0x4b 0x4b 0x4b 0x4b 0x4b 0x4b 0x4b 0x4b 0x4b 0x4b 0x4b 0x4b 0x4b 0x4b 0x4b 0x4b 0x4b 0x4b 0x4b 0x4b 0x4b 0x4b 0x4b 0x4b 0x4b 0x4b 0x4b 0x4b 0x4b 0x4b 0x4b 0x4b 0x4b 0x4b 0x4b 0x4b 0x4b 0x4b 0x4b 0x4b 0x4b 0x4b 0x4b 0x4b 0x4b 0x4b 0x4b 0x4b 0x4b 0x4b 0x4b 0x4b 0x4b 0x4b 0x4b 0x4b 0x4b 0x4b 0x4b 0x4b 0x4b 0x4b 0x4b 0x4b 0x4b 0x4b 0x4b 0x4b 0x4b 0x4b 0x4b 0x4b 0x4b 0x4b 0x4b 0x4b 0x4b 0x4b 0x4b 0x4b 0x4b 0x4b 0x4b 0x4b 0x4b 0x4b 0x4b 0x4b 0x4b 0x4b 0x4b 0x4b 0x4b 0x4b 0x4b 0x4b 0x4b 0x4b 0x4b 0x4b 0x4b 0x4b 0x4b 0x4b 0x4b 0x4b 0x4b 0x4b 0x4b 0x4b 0x4b 0x4b 0x4b 0x4b 0x4b 0x4b 0x4b 0x4b 0x4b 0x4b 0x4b 0x4b 0x4b 0x4b 0x4b 0x4b 0x4b 0x4b 0x4b 0x4b 0x4b 0x4b 0x4b 0x4b 0x4b 0x4b 0x4b 0x4b 0x4b 0x4b 0x4b 0x4b 0x4b 0x4b 0x4b 0x4b 0x4b 0x4b 0x4b 0x4b 0x4b 0x4b 0x4b 0x4b 0x4b 0x4b 0x4b 0x4b 0x4b 0x4b 0x4b 0x4b 0x4b 0x4b 0x4b 0x4b 0x4b 0x4b 0x4b 0x4b 0x4b 0x4b 0x4b 0x4b 0x4b 0x4b 0x4b 0x4b 0x4b 0x4b 0x4b 0x4b 0x4b 0x4b 0x4b 0x4b 0x4b 0x4b 0x4b 0x4b 0x4b 0x4b 0x4b 0x4b 0x4b 0x4b 0x4b 0x4b 0x4b 0x4b 0x4b 0x4b 0x4b 0x4b 0x4b 0x4b 0x4b 0x4b 0x4b 0x4b 0x4b 0x4b 0x4b 0x4b 0x4b 0x4b 0x4b 0x4b 0x4b 0x4b 0x4b 0x4b 0x4b 0x4b 0x4b 0x4b 0x4b 0x4b 0x4b 0x4b 0x4b 0x4b 0x4b 0x4b 0x4b 0x4b 0x4b 0x4b 0x4b 0x4b 0x4b 0x4b 0x4b 0x4b 0x4b 0x4b 0x4b 0x4b 0x4b 0x4b 0x4b 0x4b 0x4b 0x4b 0x4b 0x4b 0x4b 0x4b 0x4b 0x4b 0x4b 0x4b 0x4b 0x4b 0x4b 0x4b 0x4b 0x4b 0x4b 0x4b 0x4b 0x4b 0x4b 0x4b 0x4b 0x4b 0x4b 0x4b 0x4b 0x4b 0x4b 0x4b 0x4b 0x4b 0x4b 0x4b 0x4b 0x4b 0x4b 0x4b 0x4b 0x4b 0x4b 0x4b 0x4b 0x4b 0x4b 0x4b 0x4b 0x4b 0x4b 0x4b 0x4b 0x4b 0x4b 0x4b 0x4b 0x4b 0x4b 0x4b 0x4b 0x4b 0x4b 0x4b 0x4b 0x4b 0x4b 0x4b 0x4b 0x4b 0x4b 0x4b 0x4b 0x4b 0x4b 0x4b 0x4b 0x4b 0x4b 0x4b 0x4b 0x4b 0x4b 0x4b 0x4b 0x4b 0x4b 0x4b 0x4b 0x4b 0x4b 0x4b 0x4b 0x4b 0x4b 0x4b 0x4b 0x4b 0x4b 0x4b 0x4b 0x4b 0x4b 0x4b 0x4b 0x4b 0x4b 0x4b 0x4b 0x4b 0x4b 0x4b 0x4b 0x4b 0x4b 0x4b 0x4b 0x4b 0x4b 0x4b 0x4b 0x4b 0x4b 0x4b 0x4b 0x4b 0x4b 0x4b 0x4b 0x4b 0x4b 0x4b 0x4b 0x4b 0x4b 0x4b 0x4b 0x4b 0x4b 0x4b 0x4b 0x4b 0x4b 0x4b 0x4b 0x4b 0x4b 0x4b 0x4b 0x4b 0x4b 0x4b 0x4b 0x4b 0x4b 0x4b 0x4b 0x4b 0x4b 0x4b 0x4b 0x4b 0x4b 0x4b 0x4b 0x4b 0x4b 0x4b 0x4b 0x4b 0x4b 0x4b 0x4b 0x4b 0x4b 0x4b 0x4b 0x4b 0x4b 0x4b 0x4b 0x4b 0x4b 0x4b 0x4b 0x4b 0x4b 0x4b 0x4b 0x4b 0x4b 0x4b 0x4b 0x4b 0x4b 0x4b 0x4b 0x4b 0x4b 0x4b 0x4b 0x4b 0x4b 0x4b 0x4b 0x4b 0x4b 0x4b 0x4b 0x4b 0x4b 0x4b 0x4b 0x4b 0x4b 0x4b 0x4b 0x4b 0x4b 0x4b 0x4b 0x4b 0x4b 0x4b 0x4b 0x4b 0x4b 0x4b 0x4b 0x4b 0x4b 0x4b 0x4b 0x4b 0x4b 0x4b 0x4b 0x4b 0x4b 0x4b 0x4b 0x4b 0x4b 0x4b 0x4b 0x4b 0x4b 0x4b 0x4b 0x4b 0x4b 0x4b 0x4b 0x4b 0x4b 0x4b 0x4b 0x4b 0x4b 0x4b 0x4b 0x4b 0x4b 0x4b 0x4b 0x4b 0x4b 0x4b 0x4b 0x4b 0x4b 0x4b 0x4b 0x4b 0x4b 0x4b 0x4b 0x4b 0x4b 0x4b 0x4b 0x4b 0x4b 0x4b 0x4b 0x4b 0x4b 0x4b 0x4b 0x4b 0x4b 0x4b 0x4b 0x4b 0x4b 0x4b 0x4b 0x4b 0x4b 0x4b 0x4b 0x4b 0x4b 0x4b 0x4b 0x4b 0x4b 0x4b 0x4b 0x4b 0x4b 0x4b 0x4b 0x4b 0x4b 0x4b 0x4b 0x4b 0x4b 0x4b 0x4b 0x4b 0x4b 0x4b 0x4b 0x4b 0x4b 0x4b 0x4b 0x4b 0x4b 0x4b 0x4b 0x4b 0x4b 0x4b 0x4b 0x4b 0x4b 0x4b 0x4b 0x4b 0x4b 0x4b 0x4b 0x4b 0x4b 0x4b 0x4b 0x4b 0x4b 0x4b 0x4b 0x4b 0x4b 0x4b 0x4b 0x4b 0x4b 0x4b 0x4b 0x4b 0x4b 0x4b 0x4b 0x4b 0x4b 0x4b 0x4b 0x4b 0x4b 0x4b 0x4b 0x4b 0x4b 0x4b 0x4b 0x4b 0x4b 0x4b 0x4b 0x4b>;
					PS_Config_Lmt_FW_Rawdata_N = <0xf0 0xf0 0xf0 0xf0 0xf0 0xf0 0xf0 0xf0 0xf0 0xf0 0xf0 0xf0 0xf0 0xf0 0xf0 0xf0 0xf0 0xf0 0xf0 0xf0 0xf0 0xf0 0xf0 0xf0 0xf0 0xf0 0xf0 0xf0 0xf0 0xf0 0xf0 0xf0 0xf0 0xf0 0xf0 0xf0 0xf0 0xf0 0xf0 0xf0 0xf0 0xf0 0xf0 0xf0 0xf0 0xf0 0xf0 0xf0 0xf0 0xf0 0xf0 0xf0 0xf0 0xf0 0xf0 0xf0 0xf0 0xf0 0xf0 0xf0 0xf0 0xf0 0xf0 0xf0 0xf0 0xf0 0xf0 0xf0 0xf0 0xf0 0xf0 0xf0 0xf0 0xf0 0xf0 0xf0 0xf0 0xf0 0xf0 0xf0 0xf0 0xf0 0xf0 0xf0 0xf0 0xf0 0xf0 0xf0 0xf0 0xf0 0xf0 0xf0 0xf0 0xf0 0xf0 0xf0 0xf0 0xf0 0xf0 0xf0 0xf0 0xf0 0xf0 0xf0 0xf0 0xf0 0xf0 0xf0 0xf0 0xf0 0xf0 0xf0 0xf0 0xf0 0xf0 0xf0 0xf0 0xf0 0xf0 0xf0 0xf0 0xf0 0xf0 0xf0 0xf0 0xf0 0xf0 0xf0 0xf0 0xf0 0xf0 0xf0 0xf0 0xf0 0xf0 0xf0 0xf0 0xf0 0xf0 0xf0 0xf0 0xf0 0xf0 0xf0 0xf0 0xf0 0xf0 0xf0 0xf0 0xf0 0xf0 0xf0 0xf0 0xf0 0xf0 0xf0 0xf0 0xf0 0xf0 0xf0 0xf0 0xf0 0xf0 0xf0 0xf0 0xf0 0xf0 0xf0 0xf0 0xf0 0xf0 0xf0 0xf0 0xf0 0xf0 0xf0 0xf0 0xf0 0xf0 0xf0 0xf0 0xf0 0xf0 0xf0 0xf0 0xf0 0xf0 0xf0 0xf0 0xf0 0xf0 0xf0 0xf0 0xf0 0xf0 0xf0 0xf0 0xf0 0xf0 0xf0 0xf0 0xf0 0xf0 0xf0 0xf0 0xf0 0xf0 0xf0 0xf0 0xf0 0xf0 0xf0 0xf0 0xf0 0xf0 0xf0 0xf0 0xf0 0xf0 0xf0 0xf0 0xf0 0xf0 0xf0 0xf0 0xf0 0xf0 0xf0 0xf0 0xf0 0xf0 0xf0 0xf0 0xf0 0xf0 0xf0 0xf0 0xf0 0xf0 0xf0 0xf0 0xf0 0xf0 0xf0 0xf0 0xf0 0xf0 0xf0 0xf0 0xf0 0xf0 0xf0 0xf0 0xf0 0xf0 0xf0 0xf0 0xf0 0xf0 0xf0 0xf0 0xf0 0xf0 0xf0 0xf0 0xf0 0xf0 0xf0 0xf0 0xf0 0xf0 0xf0 0xf0 0xf0 0xf0 0xf0 0xf0 0xf0 0xf0 0xf0 0xf0 0xf0 0xf0 0xf0 0xf0 0xf0 0xf0 0xf0 0xf0 0xf0 0xf0 0xf0 0xf0 0xf0 0xf0 0xf0 0xf0 0xf0 0xf0 0xf0 0xf0 0xf0 0xf0 0xf0 0xf0 0xf0 0xf0 0xf0 0xf0 0xf0 0xf0 0xf0 0xf0 0xf0 0xf0 0xf0 0xf0 0xf0 0xf0 0xf0 0xf0 0xf0 0xf0 0xf0 0xf0 0xf0 0xf0 0xf0 0xf0 0xf0 0xf0 0xf0 0xf0 0xf0 0xf0 0xf0 0xf0 0xf0 0xf0 0xf0 0xf0 0xf0 0xf0 0xf0 0xf0 0xf0 0xf0 0xf0 0xf0 0xf0 0xf0 0xf0 0xf0 0xf0 0xf0 0xf0 0xf0 0xf0 0xf0 0xf0 0xf0 0xf0 0xf0 0xf0 0xf0 0xf0 0xf0 0xf0 0xf0 0xf0 0xf0 0xf0 0xf0 0xf0 0xf0 0xf0 0xf0 0xf0 0xf0 0xf0 0xf0 0xf0 0xf0 0xf0 0xf0 0xf0 0xf0 0xf0 0xf0 0xf0 0xf0 0xf0 0xf0 0xf0 0xf0 0xf0 0xf0 0xf0 0xf0 0xf0 0xf0 0xf0 0xf0 0xf0 0xf0 0xf0 0xf0 0xf0 0xf0 0xf0 0xf0 0xf0 0xf0 0xf0 0xf0 0xf0 0xf0 0xf0 0xf0 0xf0 0xf0 0xf0 0xf0 0xf0 0xf0 0xf0 0xf0 0xf0 0xf0 0xf0 0xf0 0xf0 0xf0 0xf0 0xf0 0xf0 0xf0 0xf0 0xf0 0xf0 0xf0 0xf0 0xf0 0xf0 0xf0 0xf0 0xf0 0xf0 0xf0 0xf0 0xf0 0xf0 0xf0 0xf0 0xf0 0xf0 0xf0 0xf0 0xf0 0xf0 0xf0 0xf0 0xf0 0xf0 0xf0 0xf0 0xf0 0xf0 0xf0 0xf0 0xf0 0xf0 0xf0 0xf0 0xf0 0xf0 0xf0 0xf0 0xf0 0xf0 0xf0 0xf0 0xf0 0xf0 0xf0 0xf0 0xf0 0xf0 0xf0 0xf0 0xf0 0xf0 0xf0 0xf0 0xf0 0xf0 0xf0 0xf0 0xf0 0xf0 0xf0 0xf0 0xf0 0xf0 0xf0 0xf0 0xf0 0xf0 0xf0 0xf0 0xf0 0xf0 0xf0 0xf0 0xf0 0xf0 0xf0 0xf0 0xf0 0xf0 0xf0 0xf0 0xf0 0xf0 0xf0 0xf0 0xf0 0xf0 0xf0 0xf0 0xf0 0xf0 0xf0 0xf0 0xf0 0xf0 0xf0 0xf0 0xf0 0xf0 0xf0 0xf0 0xf0 0xf0 0xf0 0xf0 0xf0 0xf0 0xf0 0xf0 0xf0 0xf0 0xf0 0xf0 0xf0 0xf0 0xf0 0xf0 0xf0 0xf0 0xf0 0xf0 0xf0 0xf0 0xf0 0xf0 0xf0 0xf0 0xf0 0xf0 0xf0 0xf0 0xf0 0xf0 0xf0 0xf0 0xf0 0xf0 0xf0 0xf0 0xf0 0xf0 0xf0 0xf0 0xf0 0xf0 0xf0 0xf0 0xf0 0xf0 0xf0 0xf0 0xf0 0xf0 0xf0 0xf0 0xf0 0xf0 0xf0 0xf0 0xf0 0xf0 0xf0 0xf0 0xf0 0xf0 0xf0 0xf0 0xf0 0xf0 0xf0 0xf0 0xf0 0xf0 0xf0 0xf0 0xf0 0xf0 0xf0 0xf0 0xf0 0xf0 0xf0 0xf0 0xf0 0xf0 0xf0 0xf0 0xf0 0xf0 0xf0 0xf0 0xf0 0xf0 0xf0 0xf0 0xf0 0xf0 0xf0 0xf0 0xf0 0xf0 0xf0 0xf0 0xf0 0xf0 0xf0 0xf0 0xf0 0xf0 0xf0>;
					PS_Config_Lmt_FW_Rawdata_P = <0xf00 0xf00 0xf00 0xf00 0xf00 0xf00 0xf00 0xf00 0xf00 0xf00 0xf00 0xf00 0xf00 0xf00 0xf00 0xf00 0xf00 0xf00 0xf00 0xf00 0xf00 0xf00 0xf00 0xf00 0xf00 0xf00 0xf00 0xf00 0xf00 0xf00 0xf00 0xf00 0xf00 0xf00 0xf00 0xf00 0xf00 0xf00 0xf00 0xf00 0xf00 0xf00 0xf00 0xf00 0xf00 0xf00 0xf00 0xf00 0xf00 0xf00 0xf00 0xf00 0xf00 0xf00 0xf00 0xf00 0xf00 0xf00 0xf00 0xf00 0xf00 0xf00 0xf00 0xf00 0xf00 0xf00 0xf00 0xf00 0xf00 0xf00 0xf00 0xf00 0xf00 0xf00 0xf00 0xf00 0xf00 0xf00 0xf00 0xf00 0xf00 0xf00 0xf00 0xf00 0xf00 0xf00 0xf00 0xf00 0xf00 0xf00 0xf00 0xf00 0xf00 0xf00 0xf00 0xf00 0xf00 0xf00 0xf00 0xf00 0xf00 0xf00 0xf00 0xf00 0xf00 0xf00 0xf00 0xf00 0xf00 0xf00 0xf00 0xf00 0xf00 0xf00 0xf00 0xf00 0xf00 0xf00 0xf00 0xf00 0xf00 0xf00 0xf00 0xf00 0xf00 0xf00 0xf00 0xf00 0xf00 0xf00 0xf00 0xf00 0xf00 0xf00 0xf00 0xf00 0xf00 0xf00 0xf00 0xf00 0xf00 0xf00 0xf00 0xf00 0xf00 0xf00 0xf00 0xf00 0xf00 0xf00 0xf00 0xf00 0xf00 0xf00 0xf00 0xf00 0xf00 0xf00 0xf00 0xf00 0xf00 0xf00 0xf00 0xf00 0xf00 0xf00 0xf00 0xf00 0xf00 0xf00 0xf00 0xf00 0xf00 0xf00 0xf00 0xf00 0xf00 0xf00 0xf00 0xf00 0xf00 0xf00 0xf00 0xf00 0xf00 0xf00 0xf00 0xf00 0xf00 0xf00 0xf00 0xf00 0xf00 0xf00 0xf00 0xf00 0xf00 0xf00 0xf00 0xf00 0xf00 0xf00 0xf00 0xf00 0xf00 0xf00 0xf00 0xf00 0xf00 0xf00 0xf00 0xf00 0xf00 0xf00 0xf00 0xf00 0xf00 0xf00 0xf00 0xf00 0xf00 0xf00 0xf00 0xf00 0xf00 0xf00 0xf00 0xf00 0xf00 0xf00 0xf00 0xf00 0xf00 0xf00 0xf00 0xf00 0xf00 0xf00 0xf00 0xf00 0xf00 0xf00 0xf00 0xf00 0xf00 0xf00 0xf00 0xf00 0xf00 0xf00 0xf00 0xf00 0xf00 0xf00 0xf00 0xf00 0xf00 0xf00 0xf00 0xf00 0xf00 0xf00 0xf00 0xf00 0xf00 0xf00 0xf00 0xf00 0xf00 0xf00 0xf00 0xf00 0xf00 0xf00 0xf00 0xf00 0xf00 0xf00 0xf00 0xf00 0xf00 0xf00 0xf00 0xf00 0xf00 0xf00 0xf00 0xf00 0xf00 0xf00 0xf00 0xf00 0xf00 0xf00 0xf00 0xf00 0xf00 0xf00 0xf00 0xf00 0xf00 0xf00 0xf00 0xf00 0xf00 0xf00 0xf00 0xf00 0xf00 0xf00 0xf00 0xf00 0xf00 0xf00 0xf00 0xf00 0xf00 0xf00 0xf00 0xf00 0xf00 0xf00 0xf00 0xf00 0xf00 0xf00 0xf00 0xf00 0xf00 0xf00 0xf00 0xf00 0xf00 0xf00 0xf00 0xf00 0xf00 0xf00 0xf00 0xf00 0xf00 0xf00 0xf00 0xf00 0xf00 0xf00 0xf00 0xf00 0xf00 0xf00 0xf00 0xf00 0xf00 0xf00 0xf00 0xf00 0xf00 0xf00 0xf00 0xf00 0xf00 0xf00 0xf00 0xf00 0xf00 0xf00 0xf00 0xf00 0xf00 0xf00 0xf00 0xf00 0xf00 0xf00 0xf00 0xf00 0xf00 0xf00 0xf00 0xf00 0xf00 0xf00 0xf00 0xf00 0xf00 0xf00 0xf00 0xf00 0xf00 0xf00 0xf00 0xf00 0xf00 0xf00 0xf00 0xf00 0xf00 0xf00 0xf00 0xf00 0xf00 0xf00 0xf00 0xf00 0xf00 0xf00 0xf00 0xf00 0xf00 0xf00 0xf00 0xf00 0xf00 0xf00 0xf00 0xf00 0xf00 0xf00 0xf00 0xf00 0xf00 0xf00 0xf00 0xf00 0xf00 0xf00 0xf00 0xf00 0xf00 0xf00 0xf00 0xf00 0xf00 0xf00 0xf00 0xf00 0xf00 0xf00 0xf00 0xf00 0xf00 0xf00 0xf00 0xf00 0xf00 0xf00 0xf00 0xf00 0xf00 0xf00 0xf00 0xf00 0xf00 0xf00 0xf00 0xf00 0xf00 0xf00 0xf00 0xf00 0xf00 0xf00 0xf00 0xf00 0xf00 0xf00 0xf00 0xf00 0xf00 0xf00 0xf00 0xf00 0xf00 0xf00 0xf00 0xf00 0xf00 0xf00 0xf00 0xf00 0xf00 0xf00 0xf00 0xf00 0xf00 0xf00 0xf00 0xf00 0xf00 0xf00 0xf00 0xf00 0xf00 0xf00 0xf00 0xf00 0xf00 0xf00 0xf00 0xf00 0xf00 0xf00 0xf00 0xf00 0xf00 0xf00 0xf00 0xf00 0xf00 0xf00 0xf00 0xf00 0xf00 0xf00 0xf00 0xf00 0xf00 0xf00 0xf00 0xf00 0xf00 0xf00 0xf00 0xf00 0xf00 0xf00 0xf00 0xf00 0xf00 0xf00 0xf00 0xf00 0xf00 0xf00 0xf00 0xf00 0xf00 0xf00 0xf00 0xf00 0xf00 0xf00 0xf00 0xf00 0xf00 0xf00 0xf00 0xf00 0xf00 0xf00 0xf00 0xf00 0xf00 0xf00 0xf00 0xf00 0xf00 0xf00 0xf00 0xf00 0xf00 0xf00 0xf00 0xf00 0xf00 0xf00 0xf00 0xf00 0xf00 0xf00 0xf00 0xf00 0xf00 0xf00 0xf00 0xf00 0xf00 0xf00 0xf00 0xf00 0xf00 0xf00 0xf00 0xf00 0xf00 0xf00 0xf00 0xf00 0xf00 0xf00 0xf00 0xf00 0xf00 0xf00 0xf00 0xf00 0xf00 0xf00 0xf00 0xf00 0xf00 0xf00 0xf00 0xf00 0xf00 0xf00 0xf00 0xf00 0xf00 0xf00 0xf00 0xf00 0xf00 0xf00 0xf00 0xf00 0xf00 0xf00 0xf00 0xf00 0xf00 0xf00 0xf00 0xf00 0xf00 0xf00 0xf00 0xf00 0xf00 0xf00 0xf00 0xf00 0xf00 0xf00 0xf00 0xf00 0xf00 0xf00 0xf00 0xf00 0xf00 0xf00 0xf00 0xf00 0xf00 0xf00 0xf00 0xf00 0xf00 0xf00 0xf00>;
					PS_Config_Lmt_Open_Rawdata_N = <0xfffffe01 0xfffffe01 0xfffffe01 0xfffffe01 0xfffffe01 0xfffffe01 0xfffffe01 0xfffffe01 0xfffffe01 0xfffffe01 0xfffffe01 0xfffffe01 0xfffffe01 0xfffffe01 0xfffffe01 0xfffffe01 0xfffffe01 0xfffffe01 0xfffffe01 0xfffffe01 0xfffffe01 0xfffffe01 0xfffffe01 0xfffffe01 0xfffffe01 0xfffffe01 0xfffffe01 0xfffffe01 0xfffffe01 0xfffffe01 0xfffffe01 0xfffffe01 0xfffffe01 0xfffffe01 0xfffffe01 0xfffffe01 0xfffffe01 0xfffffe01 0xfffffe01 0xfffffe01 0xfffffe01 0xfffffe01 0xfffffe01 0xfffffe01 0xfffffe01 0xfffffe01 0xfffffe01 0xfffffe01 0xfffffe01 0xfffffe01 0xfffffe01 0xfffffe01 0xfffffe01 0xfffffe01 0xfffffe01 0xfffffe01 0xfffffe01 0xfffffe01 0xfffffe01 0xfffffe01 0xfffffe01 0xfffffe01 0xfffffe01 0xfffffe01 0xfffffe01 0xfffffe01 0xfffffe01 0xfffffe01 0xfffffe01 0xfffffe01 0xfffffe01 0xfffffe01 0xfffffe01 0xfffffe01 0xfffffe01 0xfffffe01 0xfffffe01 0xfffffe01 0xfffffe01 0xfffffe01 0xfffffe01 0xfffffe01 0xfffffe01 0xfffffe01 0xfffffe01 0xfffffe01 0xfffffe01 0xfffffe01 0xfffffe01 0xfffffe01 0xfffffe01 0xfffffe01 0xfffffe01 0xfffffe01 0xfffffe01 0xfffffe01 0xfffffe01 0xfffffe01 0xfffffe01 0xfffffe01 0xfffffe01 0xfffffe01 0xfffffe01 0xfffffe01 0xfffffe01 0xfffffe01 0xfffffe01 0xfffffe01 0xfffffe01 0xfffffe01 0xfffffe01 0xfffffe01 0xfffffe01 0xfffffe01 0xfffffe01 0xfffffe01 0xfffffe01 0xfffffe01 0xfffffe01 0xfffffe01 0xfffffe01 0xfffffe01 0xfffffe01 0xfffffe01 0xfffffe01 0xfffffe01 0xfffffe01 0xfffffe01 0xfffffe01 0xfffffe01 0xfffffe01 0xfffffe01 0xfffffe01 0xfffffe01 0xfffffe01 0xfffffe01 0xfffffe01 0xfffffe01 0xfffffe01 0xfffffe01 0xfffffe01 0xfffffe01 0xfffffe01 0xfffffe01 0xfffffe01 0xfffffe01 0xfffffe01 0xfffffe01 0xfffffe01 0xfffffe01 0xfffffe01 0xfffffe01 0xfffffe01 0xfffffe01 0xfffffe01 0xfffffe01 0xfffffe01 0xfffffe01 0xfffffe01 0xfffffe01 0xfffffe01 0xfffffe01 0xfffffe01 0xfffffe01 0xfffffe01 0xfffffe01 0xfffffe01 0xfffffe01 0xfffffe01 0xfffffe01 0xfffffe01 0xfffffe01 0xfffffe01 0xfffffe01 0xfffffe01 0xfffffe01 0xfffffe01 0xfffffe01 0xfffffe01 0xfffffe01 0xfffffe01 0xfffffe01 0xfffffe01 0xfffffe01 0xfffffe01 0xfffffe01 0xfffffe01 0xfffffe01 0xfffffe01 0xfffffe01 0xfffffe01 0xfffffe01 0xfffffe01 0xfffffe01 0xfffffe01 0xfffffe01 0xfffffe01 0xfffffe01 0xfffffe01 0xfffffe01 0xfffffe01 0xfffffe01 0xfffffe01 0xfffffe01 0xfffffe01 0xfffffe01 0xfffffe01 0xfffffe01 0xfffffe01 0xfffffe01 0xfffffe01 0xfffffe01 0xfffffe01 0xfffffe01 0xfffffe01 0xfffffe01 0xfffffe01 0xfffffe01 0xfffffe01 0xfffffe01 0xfffffe01 0xfffffe01 0xfffffe01 0xfffffe01 0xfffffe01 0xfffffe01 0xfffffe01 0xfffffe01 0xfffffe01 0xfffffe01 0xfffffe01 0xfffffe01 0xfffffe01 0xfffffe01 0xfffffe01 0xfffffe01 0xfffffe01 0xfffffe01 0xfffffe01 0xfffffe01 0xfffffe01 0xfffffe01 0xfffffe01 0xfffffe01 0xfffffe01 0xfffffe01 0xfffffe01 0xfffffe01 0xfffffe01 0xfffffe01 0xfffffe01 0xfffffe01 0xfffffe01 0xfffffe01 0xfffffe01 0xfffffe01 0xfffffe01 0xfffffe01 0xfffffe01 0xfffffe01 0xfffffe01 0xfffffe01 0xfffffe01 0xfffffe01 0xfffffe01 0xfffffe01 0xfffffe01 0xfffffe01 0xfffffe01 0xfffffe01 0xfffffe01 0xfffffe01 0xfffffe01 0xfffffe01 0xfffffe01 0xfffffe01 0xfffffe01 0xfffffe01 0xfffffe01 0xfffffe01 0xfffffe01 0xfffffe01 0xfffffe01 0xfffffe01 0xfffffe01 0xfffffe01 0xfffffe01 0xfffffe01 0xfffffe01 0xfffffe01 0xfffffe01 0xfffffe01 0xfffffe01 0xfffffe01 0xfffffe01 0xfffffe01 0xfffffe01 0xfffffe01 0xfffffe01 0xfffffe01 0xfffffe01 0xfffffe01 0xfffffe01 0xfffffe01 0xfffffe01 0xfffffe01 0xfffffe01 0xfffffe01 0xfffffe01 0xfffffe01 0xfffffe01 0xfffffe01 0xfffffe01 0xfffffe01 0xfffffe01 0xfffffe01 0xfffffe01 0xfffffe01 0xfffffe01 0xfffffe01 0xfffffe01 0xfffffe01 0xfffffe01 0xfffffe01 0xfffffe01 0xfffffe01 0xfffffe01 0xfffffe01 0xfffffe01 0xfffffe01 0xfffffe01 0xfffffe01 0xfffffe01 0xfffffe01 0xfffffe01 0xfffffe01 0xfffffe01 0xfffffe01 0xfffffe01 0xfffffe01 0xfffffe01 0xfffffe01 0xfffffe01 0xfffffe01 0xfffffe01 0xfffffe01 0xfffffe01 0xfffffe01 0xfffffe01 0xfffffe01 0xfffffe01 0xfffffe01 0xfffffe01 0xfffffe01 0xfffffe01 0xfffffe01 0xfffffe01 0xfffffe01 0xfffffe01 0xfffffe01 0xfffffe01 0xfffffe01 0xfffffe01 0xfffffe01 0xfffffe01 0xfffffe01 0xfffffe01 0xfffffe01 0xfffffe01 0xfffffe01 0xfffffe01 0xfffffe01 0xfffffe01 0xfffffe01 0xfffffe01 0xfffffe01 0xfffffe01 0xfffffe01 0xfffffe01 0xfffffe01 0xfffffe01 0xfffffe01 0xfffffe01 0xfffffe01 0xfffffe01 0xfffffe01 0xfffffe01 0xfffffe01 0xfffffe01 0xfffffe01 0xfffffe01 0xfffffe01 0xfffffe01 0xfffffe01 0xfffffe01 0xfffffe01 0xfffffe01 0xfffffe01 0xfffffe01 0xfffffe01 0xfffffe01 0xfffffe01 0xfffffe01 0xfffffe01 0xfffffe01 0xfffffe01 0xfffffe01 0xfffffe01 0xfffffe01 0xfffffe01 0xfffffe01 0xfffffe01 0xfffffe01 0xfffffe01 0xfffffe01 0xfffffe01 0xfffffe01 0xfffffe01 0xfffffe01 0xfffffe01 0xfffffe01 0xfffffe01 0xfffffe01 0xfffffe01 0xfffffe01 0xfffffe01 0xfffffe01 0xfffffe01 0xfffffe01 0xfffffe01 0xfffffe01 0xfffffe01 0xfffffe01 0xfffffe01 0xfffffe01 0xfffffe01 0xfffffe01 0xfffffe01 0xfffffe01 0xfffffe01 0xfffffe01 0xfffffe01 0xfffffe01 0xfffffe01 0xfffffe01 0xfffffe01 0xfffffe01 0xfffffe01 0xfffffe01 0xfffffe01 0xfffffe01 0xfffffe01 0xfffffe01 0xfffffe01 0xfffffe01 0xfffffe01 0xfffffe01 0xfffffe01 0xfffffe01 0xfffffe01 0xfffffe01 0xfffffe01 0xfffffe01 0xfffffe01 0xfffffe01 0xfffffe01 0xfffffe01 0xfffffe01 0xfffffe01 0xfffffe01 0xfffffe01 0xfffffe01 0xfffffe01 0xfffffe01 0xfffffe01 0xfffffe01 0xfffffe01 0xfffffe01 0xfffffe01 0xfffffe01 0xfffffe01 0xfffffe01 0xfffffe01 0xfffffe01 0xfffffe01 0xfffffe01 0xfffffe01 0xfffffe01 0xfffffe01 0xfffffe01 0xfffffe01 0xfffffe01 0xfffffe01 0xfffffe01 0xfffffe01 0xfffffe01 0xfffffe01 0xfffffe01 0xfffffe01 0xfffffe01 0xfffffe01 0xfffffe01 0xfffffe01 0xfffffe01 0xfffffe01 0xfffffe01 0xfffffe01 0xfffffe01 0xfffffe01 0xfffffe01 0xfffffe01 0xfffffe01 0xfffffe01 0xfffffe01 0xfffffe01 0xfffffe01 0xfffffe01 0xfffffe01 0xfffffe01 0xfffffe01 0xfffffe01 0xfffffe01 0xfffffe01 0xfffffe01 0xfffffe01 0xfffffe01 0xfffffe01 0xfffffe01 0xfffffe01 0xfffffe01 0xfffffe01 0xfffffe01 0xfffffe01 0xfffffe01 0xfffffe01 0xfffffe01 0xfffffe01 0xfffffe01 0xfffffe01 0xfffffe01 0xfffffe01 0xfffffe01 0xfffffe01 0xfffffe01 0xfffffe01 0xfffffe01 0xfffffe01 0xfffffe01 0xfffffe01 0xfffffe01 0xfffffe01 0xfffffe01 0xfffffe01 0xfffffe01 0xfffffe01 0xfffffe01 0xfffffe01 0xfffffe01 0xfffffe01 0xfffffe01 0xfffffe01 0xfffffe01 0xfffffe01 0xfffffe01 0xfffffe01 0xfffffe01 0xfffffe01 0xfffffe01 0xfffffe01 0xfffffe01 0xfffffe01 0xfffffe01 0xfffffe01 0xfffffe01 0xfffffe01 0xfffffe01 0xfffffe01 0xfffffe01 0xfffffe01 0xfffffe01 0xfffffe01 0xfffffe01 0xfffffe01 0xfffffe01 0xfffffe01 0xfffffe01 0xfffffe01 0xfffffe01 0xfffffe01 0xfffffe01 0xfffffe01 0xfffffe01 0xfffffe01 0xfffffe01 0xfffffe01 0xfffffe01 0xfffffe01 0xfffffe01 0xfffffe01 0xfffffe01 0xfffffe01 0xfffffe01 0xfffffe01 0xfffffe01 0xfffffe01 0xfffffe01 0xfffffe01 0xfffffe01 0xfffffe01 0xfffffe01 0xfffffe01 0xfffffe01 0xfffffe01 0xfffffe01 0xfffffe01 0xfffffe01 0xfffffe01 0xfffffe01 0xfffffe01 0xfffffe01 0xfffffe01 0xfffffe01 0xfffffe01 0xfffffe01 0xfffffe01 0xfffffe01 0xfffffe01 0xfffffe01 0xfffffe01 0xfffffe01 0xfffffe01 0xfffffe01 0xfffffe01 0xfffffe01 0xfffffe01 0xfffffe01 0xfffffe01 0xfffffe01 0xfffffe01 0xfffffe01 0xfffffe01 0xfffffe01 0xfffffe01 0xfffffe01 0xfffffe01 0xfffffe01 0xfffffe01 0xfffffe01 0xfffffe01 0xfffffe01 0xfffffe01>;
					PS_Config_Lmt_Open_Rawdata_P = <0x1400 0x1400 0x1400 0x1400 0x1400 0x1400 0x1400 0x1400 0x1400 0x1400 0x1400 0x1400 0x1400 0x1400 0x1400 0x1400 0x1400 0x1400 0x1400 0x1400 0x1400 0x1400 0x1400 0x1400 0x1400 0x1400 0x1400 0x1400 0x1400 0x1400 0x1400 0x1400 0x1400 0x1400 0x1400 0x1400 0x1400 0x1400 0x1400 0x1400 0x1400 0x1400 0x1400 0x1400 0x1400 0x1400 0x1400 0x1400 0x1400 0x1400 0x1400 0x1400 0x1400 0x1400 0x1400 0x1400 0x1400 0x1400 0x1400 0x1400 0x1400 0x1400 0x1400 0x1400 0x1400 0x1400 0x1400 0x1400 0x1400 0x1400 0x1400 0x1400 0x1400 0x1400 0x1400 0x1400 0x1400 0x1400 0x1400 0x1400 0x1400 0x1400 0x1400 0x1400 0x1400 0x1400 0x1400 0x1400 0x1400 0x1400 0x1400 0x1400 0x1400 0x1400 0x1400 0x1400 0x1400 0x1400 0x1400 0x1400 0x1400 0x1400 0x1400 0x1400 0x1400 0x1400 0x1400 0x1400 0x1400 0x1400 0x1400 0x1400 0x1400 0x1400 0x1400 0x1400 0x1400 0x1400 0x1400 0x1400 0x1400 0x1400 0x1400 0x1400 0x1400 0x1400 0x1400 0x1400 0x1400 0x1400 0x1400 0x1400 0x1400 0x1400 0x1400 0x1400 0x1400 0x1400 0x1400 0x1400 0x1400 0x1400 0x1400 0x1400 0x1400 0x1400 0x1400 0x1400 0x1400 0x1400 0x1400 0x1400 0x1400 0x1400 0x1400 0x1400 0x1400 0x1400 0x1400 0x1400 0x1400 0x1400 0x1400 0x1400 0x1400 0x1400 0x1400 0x1400 0x1400 0x1400 0x1400 0x1400 0x1400 0x1400 0x1400 0x1400 0x1400 0x1400 0x1400 0x1400 0x1400 0x1400 0x1400 0x1400 0x1400 0x1400 0x1400 0x1400 0x1400 0x1400 0x1400 0x1400 0x1400 0x1400 0x1400 0x1400 0x1400 0x1400 0x1400 0x1400 0x1400 0x1400 0x1400 0x1400 0x1400 0x1400 0x1400 0x1400 0x1400 0x1400 0x1400 0x1400 0x1400 0x1400 0x1400 0x1400 0x1400 0x1400 0x1400 0x1400 0x1400 0x1400 0x1400 0x1400 0x1400 0x1400 0x1400 0x1400 0x1400 0x1400 0x1400 0x1400 0x1400 0x1400 0x1400 0x1400 0x1400 0x1400 0x1400 0x1400 0x1400 0x1400 0x1400 0x1400 0x1400 0x1400 0x1400 0x1400 0x1400 0x1400 0x1400 0x1400 0x1400 0x1400 0x1400 0x1400 0x1400 0x1400 0x1400 0x1400 0x1400 0x1400 0x1400 0x1400 0x1400 0x1400 0x1400 0x1400 0x1400 0x1400 0x1400 0x1400 0x1400 0x1400 0x1400 0x1400 0x1400 0x1400 0x1400 0x1400 0x1400 0x1400 0x1400 0x1400 0x1400 0x1400 0x1400 0x1400 0x1400 0x1400 0x1400 0x1400 0x1400 0x1400 0x1400 0x1400 0x1400 0x1400 0x1400 0x1400 0x1400 0x1400 0x1400 0x1400 0x1400 0x1400 0x1400 0x1400 0x1400 0x1400 0x1400 0x1400 0x1400 0x1400 0x1400 0x1400 0x1400 0x1400 0x1400 0x1400 0x1400 0x1400 0x1400 0x1400 0x1400 0x1400 0x1400 0x1400 0x1400 0x1400 0x1400 0x1400 0x1400 0x1400 0x1400 0x1400 0x1400 0x1400 0x1400 0x1400 0x1400 0x1400 0x1400 0x1400 0x1400 0x1400 0x1400 0x1400 0x1400 0x1400 0x1400 0x1400 0x1400 0x1400 0x1400 0x1400 0x1400 0x1400 0x1400 0x1400 0x1400 0x1400 0x1400 0x1400 0x1400 0x1400 0x1400 0x1400 0x1400 0x1400 0x1400 0x1400 0x1400 0x1400 0x1400 0x1400 0x1400 0x1400 0x1400 0x1400 0x1400 0x1400 0x1400 0x1400 0x1400 0x1400 0x1400 0x1400 0x1400 0x1400 0x1400 0x1400 0x1400 0x1400 0x1400 0x1400 0x1400 0x1400 0x1400 0x1400 0x1400 0x1400 0x1400 0x1400 0x1400 0x1400 0x1400 0x1400 0x1400 0x1400 0x1400 0x1400 0x1400 0x1400 0x1400 0x1400 0x1400 0x1400 0x1400 0x1400 0x1400 0x1400 0x1400 0x1400 0x1400 0x1400 0x1400 0x1400 0x1400 0x1400 0x1400 0x1400 0x1400 0x1400 0x1400 0x1400 0x1400 0x1400 0x1400 0x1400 0x1400 0x1400 0x1400 0x1400 0x1400 0x1400 0x1400 0x1400 0x1400 0x1400 0x1400 0x1400 0x1400 0x1400 0x1400 0x1400 0x1400 0x1400 0x1400 0x1400 0x1400 0x1400 0x1400 0x1400 0x1400 0x1400 0x1400 0x1400 0x1400 0x1400 0x1400 0x1400 0x1400 0x1400 0x1400 0x1400 0x1400 0x1400 0x1400 0x1400 0x1400 0x1400 0x1400 0x1400 0x1400 0x1400 0x1400 0x1400 0x1400 0x1400 0x1400 0x1400 0x1400 0x1400 0x1400 0x1400 0x1400 0x1400 0x1400 0x1400 0x1400 0x1400 0x1400 0x1400 0x1400 0x1400 0x1400 0x1400 0x1400 0x1400 0x1400 0x1400 0x1400 0x1400 0x1400 0x1400 0x1400 0x1400 0x1400 0x1400 0x1400 0x1400 0x1400 0x1400 0x1400 0x1400 0x1400 0x1400 0x1400 0x1400 0x1400 0x1400 0x1400 0x1400 0x1400 0x1400 0x1400 0x1400 0x1400 0x1400 0x1400 0x1400 0x1400 0x1400 0x1400 0x1400 0x1400 0x1400 0x1400 0x1400 0x1400 0x1400 0x1400 0x1400 0x1400 0x1400 0x1400 0x1400 0x1400 0x1400 0x1400 0x1400 0x1400 0x1400 0x1400 0x1400 0x1400 0x1400 0x1400 0x1400 0x1400 0x1400 0x1400 0x1400 0x1400 0x1400 0x1400 0x1400 0x1400 0x1400 0x1400 0x1400 0x1400 0x1400 0x1400 0x1400 0x1400 0x1400 0x1400 0x1400 0x1400 0x1400 0x1400 0x1400 0x1400 0x1400 0x1400 0x1400 0x1400 0x1400 0x1400 0x1400 0x1400 0x1400 0x1400 0x1400 0x1400 0x1400 0x1400 0x1400 0x1400 0x1400 0x1400 0x1400 0x1400 0x1400 0x1400 0x1400 0x1400 0x1400 0x1400 0x1400 0x1400 0x1400 0x1400 0x1400 0x1400 0x1400 0x1400 0x1400 0x1400 0x1400 0x1400 0x1400 0x1400 0x1400 0x1400 0x1400 0x1400 0x1400 0x1400 0x1400 0x1400 0x1400 0x1400 0x1400 0x1400 0x1400 0x1400 0x1400 0x1400>;
					PS_Config_Lmt_Short_Rawdata_N = <0x2710 0x2710 0x2710 0x2710 0x2710 0x2710 0x2710 0x2710 0x2710 0x2710 0x2710 0x2710 0x2710 0x2710 0x2710 0x2710 0x2710 0x2710 0x2710 0x2710 0x2710 0x2710 0x2710 0x2710 0x2710 0x2710 0x2710 0x2710 0x2710 0x2710 0x2710 0x2710 0x2710 0x2710 0x2710 0x2710 0x2710 0x2710 0x2710 0x2710 0x2710 0x2710 0x2710 0x2710 0x2710 0x2710 0x2710 0x2710 0x2710 0x2710 0x2710 0x2710 0x2710 0x2710 0x2710 0x2710 0x2710 0x2710 0x2710 0x2710 0x2710 0x2710 0x2710 0x2710 0x2710 0x2710 0x2710 0x2710 0x2710 0x2710 0x2710 0x2710 0x2710 0x2710 0x2710 0x2710 0x2710 0x2710 0x2710 0x2710 0x2710 0x2710 0x2710 0x2710 0x2710 0x2710 0x2710 0x2710 0x2710 0x2710 0x2710 0x2710 0x2710 0x2710 0x2710 0x2710 0x2710 0x2710 0x2710 0x2710 0x2710 0x2710 0x2710 0x2710 0x2710 0x2710 0x2710 0x2710 0x2710 0x2710 0x2710 0x2710 0x2710 0x2710 0x2710 0x2710 0x2710 0x2710 0x2710 0x2710 0x2710 0x2710 0x2710 0x2710 0x2710 0x2710 0x2710 0x2710 0x2710 0x2710 0x2710 0x2710 0x2710 0x2710 0x2710 0x2710 0x2710 0x2710 0x2710 0x2710 0x2710 0x2710 0x2710 0x2710 0x2710 0x2710 0x2710 0x2710 0x2710 0x2710 0x2710 0x2710 0x2710 0x2710 0x2710 0x2710 0x2710 0x2710 0x2710 0x2710 0x2710 0x2710 0x2710 0x2710 0x2710 0x2710 0x2710 0x2710 0x2710 0x2710 0x2710 0x2710 0x2710 0x2710 0x2710 0x2710 0x2710 0x2710 0x2710 0x2710 0x2710 0x2710 0x2710 0x2710 0x2710 0x2710 0x2710 0x2710 0x2710 0x2710 0x2710 0x2710 0x2710 0x2710 0x2710 0x2710 0x2710 0x2710 0x2710 0x2710 0x2710 0x2710 0x2710 0x2710 0x2710 0x2710 0x2710 0x2710 0x2710 0x2710 0x2710 0x2710 0x2710 0x2710 0x2710 0x2710 0x2710 0x2710 0x2710 0x2710 0x2710 0x2710 0x2710 0x2710 0x2710 0x2710 0x2710 0x2710 0x2710 0x2710 0x2710 0x2710 0x2710 0x2710 0x2710 0x2710 0x2710 0x2710 0x2710 0x2710 0x2710 0x2710 0x2710 0x2710 0x2710 0x2710 0x2710 0x2710 0x2710 0x2710 0x2710 0x2710 0x2710 0x2710 0x2710 0x2710 0x2710 0x2710 0x2710 0x2710 0x2710 0x2710 0x2710 0x2710 0x2710 0x2710 0x2710 0x2710 0x2710 0x2710 0x2710 0x2710 0x2710 0x2710 0x2710 0x2710 0x2710 0x2710 0x2710 0x2710 0x2710 0x2710 0x2710 0x2710 0x2710 0x2710 0x2710 0x2710 0x2710 0x2710 0x2710 0x2710 0x2710 0x2710 0x2710 0x2710 0x2710 0x2710 0x2710 0x2710 0x2710 0x2710 0x2710 0x2710 0x2710 0x2710 0x2710 0x2710 0x2710 0x2710 0x2710 0x2710 0x2710 0x2710 0x2710 0x2710 0x2710 0x2710 0x2710 0x2710 0x2710 0x2710 0x2710 0x2710 0x2710 0x2710 0x2710 0x2710 0x2710 0x2710 0x2710 0x2710 0x2710 0x2710 0x2710 0x2710 0x2710 0x2710 0x2710 0x2710 0x2710 0x2710 0x2710 0x2710 0x2710 0x2710 0x2710 0x2710 0x2710 0x2710 0x2710 0x2710 0x2710 0x2710 0x2710 0x2710 0x2710 0x2710 0x2710 0x2710 0x2710 0x2710 0x2710 0x2710 0x2710 0x2710 0x2710 0x2710 0x2710 0x2710 0x2710 0x2710 0x2710 0x2710 0x2710 0x2710 0x2710 0x2710 0x2710 0x2710 0x2710 0x2710 0x2710 0x2710 0x2710 0x2710 0x2710 0x2710 0x2710 0x2710 0x2710 0x2710 0x2710 0x2710 0x2710 0x2710 0x2710 0x2710 0x2710 0x2710 0x2710 0x2710 0x2710 0x2710 0x2710 0x2710 0x2710 0x2710 0x2710 0x2710 0x2710 0x2710 0x2710 0x2710 0x2710 0x2710 0x2710 0x2710 0x2710 0x2710 0x2710 0x2710 0x2710 0x2710 0x2710 0x2710 0x2710 0x2710 0x2710 0x2710 0x2710 0x2710 0x2710 0x2710 0x2710 0x2710 0x2710 0x2710 0x2710 0x2710 0x2710 0x2710 0x2710 0x2710 0x2710 0x2710 0x2710 0x2710 0x2710 0x2710 0x2710 0x2710 0x2710 0x2710 0x2710 0x2710 0x2710 0x2710 0x2710 0x2710 0x2710 0x2710 0x2710 0x2710 0x2710 0x2710 0x2710 0x2710 0x2710 0x2710 0x2710 0x2710 0x2710 0x2710 0x2710 0x2710 0x2710 0x2710 0x2710 0x2710 0x2710 0x2710 0x2710 0x2710 0x2710 0x2710 0x2710 0x2710 0x2710 0x2710 0x2710 0x2710 0x2710 0x2710 0x2710 0x2710 0x2710 0x2710 0x2710 0x2710 0x2710 0x2710 0x2710 0x2710 0x2710 0x2710 0x2710 0x2710 0x2710 0x2710 0x2710 0x2710 0x2710 0x2710 0x2710 0x2710 0x2710 0x2710 0x2710 0x2710 0x2710 0x2710 0x2710 0x2710 0x2710 0x2710 0x2710 0x2710 0x2710 0x2710 0x2710 0x2710 0x2710 0x2710 0x2710 0x2710 0x2710 0x2710 0x2710 0x2710 0x2710 0x2710 0x2710 0x2710 0x2710 0x2710 0x2710 0x2710 0x2710 0x2710 0x2710 0x2710 0x2710 0x2710 0x2710 0x2710 0x2710 0x2710 0x2710 0x2710 0x2710 0x2710 0x2710 0x2710 0x2710 0x2710 0x2710 0x2710 0x2710 0x2710 0x2710 0x2710 0x2710 0x2710 0x2710 0x2710 0x2710 0x2710 0x2710 0x2710 0x2710 0x2710 0x2710 0x2710 0x2710 0x2710 0x2710 0x2710 0x2710 0x2710 0x2710 0x2710 0x2710 0x2710 0x2710 0x2710 0x2710 0x2710 0x2710 0x2710 0x2710 0x2710 0x2710 0x2710 0x2710 0x2710 0x2710 0x2710 0x2710 0x2710 0x2710 0x2710 0x2710 0x2710 0x2710 0x2710 0x2710 0x2710 0x2710 0x2710 0x2710 0x2710 0x2710 0x2710 0x2710 0x2710 0x2710 0x2710 0x2710 0x2710 0x2710 0x2710 0x2710 0x2710 0x2710 0x2710 0x2710 0x2710 0x2710 0x2710 0x2710 0x2710 0x2710 0x2710 0x2710 0x2710 0x2710 0x2710 0x2710 0x2710 0x2710>;
					PS_Config_Lmt_Short_Rawdata_P = <0x36b8 0x36b8 0x36b8 0x36b8 0x36b8 0x36b8 0x36b8 0x36b8 0x36b8 0x36b8 0x36b8 0x36b8 0x36b8 0x36b8 0x36b8 0x36b8 0x36b8 0x36b8 0x36b8 0x36b8 0x36b8 0x36b8 0x36b8 0x36b8 0x36b8 0x36b8 0x36b8 0x36b8 0x36b8 0x36b8 0x36b8 0x36b8 0x36b8 0x36b8 0x36b8 0x36b8 0x36b8 0x36b8 0x36b8 0x36b8 0x36b8 0x36b8 0x36b8 0x36b8 0x36b8 0x36b8 0x36b8 0x36b8 0x36b8 0x36b8 0x36b8 0x36b8 0x36b8 0x36b8 0x36b8 0x36b8 0x36b8 0x36b8 0x36b8 0x36b8 0x36b8 0x36b8 0x36b8 0x36b8 0x36b8 0x36b8 0x36b8 0x36b8 0x36b8 0x36b8 0x36b8 0x36b8 0x36b8 0x36b8 0x36b8 0x36b8 0x36b8 0x36b8 0x36b8 0x36b8 0x36b8 0x36b8 0x36b8 0x36b8 0x36b8 0x36b8 0x36b8 0x36b8 0x36b8 0x36b8 0x36b8 0x36b8 0x36b8 0x36b8 0x36b8 0x36b8 0x36b8 0x36b8 0x36b8 0x36b8 0x36b8 0x36b8 0x36b8 0x36b8 0x36b8 0x36b8 0x36b8 0x36b8 0x36b8 0x36b8 0x36b8 0x36b8 0x36b8 0x36b8 0x36b8 0x36b8 0x36b8 0x36b8 0x36b8 0x36b8 0x36b8 0x36b8 0x36b8 0x36b8 0x36b8 0x36b8 0x36b8 0x36b8 0x36b8 0x36b8 0x36b8 0x36b8 0x36b8 0x36b8 0x36b8 0x36b8 0x36b8 0x36b8 0x36b8 0x36b8 0x36b8 0x36b8 0x36b8 0x36b8 0x36b8 0x36b8 0x36b8 0x36b8 0x36b8 0x36b8 0x36b8 0x36b8 0x36b8 0x36b8 0x36b8 0x36b8 0x36b8 0x36b8 0x36b8 0x36b8 0x36b8 0x36b8 0x36b8 0x36b8 0x36b8 0x36b8 0x36b8 0x36b8 0x36b8 0x36b8 0x36b8 0x36b8 0x36b8 0x36b8 0x36b8 0x36b8 0x36b8 0x36b8 0x36b8 0x36b8 0x36b8 0x36b8 0x36b8 0x36b8 0x36b8 0x36b8 0x36b8 0x36b8 0x36b8 0x36b8 0x36b8 0x36b8 0x36b8 0x36b8 0x36b8 0x36b8 0x36b8 0x36b8 0x36b8 0x36b8 0x36b8 0x36b8 0x36b8 0x36b8 0x36b8 0x36b8 0x36b8 0x36b8 0x36b8 0x36b8 0x36b8 0x36b8 0x36b8 0x36b8 0x36b8 0x36b8 0x36b8 0x36b8 0x36b8 0x36b8 0x36b8 0x36b8 0x36b8 0x36b8 0x36b8 0x36b8 0x36b8 0x36b8 0x36b8 0x36b8 0x36b8 0x36b8 0x36b8 0x36b8 0x36b8 0x36b8 0x36b8 0x36b8 0x36b8 0x36b8 0x36b8 0x36b8 0x36b8 0x36b8 0x36b8 0x36b8 0x36b8 0x36b8 0x36b8 0x36b8 0x36b8 0x36b8 0x36b8 0x36b8 0x36b8 0x36b8 0x36b8 0x36b8 0x36b8 0x36b8 0x36b8 0x36b8 0x36b8 0x36b8 0x36b8 0x36b8 0x36b8 0x36b8 0x36b8 0x36b8 0x36b8 0x36b8 0x36b8 0x36b8 0x36b8 0x36b8 0x36b8 0x36b8 0x36b8 0x36b8 0x36b8 0x36b8 0x36b8 0x36b8 0x36b8 0x36b8 0x36b8 0x36b8 0x36b8 0x36b8 0x36b8 0x36b8 0x36b8 0x36b8 0x36b8 0x36b8 0x36b8 0x36b8 0x36b8 0x36b8 0x36b8 0x36b8 0x36b8 0x36b8 0x36b8 0x36b8 0x36b8 0x36b8 0x36b8 0x36b8 0x36b8 0x36b8 0x36b8 0x36b8 0x36b8 0x36b8 0x36b8 0x36b8 0x36b8 0x36b8 0x36b8 0x36b8 0x36b8 0x36b8 0x36b8 0x36b8 0x36b8 0x36b8 0x36b8 0x36b8 0x36b8 0x36b8 0x36b8 0x36b8 0x36b8 0x36b8 0x36b8 0x36b8 0x36b8 0x36b8 0x36b8 0x36b8 0x36b8 0x36b8 0x36b8 0x36b8 0x36b8 0x36b8 0x36b8 0x36b8 0x36b8 0x36b8 0x36b8 0x36b8 0x36b8 0x36b8 0x36b8 0x36b8 0x36b8 0x36b8 0x36b8 0x36b8 0x36b8 0x36b8 0x36b8 0x36b8 0x36b8 0x36b8 0x36b8 0x36b8 0x36b8 0x36b8 0x36b8 0x36b8 0x36b8 0x36b8 0x36b8 0x36b8 0x36b8 0x36b8 0x36b8 0x36b8 0x36b8 0x36b8 0x36b8 0x36b8 0x36b8 0x36b8 0x36b8 0x36b8 0x36b8 0x36b8 0x36b8 0x36b8 0x36b8 0x36b8 0x36b8 0x36b8 0x36b8 0x36b8 0x36b8 0x36b8 0x36b8 0x36b8 0x36b8 0x36b8 0x36b8 0x36b8 0x36b8 0x36b8 0x36b8 0x36b8 0x36b8 0x36b8 0x36b8 0x36b8 0x36b8 0x36b8 0x36b8 0x36b8 0x36b8 0x36b8 0x36b8 0x36b8 0x36b8 0x36b8 0x36b8 0x36b8 0x36b8 0x36b8 0x36b8 0x36b8 0x36b8 0x36b8 0x36b8 0x36b8 0x36b8 0x36b8 0x36b8 0x36b8 0x36b8 0x36b8 0x36b8 0x36b8 0x36b8 0x36b8 0x36b8 0x36b8 0x36b8 0x36b8 0x36b8 0x36b8 0x36b8 0x36b8 0x36b8 0x36b8 0x36b8 0x36b8 0x36b8 0x36b8 0x36b8 0x36b8 0x36b8 0x36b8 0x36b8 0x36b8 0x36b8 0x36b8 0x36b8 0x36b8 0x36b8 0x36b8 0x36b8 0x36b8 0x36b8 0x36b8 0x36b8 0x36b8 0x36b8 0x36b8 0x36b8 0x36b8 0x36b8 0x36b8 0x36b8 0x36b8 0x36b8 0x36b8 0x36b8 0x36b8 0x36b8 0x36b8 0x36b8 0x36b8 0x36b8 0x36b8 0x36b8 0x36b8 0x36b8 0x36b8 0x36b8 0x36b8 0x36b8 0x36b8 0x36b8 0x36b8 0x36b8 0x36b8 0x36b8 0x36b8 0x36b8 0x36b8 0x36b8 0x36b8 0x36b8 0x36b8 0x36b8 0x36b8 0x36b8 0x36b8 0x36b8 0x36b8 0x36b8 0x36b8 0x36b8 0x36b8 0x36b8 0x36b8 0x36b8 0x36b8 0x36b8 0x36b8 0x36b8 0x36b8 0x36b8 0x36b8 0x36b8 0x36b8 0x36b8 0x36b8 0x36b8 0x36b8 0x36b8 0x36b8 0x36b8 0x36b8 0x36b8 0x36b8 0x36b8 0x36b8 0x36b8 0x36b8 0x36b8 0x36b8 0x36b8 0x36b8 0x36b8 0x36b8 0x36b8 0x36b8 0x36b8 0x36b8 0x36b8 0x36b8 0x36b8 0x36b8 0x36b8 0x36b8 0x36b8 0x36b8 0x36b8 0x36b8 0x36b8 0x36b8 0x36b8 0x36b8 0x36b8 0x36b8 0x36b8 0x36b8 0x36b8 0x36b8 0x36b8 0x36b8 0x36b8 0x36b8 0x36b8 0x36b8 0x36b8 0x36b8 0x36b8 0x36b8 0x36b8 0x36b8 0x36b8 0x36b8 0x36b8 0x36b8 0x36b8 0x36b8 0x36b8 0x36b8 0x36b8 0x36b8 0x36b8 0x36b8 0x36b8 0x36b8 0x36b8 0x36b8 0x36b8 0x36b8 0x36b8 0x36b8 0x36b8 0x36b8 0x36b8 0x36b8 0x36b8 0x36b8 0x36b8 0x36b8 0x36b8 0x36b8 0x36b8 0x36b8 0x36b8 0x36b8 0x36b8 0x36b8 0x36b8 0x36b8 0x36b8 0x36b8 0x36b8 0x36b8 0x36b8 0x36b8 0x36b8 0x36b8 0x36b8 0x36b8 0x36b8 0x36b8 0x36b8 0x36b8 0x36b8 0x36b8 0x36b8 0x36b8 0x36b8>;
					X_Channel = <0x12>;
					Y_Channel = <0x24>;
					compatible = "novatek-mp-criteria-627D";
				};
			};
		};
	};

	fragment@9 {
		target = <0xffffffff>;

		__overlay__ {
			compatible = "mediatek,touch";
			pinctrl-0 = <0x9>;
			pinctrl-1 = <0xa>;
			pinctrl-2 = <0xb>;
			pinctrl-3 = <0xc>;
			pinctrl-4 = <0xd>;
			pinctrl-5 = <0xe>;
			pinctrl-names = "default", "state_eint_as_int", "state_eint_output0", "state_eint_output1", "state_rst_output0", "state_rst_output1";
			status = "okay";
			tpd-filter-custom-prameters = <0x0 0x0 0x0 0x0 0x0 0x0 0x0 0x0 0x0 0x0 0x0 0x0>;
			tpd-filter-custom-speed = <0x0 0x0 0x0>;
			tpd-filter-enable = <0x0>;
			tpd-filter-pixel-density = <0x6a>;
			tpd-key-dim-local = <0x5a 0x373 0x64 0x28 0xe6 0x373 0x64 0x28 0x172 0x373 0x64 0x28 0x0 0x0 0x0 0x0>;
			tpd-key-local = <0x8b 0xac 0x9e 0x0>;
			tpd-key-num = <0x3>;
			tpd-max-touch-num = <0x5>;
			tpd-resolution = <0x438 0x99c>;
			use-tpd-button = <0x0>;
		};
	};
};
